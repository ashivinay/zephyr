## boards/arm/lpcxpresso55s36/Kconfig.board
```kconfig
# LPCXpresso55S36 board

# Copyright (c) 2021 NXP
# SPDX-License-Identifier: Apache-2.0

config BOARD_LPCXPRESSO55S36
	bool "NXP LPCXPRESSO-55S36"
	depends on SOC_SERIES_LPC55XXX
	select SOC_PART_NUMBER_LPC55S36JBD100
```

## boards/arm/lpcxpresso55s36/Kconfig.defconfig
```kconfig
# LPCXpresso55S36 board

# Copyright (c) 2021 NXP
# SPDX-License-Identifier: Apache-2.0

if BOARD_LPCXPRESSO55S36

config BOARD
	default "lpcxpresso55S36"

endif # BOARD_LPCXPRESSO55S36
```

## boards/arm/mimxrt1060_evk/Kconfig.board
```kconfig
# Copyright (c) 2018, NXP
# SPDX-License-Identifier: Apache-2.0

config BOARD_MIMXRT1060_EVK
	bool "NXP MIMXRT1060-EVK"
	depends on SOC_SERIES_IMX_RT
	select SOC_PART_NUMBER_MIMXRT1062DVL6A
	"MIMXRT1060 evaluation kit"

config BOARD_MIMXRT1060_EVK_HYPERFLASH
	bool "NXP MIMXRT1060-EVK-HYPERFLASH"
	depends on SOC_SERIES_IMX_RT
	select SOC_PART_NUMBER_MIMXRT1062DVL6A
	"MIMXRT1060 evaluation kit, with hyperflash modifications"

config BOARD_MIMXRT1060_EVKB
	bool "NXP MIMXRT1060-EVKB"
	depends on SOC_SERIES_IMX_RT
	select SOC_PART_NUMBER_MIMXRT1062DVL6B
	"MIMXRT1060B evaluation kit"

config BOARD_MIMXRT1060_EVKB_HYPERFLASH
	bool "NXP MIMXRT1060-EVKB-HYPERFLASH"
	depends on SOC_SERIES_IMX_RT
	select SOC_PART_NUMBER_MIMXRT1062DVL6B
	"MIMXRT1060B evaluation kit, with hyperflash modifications"
```

## drivers/pwm/Kconfig.mcux_flexio
```kconfig
# (c) Meta Platforms, Inc. and affiliates.
# SPDX-License-Identifier: Apache-2.0

config PWM_MCUX_FLEXIO
	bool "MCUX Flexio PWM driver"
	default y
	depends on DT_HAS_NXP_FLEXIO_PWM_ENABLED
	help
	  Enable flexio based pwm driver.
```

## drivers/sensor/qdec_s32k/Kconfig
```kconfig
# Copyright 2023 NXP
# SPDX-License-Identifier: Apache-2.0

config QDEC_S32K
	bool "NXP Quad Decoder S32K drivers"
	default y
	depends on DT_HAS_NXP_QDEC_S32K_ENABLED
	help
	  Enable drivers for NXP S32 QUADRATURE DECODER
```

## drivers/serial/Kconfig.mcux_flexcomm
```kconfig
# MCUXpresso SDK USART

# Copyright 2017, NXP
# SPDX-License-Identifier: Apache-2.0

config UART_MCUX_FLEXCOMM
	bool "MCUX FLEXCOMM UART driver"
	default y
	depends on DT_HAS_NXP_LPC_USART_ENABLED
	select SERIAL_HAS_DRIVER
	select SERIAL_SUPPORT_INTERRUPT
	select PINCTRL
	help
	  Enable the MCUX USART driver.


config UART_MCUX_FLEXCOMM_ISR_SUPPORT
	bool
	depends on UART_MCUX_FLEXCOMM
	default y if UART_INTERRUPT_DRIVEN || PM
	help
	  Enable UART interrupt service routine.
```

## dts/bindings/i3c/nxp,mcux-i3c.yaml
```yaml
# Copyright (c) 2019 NXP
# Copyright (c) 2022 Intel Corporation
#
# SPDX-License-Identifier: Apache-2.0

description: NXP MCUX I3C controller

compatible: "nxp,mcux-i3c"

include: [i3c-controller.yaml, pinctrl-device.yaml]

properties:
  reg:
    required: true

  interrupts:
    required: true

  i3c-od-scl-hz:
    type: int
    description: |
      Open Drain Frequency for the I3C controller. When undefined, use
      the controller default or as specified by the I3C specification.

  clk-divider:
    type: int
    default: 0
    description: |
      Main clock divider for I3C. If not specified, the default value
      will be used if changing clock divider is supported by the SoC.

  clk-divider-tc:
    type: int
    default: 0
    description: |
      Slow time control clock divider for I3C. If not specified, the
      default value will be used if changing clock divider is supported
      by the SoC.

  clk-divider-slow:
    type: int
    default: 0
    description: |
      Slow clock divider for I3C. If not specified, the default value
      will be used if changing clock divider is supported by the SoC.

  disable-open-drain-high-pp:
    type: boolean
    description: |
      If false, open drain high time is 1 PPBAUD count,
      which is short high and long low.
      If true, open drain high time is same as ODBAUD
      so that open drain clock is 50% duty cycle.
      Default is false.
```

## dts/bindings/interrupt-controller/nxp,s32-siul2-eirq.yaml
```yaml
# Copyright 2022-2023 NXP
#
# SPDX-License-Identifier: Apache-2.0

description: NXP S32 SIUL2 External Interrupts Request controller

compatible: "nxp,s32-siul2-eirq"

include: [interrupt-controller.yaml, pinctrl-device.yaml, base.yaml]

properties:
  reg:
    required: true

  reg-names:
    required: true

  pinctrl-0:
    required: true

  pinctrl-names:
    required: true

  filter-prescaler:
    type: int
    enum: [0, 1, 2, 3, 4, 5, 6, 7, 8, 9, 10, 11, 12, 13, 14, 15]
    description: |
      Setting the prescaler which selects the clock for all digital filters.

  interrupt-names:
    description: |
      For platforms that external interrupt lines belong to different interrupt
      IDs (i.e. there is no single interrupt handler for all the lines), this
      property is used by the shim driver to determine the ISR name as defined
      by the HAL.

      The naming must follow: <from-line-number>_<to-line-number>, for example:
      interrupt-names = "0_7", "8_15", "16_23", "24_31";

child-binding:
  description: |
    NXP S32 SIUL2 External Interrupt line configuration. Specific filter
    requirements for each interrupt line can be specified by adding a child node
    to the interrupt controller, labeled `line_<line_number>`. For example:

      line_0: line_0 {
          filter-counter = <5>;
      };

    This will enable a digital filter counter on the corresponding interrupt
    pads to filter out glitches on the inputs. The digital filter will be
    disabled for interrupt lines without specified configuration node.

  properties:
    max-filter-counter:
      type: int
      required: true
      enum: [0, 1, 2, 3, 4, 5, 6, 7, 8, 9, 10, 11, 12, 13, 14, 15]
      description: |
        Maximum Interrupt Filter Counter setting. This value configures the
        filter counter associated with the digital glitch filter.
        - A value of 0 to 2, sets the filter as an all pass filter.
        - A value of 3 to 15, sets the filter period to (TCK * MAXCNT + n * TCK)
          where:
          * n can be in the range 0 to 4, and accounts for the uncertainty
            factor in filter period calculation.
          * TCK is the prescaled filter clock period.

interrupt-cells:
  - gpio-pin
  - eirq-line
```

## dts/bindings/mtd/nxp,imx-flexspi-mx25um51345g.yaml
```yaml
# Copyright 2021 NXP
# SPDX-License-Identifier: Apache-2.0

description: NXP FlexSPI MX25UM51345G

compatible: "nxp,imx-flexspi-mx25um51345g"

include: ["nxp,imx-flexspi-device.yaml", soc-nv-flash.yaml]

properties:
  device-base:
        type: int
        required: false
        description: |
          Base memory mapped address of this flash device. Typically the same
          base as the parent FlexSPI controller, but may vary if the device is
          the second flash chip attached to one FlexSPI controller. If present,
          this will be used as the flash base instead of base address of the
          FlexSPI controller
```

## dts/bindings/power-domain/power-domain-deviceonoff.yaml
```yaml
# Copyright 2023 NXP
# SPDX-License-Identifier: Apache-2.0

description: Power domain to Turn On and Off devices for a specified Power State

compatible: "power-domain-deviceonoff"

include: power-domain.yaml

properties:
  onoff-power-states:
    type: phandles
    description: |
      List of power management states.
      The registered devices will be turned off before the PM subsystem
      enters these PM states. The devices will be turned on after the
      PM subsystem exits these PM states.
```

## dts/bindings/pwm/nxp,flexio-pwm.yaml
```yaml
# (c) Meta Platforms, Inc. and affiliates.
# SPDX-License-Identifier: Apache-2.0

description: NXP Flexio PWM

compatible: "nxp,flexio-pwm"

include: [pwm-controller.yaml, pinctrl-device.yaml, base.yaml]

properties:
  reg:
    required: true

  prescaler:
    type: int
    default: 1
    description: prescaling value

  clk-source:
    type: int
    required: true
    description: clock to use

  "#pwm-cells":
    const: 3

pwm-cells:
  - channel
  - period
  - flags
```

## dts/bindings/sensor/nxp,s32-qdec.yaml
```yaml
# Copyright 2023 NXP
# SPDX-License-Identifier: Apache-2.0

description: |
  Quadrature Decoder driver which processes encoder signals to determine motor revs

  with the cooperation of S32K - eMIOS, TRGMUX and LCU modules.

  The sensor qdec application can be used for testing this driver.

  The following example uses TRGMUX IN2 and IN3 to connect to LCU1 LC0 I0 and I1.

  LCU1 LC0 O2 and O3 connect to eMIOS0 CH6(Clockwise rotation) and

  CH7(Counter Clockwise rotation) via TRGMUX_INT_OUT37 and TRGMUX_INT_OUT38

  micro-ticks-per-rev is set as per vehicle gearbox reduction.

  lcu output filters are set to capture maximum speed sensitivity and avoid channel noise.

   qdec0 {
        compatible = "nxp,qdec-s32";
        pinctrl-0 = <&qdec_s32k>;
        pinctrl-names = "default";
        micro-ticks-per-rev = <685440000>;
        status = "okay";
        trgmux-inst = <0>;
        trgmux-io-config =
            <0 TRGMUX_IP_OUTPUT_EMIOS0_CH5_9_IPP_IND_CH6 TRGMUX_IP_INPUT_LCU1_LC0_OUT_I2>,
            <1 TRGMUX_IP_OUTPUT_EMIOS0_CH5_9_IPP_IND_CH7 TRGMUX_IP_INPUT_LCU1_LC0_OUT_I3>,
            <2 TRGMUX_IP_OUTPUT_LCU1_0_INP_I0            TRGMUX_IP_INPUT_SIUL2_IN2>,
            <3 TRGMUX_IP_OUTPUT_LCU1_0_INP_I1            TRGMUX_IP_INPUT_SIUL2_IN3>;
        trgmux-maps = < 54 3 >, /* TRGMUX_OUT_37 <-> eMIOS0_CH6 */
           < 55 4 >; /* TRGMUX_OUT_38 <-> eMIOS0_CH7 */
        lcu_inst = <1>;
        lcu-output-filter-config =
            /* LCU Out HW ID, Rise Filter, Fall Filter */
            <0 5 5>, /* LCU O0 */
            <1 5 5>, /* LCU O1 */
            <2 2 2>, /* LCU O2 */
            <3 2 2>; /* LCU O3 */
        emios = <&emios0>;
        emios-channels = <6 7>;
   };

compatible: "nxp,qdec-s32"

include: [pinctrl-device.yaml, sensor-device.yaml]

properties:
  micro-ticks-per-rev:
    type: int
    description: |
      This is a number that is used to determine how many revolutions * 1000000
      were done based on the current counter's value.

  trgmux-inst:
    type: int
    enum: [0, 1]
    description: |
      This gives the hardware instance of TRGMUX module.

  trgmux-io-config:
    type: array
    description: |
      This gives the logic triggers configuration of TRGMUX module.
      It contains 3 values for each of the 4 logic triggers used:
        logic trigger number, output, input.
      Hence, it's length should be '12'.
      Ex:
        trgmux-io-config =
          <0 TRGMUX_IP_OUTPUT_EMIOS0_CH5_9_IPP_IND_CH6 TRGMUX_IP_INPUT_LCU1_LC0_OUT_I2>,
          <1 TRGMUX_IP_OUTPUT_EMIOS0_CH5_9_IPP_IND_CH7 TRGMUX_IP_INPUT_LCU1_LC0_OUT_I3>,
          <2 TRGMUX_IP_OUTPUT_LCU1_0_INP_I0            TRGMUX_IP_INPUT_SIUL2_IN2>,
          <3 TRGMUX_IP_OUTPUT_LCU1_0_INP_I1            TRGMUX_IP_INPUT_SIUL2_IN3>;

  lcu_inst:
    type: int
    description: |
      This gives the hardware instance of LCU module.

  emios:
    type: phandle
    description: |
      phandle to the eMIOS node.

  lcu-output-filter-config:
    type: array
    description: |
      This array gives the configuration for each of the four outputs of LCU module.
      It contains the following for each output: hardware output id, rise filter and fall filter.
      The filters specify the delay in terms of CORE_CLK between the input and output line of LC.
        We use this delay to generate short pulses at the rising and falling edges of input pulse.
      It's length should be '12' - 3 entries for each of the four LCU outputs.
      Ex: lcu-output-filter-config =
        /* LCU Out HW ID, Rise Filter, Fall Filter */
        <0 5 5>, /* LCU O0 */
        <1 5 5>, /* LCU O1 */
        <2 2 2>, /* LCU O2 */
        <3 2 2>; /* LCU O3 */

  emios-channels:
    type: array
    description: |
      This is the array containing 2 emios channel TypeG numbers used by the qdec.
      See Table 342 in S32K3XXRM for more information

  trgmux-maps:
    type: array
    description: |
      Trgmux input and output mappings. Input is followed by the output.
      See S32K3XXRM S32K3XX_IOMUX.xlsx for more information
```

## dts/bindings/sensor/nxp,s32k-qdec.yaml
```yaml
# Copyright (c) 2022, Prevas A/S
# SPDX-License-Identifier: Apache-2.0

description: |
  Quadrature Decoder driver which processes encoder signals to determine MR-BUGGY3 displacement

  with cooperation of S32K344 - eMIOS, TRGMUX and LCU modules.

  The sensor qdec application can be used for testing this driver.

  The following example uses TRGMUX IN2 and IN3 to connect to LCU1 LC0 I0 and I1.

  LCU1 LC0 O2 and O3 connect to eMIOS0 CH6(Clockwise rotation) and

  CH7(Counter Clockwise rotation) via TRGMUX_INT_OUT37 and TRGMUX_INT_OUT38

  micro-ticks-per-rev is set as per BUGGY3 gearbox reduction.

  lcu filters are set to capture maximum speed sensitivity and avoid channel noise.

  qdec0: qdec0 {
    compatible = "nxp,qdec-s32k";
    pinctrl-0 = <&qdec_s32k>;
    pinctrl-names = "default";
    status = "okay";
    lcu_inst = <1>;
    emios_inst = <0>;
    micro-ticks-per-rev = <685440000>;
    lcu-rise-fall-filter = <5>;
    lcu-glitch-filter = <2>;
    emios-channels = <6 7>;
    trgmux-maps = < 54 3 >, /* TRGMUX_OUT_37 <-> eMIOS0_CH6 */
        < 55 4 >; /* TRGMUX_OUT_38 <-> eMIOS0_CH7 */
  };


compatible: "nxp,qdec-s32k"

include: [pinctrl-device.yaml, sensor-device.yaml]

properties:
  micro-ticks-per-rev:
    type: int
    description: |
      This is a number that is used to determine how many revolutions * 1000000
      were done based on the current counter's value.

  lcu_inst:
    type: int
    description: |
      This gives the hardware instance of LCU module.

  emios_inst:
    type: int
    description: |
      This gives the hardware instance of eMIOS module.

  lcu-rise-fall-filter:
    type: int
    description: |
      This filter specifies the delay in terms of CORE_CLK between the input and the output line of LC.
      We use this delay to genarate short pulses at the rising and falling edges of input pulse.

  lcu-glitch-filter:
    type: int
    description: |
      This filter specifies the minimum width of the LC output pulse in terms of CORE_CLK.
      Any pulse less than this value will not be reflected on the output of LCU module.

  emios-channels:
    type: array
    description: |
      This is the array containing 2 emios channel TypeG numbers used by the qdec.
      See Table 342 in S32K3XXRM for more information

  trgmux-maps:
    type: array
    description: |
      Trgmux input and output mappings. Input is followed by the output.
      See S32K3XXRM S32K3XX_IOMUX.xlsx for more information
```

## modules/hal_nxp/Kconfig
```kconfig
#
# Copyright (c) 2021 Linaro, Limited
#
# SPDX-License-Identifier: Apache-2.0
#
config NXP_OSA
    bool "NXP OSA Layer"
    help
	if y, include NXP's OS abstraction layer in the build
```

## samples/boards/nxp_s32/mru/sample.yaml
```yaml
sample:
  name: NXP S32 MRU sample
tests:
  sample.boards.nxp_s32.mru:
    platform_allow: s32z270dc2_rtu0_r52
    tags: mbox
    harness: console
    harness_config:
      type: multi_line
      ordered: true
      regex:
        - "Ping on channel 0, tx data is \\d+"
        - "Pong on channel 0, rx data is \\d+"
        - "Ping on channel 0, tx data is \\d+"
        - "Pong on channel 0, rx data is \\d+"
```
