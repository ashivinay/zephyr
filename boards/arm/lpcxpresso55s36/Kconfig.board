## samples/net/zperf/boards/mimxrt1050_evk.conf
```kconfig
CONFIG_THREAD_NAME=y
CONFIG_SEGGER_SYSTEMVIEW=y
CONFIG_USE_SEGGER_RTT=y
CONFIG_TRACING=y
CONFIG_SEGGER_SYSVIEW_RTT_BUFFER_SIZE=65536

# Enable the below to relocate code to ITCM
#CONFIG_CODE_ITCM=y
#CONFIG_PLATFORM_SPECIFIC_INIT=y

# Enable the below to log net packet allocations to RTT
# CONFIG_NET_PKT_LOG_LEVEL_DBG=y
# CONFIG_NET_DEBUG_NET_PKT_ALLOC=y
# CONFIG_LOG_BACKEND_UART=n
# CONFIG_LOG_BACKEND_RTT=y
# # Don't use the UART shell for logging, we want to use RTT
# CONFIG_SHELL_LOG_BACKEND=n

# Enable the below to log net connection info
# CONFIG_NET_CONN_LOG_LEVEL_DBG=y
```

## samples/subsys/ipc/openamp/remote/boards/mimxrt1170_evk_cm4.conf
```kconfig
CONFIG_BUILD_OUTPUT_INFO_HEADER=y
# Generate hex build file so that JLink can flash to the correct offset
CONFIG_BUILD_OUTPUT_HEX=y
```

## soc/arm/nxp_lpc/lpc55xxx/Kconfig.defconfig.lpc55S36
```kconfig
# NXP LPC55S36 platform configuration options

# Copyright (c) 2021 NXP
# SPDX-License-Identifier: Apache-2.0

if SOC_LPC55S36

config SOC
	default "lpc55S36"

config PINMUX_MCUX_LPC
	default y
	depends on PINMUX

config GPIO_MCUX_LPC
	default y
	depends on GPIO

config UART_MCUX_FLEXCOMM
	default y
	depends on SERIAL

config SOC_FLASH_MCUX
	default y
	depends on FLASH

endif # SOC_LPC55S36
```

## tests/boot/test_mcuboot/testcase.yaml
```yaml
common:
    sysbuild: True
    depends_on: mcuboot
    harness: console
    harness_config:
      type: multi_line
      regex:
        - "I: Starting bootloader"
        - "Launching primary slot application on (.*)"
        - "Secondary application ready for swap, rebooting"
        - "I: Starting swap using (.*)"
        - "Swapped application booted on (.*)"
tests:
  boot.mcuboot:
    tags: mcuboot
```
