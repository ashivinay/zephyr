## sample.yaml
```
sample:
  name: I2C shell demo
tests:
  sample.drivers.i2c.shell:
    tags: drivers
    depends_on: i2c
    harness: sensor
    filter: dt_alias_exists("accel-0")
```

## prj.conf
```kconfig
CONFIG_I2C=y
CONFIG_SHELL=y
CONFIG_I2C_SHELL=y
```

## src/main.c
```c
/*
 * Copyright (c) 2022 NXP
 *
 * SPDX-License-Identifier: Apache-2.0
 */


#define LOG_LEVEL CONFIG_LOG_DEFAULT_LEVEL
#include <zephyr/logging/log.h>
LOG_MODULE_REGISTER(app);

void main(void)
{
}
```
