/*
 * Copyright (c) 2021, NXP
 *
 * SPDX-License-Identifier: Apache-2.0
 * Generated by rt-iomucx-parser.py on 2022-01-05
 */
&pinctrl {
	IOMUXC_SNVS_WAKEUP_GPIO5_IO00: IOMUXC_SNVS_WAKEUP_GPIO5_IO00 {
		pinmux = <0x400A8000 0x5 0 0 0x400A8018>;
	};

	IOMUXC_SNVS_WAKEUP_NMI_GLUE_NMI: IOMUXC_SNVS_WAKEUP_NMI_GLUE_NMI {
		pinmux = <0x400A8000 0x7 0x401F8568 0x1 0x400A8018>;
	};

	IOMUXC_SNVS_PMIC_ON_REQ_SNVS_LP_PMIC_ON_REQ: IOMUXC_SNVS_PMIC_ON_REQ_SNVS_LP_PMIC_ON_REQ {
		pinmux = <0x400A8004 0x0 0 0 0x400A801C>;
	};

	IOMUXC_SNVS_PMIC_ON_REQ_GPIO5_IO01: IOMUXC_SNVS_PMIC_ON_REQ_GPIO5_IO01 {
		pinmux = <0x400A8004 0x5 0 0 0x400A801C>;
	};

	IOMUXC_SNVS_PMIC_STBY_REQ_CCM_PMIC_VSTBY_REQ: IOMUXC_SNVS_PMIC_STBY_REQ_CCM_PMIC_VSTBY_REQ {
		pinmux = <0x400A8008 0x0 0 0 0x400A8020>;
	};

	IOMUXC_SNVS_PMIC_STBY_REQ_GPIO5_IO02: IOMUXC_SNVS_PMIC_STBY_REQ_GPIO5_IO02 {
		pinmux = <0x400A8008 0x5 0 0 0x400A8020>;
	};

	IOMUXC_SNVS_TEST_MODE: IOMUXC_SNVS_TEST_MODE {
		pinmux = <0 0 0 0 0x400A800C>;
	};

	IOMUXC_SNVS_POR_B: IOMUXC_SNVS_POR_B {
		pinmux = <0 0 0 0 0x400A8010>;
	};

	IOMUXC_SNVS_ONOFF: IOMUXC_SNVS_ONOFF {
		pinmux = <0 0 0 0 0x400A8014>;
	};

	IOMUXC_GPIO_EMC_00_SEMC_DATA00: IOMUXC_GPIO_EMC_00_SEMC_DATA00 {
		pinmux = <0x401F8014 0x0 0 0 0x401F8204>;
	};

	IOMUXC_GPIO_EMC_00_FLEXPWM4_PWMA00: IOMUXC_GPIO_EMC_00_FLEXPWM4_PWMA00 {
		pinmux = <0x401F8014 0x1 0x401F8494 0x0 0x401F8204>;
	};

	IOMUXC_GPIO_EMC_00_LPSPI2_SCK: IOMUXC_GPIO_EMC_00_LPSPI2_SCK {
		pinmux = <0x401F8014 0x2 0x401F8500 0x1 0x401F8204>;
	};

	IOMUXC_GPIO_EMC_00_XBAR1_XBAR_IN02: IOMUXC_GPIO_EMC_00_XBAR1_XBAR_IN02 {
		pinmux = <0x401F8014 0x3 0x401F860C 0x0 0x401F8204>;
	};

	IOMUXC_GPIO_EMC_00_FLEXIO1_FLEXIO00: IOMUXC_GPIO_EMC_00_FLEXIO1_FLEXIO00 {
		pinmux = <0x401F8014 0x4 0 0 0x401F8204>;
	};

	IOMUXC_GPIO_EMC_00_GPIO4_IO00: IOMUXC_GPIO_EMC_00_GPIO4_IO00 {
		pinmux = <0x401F8014 0x5 0 0 0x401F8204>;
	};

	IOMUXC_GPIO_EMC_01_SEMC_DATA01: IOMUXC_GPIO_EMC_01_SEMC_DATA01 {
		pinmux = <0x401F8018 0x0 0 0 0x401F8208>;
	};

	IOMUXC_GPIO_EMC_01_FLEXPWM4_PWMB00: IOMUXC_GPIO_EMC_01_FLEXPWM4_PWMB00 {
		pinmux = <0x401F8018 0x1 0 0 0x401F8208>;
	};

	IOMUXC_GPIO_EMC_01_LPSPI2_PCS0: IOMUXC_GPIO_EMC_01_LPSPI2_PCS0 {
		pinmux = <0x401F8018 0x2 0x401F84FC 0x1 0x401F8208>;
	};

	IOMUXC_GPIO_EMC_01_XBAR1_IN03: IOMUXC_GPIO_EMC_01_XBAR1_IN03 {
		pinmux = <0x401F8018 0x3 0x401F8610 0x0 0x401F8208>;
	};

	IOMUXC_GPIO_EMC_01_FLEXIO1_FLEXIO01: IOMUXC_GPIO_EMC_01_FLEXIO1_FLEXIO01 {
		pinmux = <0x401F8018 0x4 0 0 0x401F8208>;
	};

	IOMUXC_GPIO_EMC_01_GPIO4_IO01: IOMUXC_GPIO_EMC_01_GPIO4_IO01 {
		pinmux = <0x401F8018 0x5 0 0 0x401F8208>;
	};

	IOMUXC_GPIO_EMC_02_SEMC_DATA02: IOMUXC_GPIO_EMC_02_SEMC_DATA02 {
		pinmux = <0x401F801C 0x0 0 0 0x401F820C>;
	};

	IOMUXC_GPIO_EMC_02_FLEXPWM4_PWMA01: IOMUXC_GPIO_EMC_02_FLEXPWM4_PWMA01 {
		pinmux = <0x401F801C 0x1 0x401F8498 0x0 0x401F820C>;
	};

	IOMUXC_GPIO_EMC_02_LPSPI2_SDO: IOMUXC_GPIO_EMC_02_LPSPI2_SDO {
		pinmux = <0x401F801C 0x2 0x401F8508 0x1 0x401F820C>;
	};

	IOMUXC_GPIO_EMC_02_XBAR1_INOUT04: IOMUXC_GPIO_EMC_02_XBAR1_INOUT04 {
		pinmux = <0x401F801C 0x3 0x401F8614 0x0 0x401F820C>;
	};

	IOMUXC_GPIO_EMC_02_FLEXIO1_FLEXIO02: IOMUXC_GPIO_EMC_02_FLEXIO1_FLEXIO02 {
		pinmux = <0x401F801C 0x4 0 0 0x401F820C>;
	};

	IOMUXC_GPIO_EMC_02_GPIO4_IO02: IOMUXC_GPIO_EMC_02_GPIO4_IO02 {
		pinmux = <0x401F801C 0x5 0 0 0x401F820C>;
	};

	IOMUXC_GPIO_EMC_03_SEMC_DATA03: IOMUXC_GPIO_EMC_03_SEMC_DATA03 {
		pinmux = <0x401F8020 0x0 0 0 0x401F8210>;
	};

	IOMUXC_GPIO_EMC_03_FLEXPWM4_PWMB01: IOMUXC_GPIO_EMC_03_FLEXPWM4_PWMB01 {
		pinmux = <0x401F8020 0x1 0 0 0x401F8210>;
	};

	IOMUXC_GPIO_EMC_03_LPSPI2_SDI: IOMUXC_GPIO_EMC_03_LPSPI2_SDI {
		pinmux = <0x401F8020 0x2 0x401F8504 0x1 0x401F8210>;
	};

	IOMUXC_GPIO_EMC_03_XBAR1_INOUT05: IOMUXC_GPIO_EMC_03_XBAR1_INOUT05 {
		pinmux = <0x401F8020 0x3 0x401F8618 0x0 0x401F8210>;
	};

	IOMUXC_GPIO_EMC_03_FLEXIO1_FLEXIO03: IOMUXC_GPIO_EMC_03_FLEXIO1_FLEXIO03 {
		pinmux = <0x401F8020 0x4 0 0 0x401F8210>;
	};

	IOMUXC_GPIO_EMC_03_GPIO4_IO03: IOMUXC_GPIO_EMC_03_GPIO4_IO03 {
		pinmux = <0x401F8020 0x5 0 0 0x401F8210>;
	};

	IOMUXC_GPIO_EMC_04_SEMC_DATA04: IOMUXC_GPIO_EMC_04_SEMC_DATA04 {
		pinmux = <0x401F8024 0x0 0 0 0x401F8214>;
	};

	IOMUXC_GPIO_EMC_04_FLEXPWM4_PWMA02: IOMUXC_GPIO_EMC_04_FLEXPWM4_PWMA02 {
		pinmux = <0x401F8024 0x1 0x401F849C 0x0 0x401F8214>;
	};

	IOMUXC_GPIO_EMC_04_SAI2_TX_DATA: IOMUXC_GPIO_EMC_04_SAI2_TX_DATA {
		pinmux = <0x401F8024 0x2 0 0 0x401F8214>;
	};

	IOMUXC_GPIO_EMC_04_XBAR1_INOUT06: IOMUXC_GPIO_EMC_04_XBAR1_INOUT06 {
		pinmux = <0x401F8024 0x3 0x401F861C 0x0 0x401F8214>;
	};

	IOMUXC_GPIO_EMC_04_FLEXIO1_FLEXIO04: IOMUXC_GPIO_EMC_04_FLEXIO1_FLEXIO04 {
		pinmux = <0x401F8024 0x4 0 0 0x401F8214>;
	};

	IOMUXC_GPIO_EMC_04_GPIO4_IO04: IOMUXC_GPIO_EMC_04_GPIO4_IO04 {
		pinmux = <0x401F8024 0x5 0 0 0x401F8214>;
	};

	IOMUXC_GPIO_EMC_05_SEMC_DATA05: IOMUXC_GPIO_EMC_05_SEMC_DATA05 {
		pinmux = <0x401F8028 0x0 0 0 0x401F8218>;
	};

	IOMUXC_GPIO_EMC_05_FLEXPWM4_PWMB02: IOMUXC_GPIO_EMC_05_FLEXPWM4_PWMB02 {
		pinmux = <0x401F8028 0x1 0 0 0x401F8218>;
	};

	IOMUXC_GPIO_EMC_05_SAI2_TX_SYNC: IOMUXC_GPIO_EMC_05_SAI2_TX_SYNC {
		pinmux = <0x401F8028 0x2 0x401F85C4 0x0 0x401F8218>;
	};

	IOMUXC_GPIO_EMC_05_XBAR1_INOUT07: IOMUXC_GPIO_EMC_05_XBAR1_INOUT07 {
		pinmux = <0x401F8028 0x3 0x401F8620 0x0 0x401F8218>;
	};

	IOMUXC_GPIO_EMC_05_FLEXIO1_FLEXIO05: IOMUXC_GPIO_EMC_05_FLEXIO1_FLEXIO05 {
		pinmux = <0x401F8028 0x4 0 0 0x401F8218>;
	};

	IOMUXC_GPIO_EMC_05_GPIO4_IO05: IOMUXC_GPIO_EMC_05_GPIO4_IO05 {
		pinmux = <0x401F8028 0x5 0 0 0x401F8218>;
	};

	IOMUXC_GPIO_EMC_06_SEMC_DATA06: IOMUXC_GPIO_EMC_06_SEMC_DATA06 {
		pinmux = <0x401F802C 0x0 0 0 0x401F821C>;
	};

	IOMUXC_GPIO_EMC_06_FLEXPWM2_PWMA00: IOMUXC_GPIO_EMC_06_FLEXPWM2_PWMA00 {
		pinmux = <0x401F802C 0x1 0x401F8478 0x0 0x401F821C>;
	};

	IOMUXC_GPIO_EMC_06_SAI2_TX_BCLK: IOMUXC_GPIO_EMC_06_SAI2_TX_BCLK {
		pinmux = <0x401F802C 0x2 0x401F85C0 0x0 0x401F821C>;
	};

	IOMUXC_GPIO_EMC_06_XBAR1_INOUT08: IOMUXC_GPIO_EMC_06_XBAR1_INOUT08 {
		pinmux = <0x401F802C 0x3 0x401F8624 0x0 0x401F821C>;
	};

	IOMUXC_GPIO_EMC_06_FLEXIO1_FLEXIO06: IOMUXC_GPIO_EMC_06_FLEXIO1_FLEXIO06 {
		pinmux = <0x401F802C 0x4 0 0 0x401F821C>;
	};

	IOMUXC_GPIO_EMC_06_GPIO4_IO06: IOMUXC_GPIO_EMC_06_GPIO4_IO06 {
		pinmux = <0x401F802C 0x5 0 0 0x401F821C>;
	};

	IOMUXC_GPIO_EMC_07_SEMC_DATA07: IOMUXC_GPIO_EMC_07_SEMC_DATA07 {
		pinmux = <0x401F8030 0x0 0 0 0x401F8220>;
	};

	IOMUXC_GPIO_EMC_07_FLEXPWM2_PWMB00: IOMUXC_GPIO_EMC_07_FLEXPWM2_PWMB00 {
		pinmux = <0x401F8030 0x1 0x401F8488 0x0 0x401F8220>;
	};

	IOMUXC_GPIO_EMC_07_SAI2_MCLK: IOMUXC_GPIO_EMC_07_SAI2_MCLK {
		pinmux = <0x401F8030 0x2 0x401F85B0 0x0 0x401F8220>;
	};

	IOMUXC_GPIO_EMC_07_XBAR1_INOUT09: IOMUXC_GPIO_EMC_07_XBAR1_INOUT09 {
		pinmux = <0x401F8030 0x3 0x401F8628 0x0 0x401F8220>;
	};

	IOMUXC_GPIO_EMC_07_FLEXIO1_FLEXIO07: IOMUXC_GPIO_EMC_07_FLEXIO1_FLEXIO07 {
		pinmux = <0x401F8030 0x4 0 0 0x401F8220>;
	};

	IOMUXC_GPIO_EMC_07_GPIO4_IO07: IOMUXC_GPIO_EMC_07_GPIO4_IO07 {
		pinmux = <0x401F8030 0x5 0 0 0x401F8220>;
	};

	IOMUXC_GPIO_EMC_08_SEMC_DM00: IOMUXC_GPIO_EMC_08_SEMC_DM00 {
		pinmux = <0x401F8034 0x0 0 0 0x401F8224>;
	};

	IOMUXC_GPIO_EMC_08_FLEXPWM2_PWMA01: IOMUXC_GPIO_EMC_08_FLEXPWM2_PWMA01 {
		pinmux = <0x401F8034 0x1 0x401F847C 0x0 0x401F8224>;
	};

	IOMUXC_GPIO_EMC_08_SAI2_RX_DATA: IOMUXC_GPIO_EMC_08_SAI2_RX_DATA {
		pinmux = <0x401F8034 0x2 0x401F85B8 0x0 0x401F8224>;
	};

	IOMUXC_GPIO_EMC_08_XBAR1_INOUT17: IOMUXC_GPIO_EMC_08_XBAR1_INOUT17 {
		pinmux = <0x401F8034 0x3 0x401F862C 0x0 0x401F8224>;
	};

	IOMUXC_GPIO_EMC_08_FLEXIO1_FLEXIO08: IOMUXC_GPIO_EMC_08_FLEXIO1_FLEXIO08 {
		pinmux = <0x401F8034 0x4 0 0 0x401F8224>;
	};

	IOMUXC_GPIO_EMC_08_GPIO4_IO08: IOMUXC_GPIO_EMC_08_GPIO4_IO08 {
		pinmux = <0x401F8034 0x5 0 0 0x401F8224>;
	};

	IOMUXC_GPIO_EMC_09_SEMC_ADDR00: IOMUXC_GPIO_EMC_09_SEMC_ADDR00 {
		pinmux = <0x401F8038 0x0 0 0 0x401F8228>;
	};

	IOMUXC_GPIO_EMC_09_FLEXPWM2_PWMB01: IOMUXC_GPIO_EMC_09_FLEXPWM2_PWMB01 {
		pinmux = <0x401F8038 0x1 0x401F848C 0x0 0x401F8228>;
	};

	IOMUXC_GPIO_EMC_09_SAI2_RX_SYNC: IOMUXC_GPIO_EMC_09_SAI2_RX_SYNC {
		pinmux = <0x401F8038 0x2 0x401F85BC 0x0 0x401F8228>;
	};

	IOMUXC_GPIO_EMC_09_FLEXCAN2_TX: IOMUXC_GPIO_EMC_09_FLEXCAN2_TX {
		pinmux = <0x401F8038 0x3 0 0 0x401F8228>;
	};

	IOMUXC_GPIO_EMC_09_FLEXIO1_FLEXIO09: IOMUXC_GPIO_EMC_09_FLEXIO1_FLEXIO09 {
		pinmux = <0x401F8038 0x4 0 0 0x401F8228>;
	};

	IOMUXC_GPIO_EMC_09_GPIO4_IO09: IOMUXC_GPIO_EMC_09_GPIO4_IO09 {
		pinmux = <0x401F8038 0x5 0 0 0x401F8228>;
	};

	IOMUXC_GPIO_EMC_09_FLEXSPI2_B_SS1_B: IOMUXC_GPIO_EMC_09_FLEXSPI2_B_SS1_B {
		pinmux = <0x401F8038 0x8 0 0 0x401F8228>;
	};

	IOMUXC_GPIO_EMC_10_SEMC_ADDR01: IOMUXC_GPIO_EMC_10_SEMC_ADDR01 {
		pinmux = <0x401F803C 0x0 0 0 0x401F822C>;
	};

	IOMUXC_GPIO_EMC_10_FLEXPWM2_PWMA02: IOMUXC_GPIO_EMC_10_FLEXPWM2_PWMA02 {
		pinmux = <0x401F803C 0x1 0x401F8480 0x0 0x401F822C>;
	};

	IOMUXC_GPIO_EMC_10_SAI2_RX_BCLK: IOMUXC_GPIO_EMC_10_SAI2_RX_BCLK {
		pinmux = <0x401F803C 0x2 0x401F85B4 0x0 0x401F822C>;
	};

	IOMUXC_GPIO_EMC_10_FLEXCAN2_RX: IOMUXC_GPIO_EMC_10_FLEXCAN2_RX {
		pinmux = <0x401F803C 0x3 0x401F8450 0x0 0x401F822C>;
	};

	IOMUXC_GPIO_EMC_10_FLEXIO1_FLEXIO10: IOMUXC_GPIO_EMC_10_FLEXIO1_FLEXIO10 {
		pinmux = <0x401F803C 0x4 0 0 0x401F822C>;
	};

	IOMUXC_GPIO_EMC_10_GPIO4_IO10: IOMUXC_GPIO_EMC_10_GPIO4_IO10 {
		pinmux = <0x401F803C 0x5 0 0 0x401F822C>;
	};

	IOMUXC_GPIO_EMC_10_FLEXSPI2_B_SS0_B: IOMUXC_GPIO_EMC_10_FLEXSPI2_B_SS0_B {
		pinmux = <0x401F803C 0x8 0 0 0x401F822C>;
	};

	IOMUXC_GPIO_EMC_11_SEMC_ADDR02: IOMUXC_GPIO_EMC_11_SEMC_ADDR02 {
		pinmux = <0x401F8040 0x0 0 0 0x401F8230>;
	};

	IOMUXC_GPIO_EMC_11_FLEXPWM2_PWMB02: IOMUXC_GPIO_EMC_11_FLEXPWM2_PWMB02 {
		pinmux = <0x401F8040 0x1 0x401F8490 0x0 0x401F8230>;
	};

	IOMUXC_GPIO_EMC_11_LPI2C4_SDA: IOMUXC_GPIO_EMC_11_LPI2C4_SDA {
		pinmux = <0x401F8040 0x2 0x401F84E8 0x0 0x401F8230>;
	};

	IOMUXC_GPIO_EMC_11_USDHC2_RESET_B: IOMUXC_GPIO_EMC_11_USDHC2_RESET_B {
		pinmux = <0x401F8040 0x3 0 0 0x401F8230>;
	};

	IOMUXC_GPIO_EMC_11_FLEXIO1_FLEXIO11: IOMUXC_GPIO_EMC_11_FLEXIO1_FLEXIO11 {
		pinmux = <0x401F8040 0x4 0 0 0x401F8230>;
	};

	IOMUXC_GPIO_EMC_11_GPIO4_IO11: IOMUXC_GPIO_EMC_11_GPIO4_IO11 {
		pinmux = <0x401F8040 0x5 0 0 0x401F8230>;
	};

	IOMUXC_GPIO_EMC_11_FLEXSPI2_B_DQS: IOMUXC_GPIO_EMC_11_FLEXSPI2_B_DQS {
		pinmux = <0x401F8040 0x8 0 0 0x401F8230>;
	};

	IOMUXC_GPIO_EMC_12_SEMC_ADDR03: IOMUXC_GPIO_EMC_12_SEMC_ADDR03 {
		pinmux = <0x401F8044 0x0 0 0 0x401F8234>;
	};

	IOMUXC_GPIO_EMC_12_XBAR1_IN24: IOMUXC_GPIO_EMC_12_XBAR1_IN24 {
		pinmux = <0x401F8044 0x1 0x401F8640 0x0 0x401F8234>;
	};

	IOMUXC_GPIO_EMC_12_LPI2C4_SCL: IOMUXC_GPIO_EMC_12_LPI2C4_SCL {
		pinmux = <0x401F8044 0x2 0x401F84E4 0x0 0x401F8234>;
	};

	IOMUXC_GPIO_EMC_12_USDHC1_WP: IOMUXC_GPIO_EMC_12_USDHC1_WP {
		pinmux = <0x401F8044 0x3 0x401F85D8 0x0 0x401F8234>;
	};

	IOMUXC_GPIO_EMC_12_FLEXPWM1_PWMA03: IOMUXC_GPIO_EMC_12_FLEXPWM1_PWMA03 {
		pinmux = <0x401F8044 0x4 0x401F8454 0x1 0x401F8234>;
	};

	IOMUXC_GPIO_EMC_12_GPIO4_IO12: IOMUXC_GPIO_EMC_12_GPIO4_IO12 {
		pinmux = <0x401F8044 0x5 0 0 0x401F8234>;
	};

	IOMUXC_GPIO_EMC_12_FLEXSPI2_B_SCLK: IOMUXC_GPIO_EMC_12_FLEXSPI2_B_SCLK {
		pinmux = <0x401F8044 0x8 0x401F8754 0x0 0x401F8234>;
	};

	IOMUXC_GPIO_EMC_13_SEMC_ADDR04: IOMUXC_GPIO_EMC_13_SEMC_ADDR04 {
		pinmux = <0x401F8048 0x0 0 0 0x401F8238>;
	};

	IOMUXC_GPIO_EMC_13_XBAR1_IN25: IOMUXC_GPIO_EMC_13_XBAR1_IN25 {
		pinmux = <0x401F8048 0x1 0x401F8650 0x1 0x401F8238>;
	};

	IOMUXC_GPIO_EMC_13_LPUART3_TX: IOMUXC_GPIO_EMC_13_LPUART3_TX {
		pinmux = <0x401F8048 0x2 0x401F853C 0x1 0x401F8238>;
	};

	IOMUXC_GPIO_EMC_13_MQS_RIGHT: IOMUXC_GPIO_EMC_13_MQS_RIGHT {
		pinmux = <0x401F8048 0x3 0 0 0x401F8238>;
	};

	IOMUXC_GPIO_EMC_13_FLEXPWM1_PWMB03: IOMUXC_GPIO_EMC_13_FLEXPWM1_PWMB03 {
		pinmux = <0x401F8048 0x4 0x401F8464 0x1 0x401F8238>;
	};

	IOMUXC_GPIO_EMC_13_GPIO4_IO13: IOMUXC_GPIO_EMC_13_GPIO4_IO13 {
		pinmux = <0x401F8048 0x5 0 0 0x401F8238>;
	};

	IOMUXC_GPIO_EMC_13_FLEXSPI2_B_DATA00: IOMUXC_GPIO_EMC_13_FLEXSPI2_B_DATA00 {
		pinmux = <0x401F8048 0x8 0x401F8740 0x0 0x401F8238>;
	};

	IOMUXC_GPIO_EMC_14_SEMC_ADDR05: IOMUXC_GPIO_EMC_14_SEMC_ADDR05 {
		pinmux = <0x401F804C 0x0 0 0 0x401F823C>;
	};

	IOMUXC_GPIO_EMC_14_XBAR1_INOUT19: IOMUXC_GPIO_EMC_14_XBAR1_INOUT19 {
		pinmux = <0x401F804C 0x1 0x401F8654 0x0 0x401F823C>;
	};

	IOMUXC_GPIO_EMC_14_LPUART3_RX: IOMUXC_GPIO_EMC_14_LPUART3_RX {
		pinmux = <0x401F804C 0x2 0x401F8538 0x1 0x401F823C>;
	};

	IOMUXC_GPIO_EMC_14_MQS_LEFT: IOMUXC_GPIO_EMC_14_MQS_LEFT {
		pinmux = <0x401F804C 0x3 0 0 0x401F823C>;
	};

	IOMUXC_GPIO_EMC_14_LPSPI2_PCS1: IOMUXC_GPIO_EMC_14_LPSPI2_PCS1 {
		pinmux = <0x401F804C 0x4 0 0 0x401F823C>;
	};

	IOMUXC_GPIO_EMC_14_GPIO4_IO14: IOMUXC_GPIO_EMC_14_GPIO4_IO14 {
		pinmux = <0x401F804C 0x5 0 0 0x401F823C>;
	};

	IOMUXC_GPIO_EMC_14_FLEXSPI2_B_DATA01: IOMUXC_GPIO_EMC_14_FLEXSPI2_B_DATA01 {
		pinmux = <0x401F804C 0x8 0x401F8744 0x0 0x401F823C>;
	};

	IOMUXC_GPIO_EMC_15_SEMC_ADDR06: IOMUXC_GPIO_EMC_15_SEMC_ADDR06 {
		pinmux = <0x401F8050 0x0 0 0 0x401F8240>;
	};

	IOMUXC_GPIO_EMC_15_XBAR1_IN20: IOMUXC_GPIO_EMC_15_XBAR1_IN20 {
		pinmux = <0x401F8050 0x1 0x401F8634 0x0 0x401F8240>;
	};

	IOMUXC_GPIO_EMC_15_LPUART3_CTS_B: IOMUXC_GPIO_EMC_15_LPUART3_CTS_B {
		pinmux = <0x401F8050 0x2 0x401F8534 0x0 0x401F8240>;
	};

	IOMUXC_GPIO_EMC_15_SPDIF_OUT: IOMUXC_GPIO_EMC_15_SPDIF_OUT {
		pinmux = <0x401F8050 0x3 0 0 0x401F8240>;
	};

	IOMUXC_GPIO_EMC_15_QTIMER3_TIMER0: IOMUXC_GPIO_EMC_15_QTIMER3_TIMER0 {
		pinmux = <0x401F8050 0x4 0x401F857C 0x0 0x401F8240>;
	};

	IOMUXC_GPIO_EMC_15_GPIO4_IO15: IOMUXC_GPIO_EMC_15_GPIO4_IO15 {
		pinmux = <0x401F8050 0x5 0 0 0x401F8240>;
	};

	IOMUXC_GPIO_EMC_15_FLEXSPI2_B_DATA02: IOMUXC_GPIO_EMC_15_FLEXSPI2_B_DATA02 {
		pinmux = <0x401F8050 0x8 0x401F8748 0x0 0x401F8240>;
	};

	IOMUXC_GPIO_EMC_16_SEMC_ADDR07: IOMUXC_GPIO_EMC_16_SEMC_ADDR07 {
		pinmux = <0x401F8054 0x0 0 0 0x401F8244>;
	};

	IOMUXC_GPIO_EMC_16_XBAR1_IN21: IOMUXC_GPIO_EMC_16_XBAR1_IN21 {
		pinmux = <0x401F8054 0x1 0x401F8658 0x0 0x401F8244>;
	};

	IOMUXC_GPIO_EMC_16_LPUART3_RTS_B: IOMUXC_GPIO_EMC_16_LPUART3_RTS_B {
		pinmux = <0x401F8054 0x2 0 0 0x401F8244>;
	};

	IOMUXC_GPIO_EMC_16_SPDIF_IN: IOMUXC_GPIO_EMC_16_SPDIF_IN {
		pinmux = <0x401F8054 0x3 0x401F85C8 0x1 0x401F8244>;
	};

	IOMUXC_GPIO_EMC_16_QTIMER3_TIMER1: IOMUXC_GPIO_EMC_16_QTIMER3_TIMER1 {
		pinmux = <0x401F8054 0x4 0x401F8580 0x1 0x401F8244>;
	};

	IOMUXC_GPIO_EMC_16_GPIO4_IO16: IOMUXC_GPIO_EMC_16_GPIO4_IO16 {
		pinmux = <0x401F8054 0x5 0 0 0x401F8244>;
	};

	IOMUXC_GPIO_EMC_16_FLEXSPI2_B_DATA03: IOMUXC_GPIO_EMC_16_FLEXSPI2_B_DATA03 {
		pinmux = <0x401F8054 0x8 0x401F874C 0x0 0x401F8244>;
	};

	IOMUXC_GPIO_EMC_17_SEMC_ADDR08: IOMUXC_GPIO_EMC_17_SEMC_ADDR08 {
		pinmux = <0x401F8058 0x0 0 0 0x401F8248>;
	};

	IOMUXC_GPIO_EMC_17_FLEXPWM4_PWMA03: IOMUXC_GPIO_EMC_17_FLEXPWM4_PWMA03 {
		pinmux = <0x401F8058 0x1 0x401F84A0 0x0 0x401F8248>;
	};

	IOMUXC_GPIO_EMC_17_LPUART4_CTS_B: IOMUXC_GPIO_EMC_17_LPUART4_CTS_B {
		pinmux = <0x401F8058 0x2 0 0 0x401F8248>;
	};

	IOMUXC_GPIO_EMC_17_FLEXCAN1_TX: IOMUXC_GPIO_EMC_17_FLEXCAN1_TX {
		pinmux = <0x401F8058 0x3 0 0 0x401F8248>;
	};

	IOMUXC_GPIO_EMC_17_QTIMER3_TIMER2: IOMUXC_GPIO_EMC_17_QTIMER3_TIMER2 {
		pinmux = <0x401F8058 0x4 0x401F8584 0x0 0x401F8248>;
	};

	IOMUXC_GPIO_EMC_17_GPIO4_IO17: IOMUXC_GPIO_EMC_17_GPIO4_IO17 {
		pinmux = <0x401F8058 0x5 0 0 0x401F8248>;
	};

	IOMUXC_GPIO_EMC_18_SEMC_ADDR09: IOMUXC_GPIO_EMC_18_SEMC_ADDR09 {
		pinmux = <0x401F805C 0x0 0 0 0x401F824C>;
	};

	IOMUXC_GPIO_EMC_18_FLEXPWM4_PWMB03: IOMUXC_GPIO_EMC_18_FLEXPWM4_PWMB03 {
		pinmux = <0x401F805C 0x1 0 0 0x401F824C>;
	};

	IOMUXC_GPIO_EMC_18_LPUART4_RTS_B: IOMUXC_GPIO_EMC_18_LPUART4_RTS_B {
		pinmux = <0x401F805C 0x2 0 0 0x401F824C>;
	};

	IOMUXC_GPIO_EMC_18_FLEXCAN1_RX: IOMUXC_GPIO_EMC_18_FLEXCAN1_RX {
		pinmux = <0x401F805C 0x3 0x401F844C 0x1 0x401F824C>;
	};

	IOMUXC_GPIO_EMC_18_QTIMER3_TIMER3: IOMUXC_GPIO_EMC_18_QTIMER3_TIMER3 {
		pinmux = <0x401F805C 0x4 0x401F8588 0x0 0x401F824C>;
	};

	IOMUXC_GPIO_EMC_18_GPIO4_IO18: IOMUXC_GPIO_EMC_18_GPIO4_IO18 {
		pinmux = <0x401F805C 0x5 0 0 0x401F824C>;
	};

	IOMUXC_GPIO_EMC_18_SNVS_VIO_5_CTL: IOMUXC_GPIO_EMC_18_SNVS_VIO_5_CTL {
		pinmux = <0x401F805C 0x6 0 0 0x401F824C>;
	};

	IOMUXC_GPIO_EMC_19_SEMC_ADDR11: IOMUXC_GPIO_EMC_19_SEMC_ADDR11 {
		pinmux = <0x401F8060 0x0 0 0 0x401F8250>;
	};

	IOMUXC_GPIO_EMC_19_FLEXPWM2_PWMA03: IOMUXC_GPIO_EMC_19_FLEXPWM2_PWMA03 {
		pinmux = <0x401F8060 0x1 0x401F8474 0x1 0x401F8250>;
	};

	IOMUXC_GPIO_EMC_19_LPUART4_TX: IOMUXC_GPIO_EMC_19_LPUART4_TX {
		pinmux = <0x401F8060 0x2 0x401F8544 0x1 0x401F8250>;
	};

	IOMUXC_GPIO_EMC_19_ENET_RDATA01: IOMUXC_GPIO_EMC_19_ENET_RDATA01 {
		pinmux = <0x401F8060 0x3 0x401F8438 0x0 0x401F8250>;
	};

	IOMUXC_GPIO_EMC_19_QTIMER2_TIMER0: IOMUXC_GPIO_EMC_19_QTIMER2_TIMER0 {
		pinmux = <0x401F8060 0x4 0x401F856C 0x0 0x401F8250>;
	};

	IOMUXC_GPIO_EMC_19_GPIO4_IO19: IOMUXC_GPIO_EMC_19_GPIO4_IO19 {
		pinmux = <0x401F8060 0x5 0 0 0x401F8250>;
	};

	IOMUXC_GPIO_EMC_19_SNVS_VIO_5: IOMUXC_GPIO_EMC_19_SNVS_VIO_5 {
		pinmux = <0x401F8060 0x6 0 0 0x401F8250>;
	};

	IOMUXC_GPIO_EMC_20_SEMC_ADDR12: IOMUXC_GPIO_EMC_20_SEMC_ADDR12 {
		pinmux = <0x401F8064 0x0 0 0 0x401F8254>;
	};

	IOMUXC_GPIO_EMC_20_FLEXPWM2_PWMB03: IOMUXC_GPIO_EMC_20_FLEXPWM2_PWMB03 {
		pinmux = <0x401F8064 0x1 0x401F8484 0x1 0x401F8254>;
	};

	IOMUXC_GPIO_EMC_20_LPUART4_RX: IOMUXC_GPIO_EMC_20_LPUART4_RX {
		pinmux = <0x401F8064 0x2 0x401F8540 0x1 0x401F8254>;
	};

	IOMUXC_GPIO_EMC_20_ENET_RDATA00: IOMUXC_GPIO_EMC_20_ENET_RDATA00 {
		pinmux = <0x401F8064 0x3 0x401F8434 0x0 0x401F8254>;
	};

	IOMUXC_GPIO_EMC_20_QTIMER2_TIMER1: IOMUXC_GPIO_EMC_20_QTIMER2_TIMER1 {
		pinmux = <0x401F8064 0x4 0x401F8570 0x0 0x401F8254>;
	};

	IOMUXC_GPIO_EMC_20_GPIO4_IO20: IOMUXC_GPIO_EMC_20_GPIO4_IO20 {
		pinmux = <0x401F8064 0x5 0 0 0x401F8254>;
	};

	IOMUXC_GPIO_EMC_21_SEMC_BA0: IOMUXC_GPIO_EMC_21_SEMC_BA0 {
		pinmux = <0x401F8068 0x0 0 0 0x401F8258>;
	};

	IOMUXC_GPIO_EMC_21_FLEXPWM3_PWMA03: IOMUXC_GPIO_EMC_21_FLEXPWM3_PWMA03 {
		pinmux = <0x401F8068 0x1 0 0 0x401F8258>;
	};

	IOMUXC_GPIO_EMC_21_LPI2C3_SDA: IOMUXC_GPIO_EMC_21_LPI2C3_SDA {
		pinmux = <0x401F8068 0x2 0x401F84E0 0x0 0x401F8258>;
	};

	IOMUXC_GPIO_EMC_21_ENET_TDATA01: IOMUXC_GPIO_EMC_21_ENET_TDATA01 {
		pinmux = <0x401F8068 0x3 0 0 0x401F8258>;
	};

	IOMUXC_GPIO_EMC_21_QTIMER2_TIMER2: IOMUXC_GPIO_EMC_21_QTIMER2_TIMER2 {
		pinmux = <0x401F8068 0x4 0x401F8574 0x0 0x401F8258>;
	};

	IOMUXC_GPIO_EMC_21_GPIO4_IO21: IOMUXC_GPIO_EMC_21_GPIO4_IO21 {
		pinmux = <0x401F8068 0x5 0 0 0x401F8258>;
	};

	IOMUXC_GPIO_EMC_22_SEMC_BA1: IOMUXC_GPIO_EMC_22_SEMC_BA1 {
		pinmux = <0x401F806C 0x0 0 0 0x401F825C>;
	};

	IOMUXC_GPIO_EMC_22_FLEXPWM3_PWMB03: IOMUXC_GPIO_EMC_22_FLEXPWM3_PWMB03 {
		pinmux = <0x401F806C 0x1 0 0 0x401F825C>;
	};

	IOMUXC_GPIO_EMC_22_LPI2C3_SCL: IOMUXC_GPIO_EMC_22_LPI2C3_SCL {
		pinmux = <0x401F806C 0x2 0x401F84DC 0x0 0x401F825C>;
	};

	IOMUXC_GPIO_EMC_22_ENET_TDATA00: IOMUXC_GPIO_EMC_22_ENET_TDATA00 {
		pinmux = <0x401F806C 0x3 0 0 0x401F825C>;
	};

	IOMUXC_GPIO_EMC_22_QTIMER2_TIMER3: IOMUXC_GPIO_EMC_22_QTIMER2_TIMER3 {
		pinmux = <0x401F806C 0x4 0x401F8578 0x0 0x401F825C>;
	};

	IOMUXC_GPIO_EMC_22_GPIO4_IO22: IOMUXC_GPIO_EMC_22_GPIO4_IO22 {
		pinmux = <0x401F806C 0x5 0 0 0x401F825C>;
	};

	IOMUXC_GPIO_EMC_22_FLEXSPI2_A_SS1_B: IOMUXC_GPIO_EMC_22_FLEXSPI2_A_SS1_B {
		pinmux = <0x401F806C 0x8 0 0 0x401F825C>;
	};

	IOMUXC_GPIO_EMC_23_SEMC_ADDR10: IOMUXC_GPIO_EMC_23_SEMC_ADDR10 {
		pinmux = <0x401F8070 0x0 0 0 0x401F8260>;
	};

	IOMUXC_GPIO_EMC_23_FLEXPWM1_PWMA00: IOMUXC_GPIO_EMC_23_FLEXPWM1_PWMA00 {
		pinmux = <0x401F8070 0x1 0x401F8458 0x0 0x401F8260>;
	};

	IOMUXC_GPIO_EMC_23_LPUART5_TX: IOMUXC_GPIO_EMC_23_LPUART5_TX {
		pinmux = <0x401F8070 0x2 0x401F854C 0x0 0x401F8260>;
	};

	IOMUXC_GPIO_EMC_23_ENET_RX_EN: IOMUXC_GPIO_EMC_23_ENET_RX_EN {
		pinmux = <0x401F8070 0x3 0x401F843C 0x0 0x401F8260>;
	};

	IOMUXC_GPIO_EMC_23_GPT1_CAPTURE2: IOMUXC_GPIO_EMC_23_GPT1_CAPTURE2 {
		pinmux = <0x401F8070 0x4 0x401F875C 0x0 0x401F8260>;
	};

	IOMUXC_GPIO_EMC_23_GPIO4_IO23: IOMUXC_GPIO_EMC_23_GPIO4_IO23 {
		pinmux = <0x401F8070 0x5 0 0 0x401F8260>;
	};

	IOMUXC_GPIO_EMC_23_FLEXSPI2_A_DQS: IOMUXC_GPIO_EMC_23_FLEXSPI2_A_DQS {
		pinmux = <0x401F8070 0x8 0x401F872C 0x1 0x401F8260>;
	};

	IOMUXC_GPIO_EMC_24_SEMC_CAS: IOMUXC_GPIO_EMC_24_SEMC_CAS {
		pinmux = <0x401F8074 0x0 0 0 0x401F8264>;
	};

	IOMUXC_GPIO_EMC_24_FLEXPWM1_PWMB00: IOMUXC_GPIO_EMC_24_FLEXPWM1_PWMB00 {
		pinmux = <0x401F8074 0x1 0x401F8468 0x0 0x401F8264>;
	};

	IOMUXC_GPIO_EMC_24_LPUART5_RX: IOMUXC_GPIO_EMC_24_LPUART5_RX {
		pinmux = <0x401F8074 0x2 0x401F8548 0x0 0x401F8264>;
	};

	IOMUXC_GPIO_EMC_24_ENET_TX_EN: IOMUXC_GPIO_EMC_24_ENET_TX_EN {
		pinmux = <0x401F8074 0x3 0 0 0x401F8264>;
	};

	IOMUXC_GPIO_EMC_24_GPT1_CAPTURE1: IOMUXC_GPIO_EMC_24_GPT1_CAPTURE1 {
		pinmux = <0x401F8074 0x4 0x401F8758 0x0 0x401F8264>;
	};

	IOMUXC_GPIO_EMC_24_GPIO4_IO24: IOMUXC_GPIO_EMC_24_GPIO4_IO24 {
		pinmux = <0x401F8074 0x5 0 0 0x401F8264>;
	};

	IOMUXC_GPIO_EMC_24_FLEXSPI2_A_SS0_B: IOMUXC_GPIO_EMC_24_FLEXSPI2_A_SS0_B {
		pinmux = <0x401F8074 0x8 0 0 0x401F8264>;
	};

	IOMUXC_GPIO_EMC_25_SEMC_RAS: IOMUXC_GPIO_EMC_25_SEMC_RAS {
		pinmux = <0x401F8078 0x0 0 0 0x401F8268>;
	};

	IOMUXC_GPIO_EMC_25_FLEXPWM1_PWMA01: IOMUXC_GPIO_EMC_25_FLEXPWM1_PWMA01 {
		pinmux = <0x401F8078 0x1 0x401F845C 0x0 0x401F8268>;
	};

	IOMUXC_GPIO_EMC_25_LPUART6_TX: IOMUXC_GPIO_EMC_25_LPUART6_TX {
		pinmux = <0x401F8078 0x2 0x401F8554 0x0 0x401F8268>;
	};

	IOMUXC_GPIO_EMC_25_ENET_TX_CLK: IOMUXC_GPIO_EMC_25_ENET_TX_CLK {
		pinmux = <0x401F8078 0x3 0x401F8448 0x0 0x401F8268>;
	};

	IOMUXC_GPIO_EMC_25_ENET_REF_CLK: IOMUXC_GPIO_EMC_25_ENET_REF_CLK {
		pinmux = <0x401F8078 0x4 0x401F842C 0x0 0x401F8268>;
	};

	IOMUXC_GPIO_EMC_25_GPIO4_IO25: IOMUXC_GPIO_EMC_25_GPIO4_IO25 {
		pinmux = <0x401F8078 0x5 0 0 0x401F8268>;
	};

	IOMUXC_GPIO_EMC_25_FLEXSPI2_A_SCLK: IOMUXC_GPIO_EMC_25_FLEXSPI2_A_SCLK {
		pinmux = <0x401F8078 0x8 0x401F8750 0x1 0x401F8268>;
	};

	IOMUXC_GPIO_EMC_26_SEMC_CLK: IOMUXC_GPIO_EMC_26_SEMC_CLK {
		pinmux = <0x401F807C 0x0 0 0 0x401F826C>;
	};

	IOMUXC_GPIO_EMC_26_FLEXPWM1_PWMB01: IOMUXC_GPIO_EMC_26_FLEXPWM1_PWMB01 {
		pinmux = <0x401F807C 0x1 0x401F846C 0x0 0x401F826C>;
	};

	IOMUXC_GPIO_EMC_26_LPUART6_RX: IOMUXC_GPIO_EMC_26_LPUART6_RX {
		pinmux = <0x401F807C 0x2 0x401F8550 0x0 0x401F826C>;
	};

	IOMUXC_GPIO_EMC_26_ENET_RX_ER: IOMUXC_GPIO_EMC_26_ENET_RX_ER {
		pinmux = <0x401F807C 0x3 0x401F8440 0x0 0x401F826C>;
	};

	IOMUXC_GPIO_EMC_26_FLEXIO1_FLEXIO12: IOMUXC_GPIO_EMC_26_FLEXIO1_FLEXIO12 {
		pinmux = <0x401F807C 0x4 0 0 0x401F826C>;
	};

	IOMUXC_GPIO_EMC_26_GPIO4_IO26: IOMUXC_GPIO_EMC_26_GPIO4_IO26 {
		pinmux = <0x401F807C 0x5 0 0 0x401F826C>;
	};

	IOMUXC_GPIO_EMC_26_FLEXSPI2_A_DATA00: IOMUXC_GPIO_EMC_26_FLEXSPI2_A_DATA00 {
		pinmux = <0x401F807C 0x8 0x401F8730 0x1 0x401F826C>;
	};

	IOMUXC_GPIO_EMC_27_SEMC_CKE: IOMUXC_GPIO_EMC_27_SEMC_CKE {
		pinmux = <0x401F8080 0x0 0 0 0x401F8270>;
	};

	IOMUXC_GPIO_EMC_27_FLEXPWM1_PWMA02: IOMUXC_GPIO_EMC_27_FLEXPWM1_PWMA02 {
		pinmux = <0x401F8080 0x1 0x401F8460 0x0 0x401F8270>;
	};

	IOMUXC_GPIO_EMC_27_LPUART5_RTS_B: IOMUXC_GPIO_EMC_27_LPUART5_RTS_B {
		pinmux = <0x401F8080 0x2 0 0 0x401F8270>;
	};

	IOMUXC_GPIO_EMC_27_LPSPI1_SCK: IOMUXC_GPIO_EMC_27_LPSPI1_SCK {
		pinmux = <0x401F8080 0x3 0x401F84F0 0x0 0x401F8270>;
	};

	IOMUXC_GPIO_EMC_27_FLEXIO1_FLEXIO13: IOMUXC_GPIO_EMC_27_FLEXIO1_FLEXIO13 {
		pinmux = <0x401F8080 0x4 0 0 0x401F8270>;
	};

	IOMUXC_GPIO_EMC_27_GPIO4_IO27: IOMUXC_GPIO_EMC_27_GPIO4_IO27 {
		pinmux = <0x401F8080 0x5 0 0 0x401F8270>;
	};

	IOMUXC_GPIO_EMC_27_FLEXSPI2_A_DATA01: IOMUXC_GPIO_EMC_27_FLEXSPI2_A_DATA01 {
		pinmux = <0x401F8080 0x8 0x401F8734 0x1 0x401F8270>;
	};

	IOMUXC_GPIO_EMC_28_SEMC_WE: IOMUXC_GPIO_EMC_28_SEMC_WE {
		pinmux = <0x401F8084 0x0 0 0 0x401F8274>;
	};

	IOMUXC_GPIO_EMC_28_FLEXPWM1_PWMB02: IOMUXC_GPIO_EMC_28_FLEXPWM1_PWMB02 {
		pinmux = <0x401F8084 0x1 0x401F8470 0x0 0x401F8274>;
	};

	IOMUXC_GPIO_EMC_28_LPUART5_CTS_B: IOMUXC_GPIO_EMC_28_LPUART5_CTS_B {
		pinmux = <0x401F8084 0x2 0 0 0x401F8274>;
	};

	IOMUXC_GPIO_EMC_28_LPSPI1_SDO: IOMUXC_GPIO_EMC_28_LPSPI1_SDO {
		pinmux = <0x401F8084 0x3 0x401F84F8 0x0 0x401F8274>;
	};

	IOMUXC_GPIO_EMC_28_FLEXIO1_FLEXIO14: IOMUXC_GPIO_EMC_28_FLEXIO1_FLEXIO14 {
		pinmux = <0x401F8084 0x4 0 0 0x401F8274>;
	};

	IOMUXC_GPIO_EMC_28_GPIO4_IO28: IOMUXC_GPIO_EMC_28_GPIO4_IO28 {
		pinmux = <0x401F8084 0x5 0 0 0x401F8274>;
	};

	IOMUXC_GPIO_EMC_28_FLEXSPI2_A_DATA02: IOMUXC_GPIO_EMC_28_FLEXSPI2_A_DATA02 {
		pinmux = <0x401F8084 0x8 0x401F8738 0x1 0x401F8274>;
	};

	IOMUXC_GPIO_EMC_29_SEMC_CS0: IOMUXC_GPIO_EMC_29_SEMC_CS0 {
		pinmux = <0x401F8088 0x0 0 0 0x401F8278>;
	};

	IOMUXC_GPIO_EMC_29_FLEXPWM3_PWMA00: IOMUXC_GPIO_EMC_29_FLEXPWM3_PWMA00 {
		pinmux = <0x401F8088 0x1 0 0 0x401F8278>;
	};

	IOMUXC_GPIO_EMC_29_LPUART6_RTS_B: IOMUXC_GPIO_EMC_29_LPUART6_RTS_B {
		pinmux = <0x401F8088 0x2 0 0 0x401F8278>;
	};

	IOMUXC_GPIO_EMC_29_LPSPI1_SDI: IOMUXC_GPIO_EMC_29_LPSPI1_SDI {
		pinmux = <0x401F8088 0x3 0x401F84F4 0x0 0x401F8278>;
	};

	IOMUXC_GPIO_EMC_29_FLEXIO1_FLEXIO15: IOMUXC_GPIO_EMC_29_FLEXIO1_FLEXIO15 {
		pinmux = <0x401F8088 0x4 0 0 0x401F8278>;
	};

	IOMUXC_GPIO_EMC_29_GPIO4_IO29: IOMUXC_GPIO_EMC_29_GPIO4_IO29 {
		pinmux = <0x401F8088 0x5 0 0 0x401F8278>;
	};

	IOMUXC_GPIO_EMC_29_FLEXSPI2_A_DATA03: IOMUXC_GPIO_EMC_29_FLEXSPI2_A_DATA03 {
		pinmux = <0x401F8088 0x8 0x401F873C 0x1 0x401F8278>;
	};

	IOMUXC_GPIO_EMC_30_SEMC_DATA08: IOMUXC_GPIO_EMC_30_SEMC_DATA08 {
		pinmux = <0x401F808C 0x0 0 0 0x401F827C>;
	};

	IOMUXC_GPIO_EMC_30_FLEXPWM3_PWMB00: IOMUXC_GPIO_EMC_30_FLEXPWM3_PWMB00 {
		pinmux = <0x401F808C 0x1 0 0 0x401F827C>;
	};

	IOMUXC_GPIO_EMC_30_LPUART6_CTS_B: IOMUXC_GPIO_EMC_30_LPUART6_CTS_B {
		pinmux = <0x401F808C 0x2 0 0 0x401F827C>;
	};

	IOMUXC_GPIO_EMC_30_LPSPI1_PCS0: IOMUXC_GPIO_EMC_30_LPSPI1_PCS0 {
		pinmux = <0x401F808C 0x3 0x401F84EC 0x1 0x401F827C>;
	};

	IOMUXC_GPIO_EMC_30_CSI_DATA23: IOMUXC_GPIO_EMC_30_CSI_DATA23 {
		pinmux = <0x401F808C 0x4 0 0 0x401F827C>;
	};

	IOMUXC_GPIO_EMC_30_GPIO4_IO30: IOMUXC_GPIO_EMC_30_GPIO4_IO30 {
		pinmux = <0x401F808C 0x5 0 0 0x401F827C>;
	};

	IOMUXC_GPIO_EMC_30_ENET2_TDATA00: IOMUXC_GPIO_EMC_30_ENET2_TDATA00 {
		pinmux = <0x401F808C 0x8 0 0 0x401F827C>;
	};

	IOMUXC_GPIO_EMC_31_SEMC_DATA09: IOMUXC_GPIO_EMC_31_SEMC_DATA09 {
		pinmux = <0x401F8090 0x0 0 0 0x401F8280>;
	};

	IOMUXC_GPIO_EMC_31_FLEXPWM3_PWMA01: IOMUXC_GPIO_EMC_31_FLEXPWM3_PWMA01 {
		pinmux = <0x401F8090 0x1 0 0 0x401F8280>;
	};

	IOMUXC_GPIO_EMC_31_LPUART7_TX: IOMUXC_GPIO_EMC_31_LPUART7_TX {
		pinmux = <0x401F8090 0x2 0x401F855C 0x1 0x401F8280>;
	};

	IOMUXC_GPIO_EMC_31_LPSPI1_PCS1: IOMUXC_GPIO_EMC_31_LPSPI1_PCS1 {
		pinmux = <0x401F8090 0x3 0 0 0x401F8280>;
	};

	IOMUXC_GPIO_EMC_31_CSI_DATA22: IOMUXC_GPIO_EMC_31_CSI_DATA22 {
		pinmux = <0x401F8090 0x4 0 0 0x401F8280>;
	};

	IOMUXC_GPIO_EMC_31_GPIO4_IO31: IOMUXC_GPIO_EMC_31_GPIO4_IO31 {
		pinmux = <0x401F8090 0x5 0 0 0x401F8280>;
	};

	IOMUXC_GPIO_EMC_31_ENET2_TDATA01: IOMUXC_GPIO_EMC_31_ENET2_TDATA01 {
		pinmux = <0x401F8090 0x8 0 0 0x401F8280>;
	};

	IOMUXC_GPIO_EMC_32_SEMC_DATA10: IOMUXC_GPIO_EMC_32_SEMC_DATA10 {
		pinmux = <0x401F8094 0x0 0 0 0x401F8284>;
	};

	IOMUXC_GPIO_EMC_32_FLEXPWM3_PWMB01: IOMUXC_GPIO_EMC_32_FLEXPWM3_PWMB01 {
		pinmux = <0x401F8094 0x1 0 0 0x401F8284>;
	};

	IOMUXC_GPIO_EMC_32_LPUART7_RX: IOMUXC_GPIO_EMC_32_LPUART7_RX {
		pinmux = <0x401F8094 0x2 0x401F8558 0x1 0x401F8284>;
	};

	IOMUXC_GPIO_EMC_32_CCM_PMIC_RDY: IOMUXC_GPIO_EMC_32_CCM_PMIC_RDY {
		pinmux = <0x401F8094 0x3 0x401F83FC 0x4 0x401F8284>;
	};

	IOMUXC_GPIO_EMC_32_CSI_DATA21: IOMUXC_GPIO_EMC_32_CSI_DATA21 {
		pinmux = <0x401F8094 0x4 0 0 0x401F8284>;
	};

	IOMUXC_GPIO_EMC_32_GPIO3_IO18: IOMUXC_GPIO_EMC_32_GPIO3_IO18 {
		pinmux = <0x401F8094 0x5 0 0 0x401F8284>;
	};

	IOMUXC_GPIO_EMC_32_ENET2_TX_EN: IOMUXC_GPIO_EMC_32_ENET2_TX_EN {
		pinmux = <0x401F8094 0x8 0 0 0x401F8284>;
	};

	IOMUXC_GPIO_EMC_33_SEMC_DATA11: IOMUXC_GPIO_EMC_33_SEMC_DATA11 {
		pinmux = <0x401F8098 0x0 0 0 0x401F8288>;
	};

	IOMUXC_GPIO_EMC_33_FLEXPWM3_PWMA02: IOMUXC_GPIO_EMC_33_FLEXPWM3_PWMA02 {
		pinmux = <0x401F8098 0x1 0 0 0x401F8288>;
	};

	IOMUXC_GPIO_EMC_33_USDHC1_RESET_B: IOMUXC_GPIO_EMC_33_USDHC1_RESET_B {
		pinmux = <0x401F8098 0x2 0 0 0x401F8288>;
	};

	IOMUXC_GPIO_EMC_33_SAI3_RX_DATA: IOMUXC_GPIO_EMC_33_SAI3_RX_DATA {
		pinmux = <0x401F8098 0x3 0x401F8778 0x0 0x401F8288>;
	};

	IOMUXC_GPIO_EMC_33_CSI_DATA20: IOMUXC_GPIO_EMC_33_CSI_DATA20 {
		pinmux = <0x401F8098 0x4 0 0 0x401F8288>;
	};

	IOMUXC_GPIO_EMC_33_GPIO3_IO19: IOMUXC_GPIO_EMC_33_GPIO3_IO19 {
		pinmux = <0x401F8098 0x5 0 0 0x401F8288>;
	};

	IOMUXC_GPIO_EMC_33_ENET2_TX_CLK: IOMUXC_GPIO_EMC_33_ENET2_TX_CLK {
		pinmux = <0x401F8098 0x8 0x401F8728 0x0 0x401F8288>;
	};

	IOMUXC_GPIO_EMC_33_ENET2_REF_CLK2: IOMUXC_GPIO_EMC_33_ENET2_REF_CLK2 {
		pinmux = <0x401F8098 0x9 0x401F870C 0x0 0x401F8288>;
	};

	IOMUXC_GPIO_EMC_34_SEMC_DATA12: IOMUXC_GPIO_EMC_34_SEMC_DATA12 {
		pinmux = <0x401F809C 0x0 0 0 0x401F828C>;
	};

	IOMUXC_GPIO_EMC_34_FLEXPWM3_PWMB02: IOMUXC_GPIO_EMC_34_FLEXPWM3_PWMB02 {
		pinmux = <0x401F809C 0x1 0 0 0x401F828C>;
	};

	IOMUXC_GPIO_EMC_34_USDHC1_VSELECT: IOMUXC_GPIO_EMC_34_USDHC1_VSELECT {
		pinmux = <0x401F809C 0x2 0 0 0x401F828C>;
	};

	IOMUXC_GPIO_EMC_34_SAI3_RX_SYNC: IOMUXC_GPIO_EMC_34_SAI3_RX_SYNC {
		pinmux = <0x401F809C 0x3 0x401F877C 0x0 0x401F828C>;
	};

	IOMUXC_GPIO_EMC_34_CSI_DATA19: IOMUXC_GPIO_EMC_34_CSI_DATA19 {
		pinmux = <0x401F809C 0x4 0 0 0x401F828C>;
	};

	IOMUXC_GPIO_EMC_34_GPIO3_IO20: IOMUXC_GPIO_EMC_34_GPIO3_IO20 {
		pinmux = <0x401F809C 0x5 0 0 0x401F828C>;
	};

	IOMUXC_GPIO_EMC_34_ENET2_RX_ER: IOMUXC_GPIO_EMC_34_ENET2_RX_ER {
		pinmux = <0x401F809C 0x8 0x401F8720 0x0 0x401F828C>;
	};

	IOMUXC_GPIO_EMC_35_SEMC_DATA13: IOMUXC_GPIO_EMC_35_SEMC_DATA13 {
		pinmux = <0x401F80A0 0x0 0 0 0x401F8290>;
	};

	IOMUXC_GPIO_EMC_35_XBAR1_INOUT18: IOMUXC_GPIO_EMC_35_XBAR1_INOUT18 {
		pinmux = <0x401F80A0 0x1 0x401F8630 0x0 0x401F8290>;
	};

	IOMUXC_GPIO_EMC_35_GPT1_COMPARE1: IOMUXC_GPIO_EMC_35_GPT1_COMPARE1 {
		pinmux = <0x401F80A0 0x2 0 0 0x401F8290>;
	};

	IOMUXC_GPIO_EMC_35_SAI3_RX_BCLK: IOMUXC_GPIO_EMC_35_SAI3_RX_BCLK {
		pinmux = <0x401F80A0 0x3 0x401F8774 0x0 0x401F8290>;
	};

	IOMUXC_GPIO_EMC_35_CSI_DATA18: IOMUXC_GPIO_EMC_35_CSI_DATA18 {
		pinmux = <0x401F80A0 0x4 0 0 0x401F8290>;
	};

	IOMUXC_GPIO_EMC_35_GPIO3_IO21: IOMUXC_GPIO_EMC_35_GPIO3_IO21 {
		pinmux = <0x401F80A0 0x5 0 0 0x401F8290>;
	};

	IOMUXC_GPIO_EMC_35_USDHC1_CD_B: IOMUXC_GPIO_EMC_35_USDHC1_CD_B {
		pinmux = <0x401F80A0 0x6 0x401F85D4 0x0 0x401F8290>;
	};

	IOMUXC_GPIO_EMC_35_ENET2_RDATA00: IOMUXC_GPIO_EMC_35_ENET2_RDATA00 {
		pinmux = <0x401F80A0 0x8 0x401F8714 0x0 0x401F8290>;
	};

	IOMUXC_GPIO_EMC_36_SEMC_DATA14: IOMUXC_GPIO_EMC_36_SEMC_DATA14 {
		pinmux = <0x401F80A4 0x0 0 0 0x401F8294>;
	};

	IOMUXC_GPIO_EMC_36_XBAR1_IN22: IOMUXC_GPIO_EMC_36_XBAR1_IN22 {
		pinmux = <0x401F80A4 0x1 0x401F8638 0x0 0x401F8294>;
	};

	IOMUXC_GPIO_EMC_36_GPT1_COMPARE2: IOMUXC_GPIO_EMC_36_GPT1_COMPARE2 {
		pinmux = <0x401F80A4 0x2 0 0 0x401F8294>;
	};

	IOMUXC_GPIO_EMC_36_SAI3_TX_DATA: IOMUXC_GPIO_EMC_36_SAI3_TX_DATA {
		pinmux = <0x401F80A4 0x3 0 0 0x401F8294>;
	};

	IOMUXC_GPIO_EMC_36_CSI_DATA17: IOMUXC_GPIO_EMC_36_CSI_DATA17 {
		pinmux = <0x401F80A4 0x4 0 0 0x401F8294>;
	};

	IOMUXC_GPIO_EMC_36_GPIO3_IO22: IOMUXC_GPIO_EMC_36_GPIO3_IO22 {
		pinmux = <0x401F80A4 0x5 0 0 0x401F8294>;
	};

	IOMUXC_GPIO_EMC_36_USDHC1_WP: IOMUXC_GPIO_EMC_36_USDHC1_WP {
		pinmux = <0x401F80A4 0x6 0x401F85D8 0x1 0x401F8294>;
	};

	IOMUXC_GPIO_EMC_36_ENET2_RDATA01: IOMUXC_GPIO_EMC_36_ENET2_RDATA01 {
		pinmux = <0x401F80A4 0x8 0x401F8718 0x0 0x401F8294>;
	};

	IOMUXC_GPIO_EMC_36_FLEXCAN3_TX: IOMUXC_GPIO_EMC_36_FLEXCAN3_TX {
		pinmux = <0x401F80A4 0x9 0 0 0x401F8294>;
	};

	IOMUXC_GPIO_EMC_37_SEMC_DATA15: IOMUXC_GPIO_EMC_37_SEMC_DATA15 {
		pinmux = <0x401F80A8 0x0 0 0 0x401F8298>;
	};

	IOMUXC_GPIO_EMC_37_XBAR1_IN23: IOMUXC_GPIO_EMC_37_XBAR1_IN23 {
		pinmux = <0x401F80A8 0x1 0x401F863C 0x0 0x401F8298>;
	};

	IOMUXC_GPIO_EMC_37_GPT1_COMPARE3: IOMUXC_GPIO_EMC_37_GPT1_COMPARE3 {
		pinmux = <0x401F80A8 0x2 0 0 0x401F8298>;
	};

	IOMUXC_GPIO_EMC_37_SAI3_MCLK: IOMUXC_GPIO_EMC_37_SAI3_MCLK {
		pinmux = <0x401F80A8 0x3 0x401F8770 0x0 0x401F8298>;
	};

	IOMUXC_GPIO_EMC_37_CSI_DATA16: IOMUXC_GPIO_EMC_37_CSI_DATA16 {
		pinmux = <0x401F80A8 0x4 0 0 0x401F8298>;
	};

	IOMUXC_GPIO_EMC_37_GPIO3_IO23: IOMUXC_GPIO_EMC_37_GPIO3_IO23 {
		pinmux = <0x401F80A8 0x5 0 0 0x401F8298>;
	};

	IOMUXC_GPIO_EMC_37_USDHC2_WP: IOMUXC_GPIO_EMC_37_USDHC2_WP {
		pinmux = <0x401F80A8 0x6 0x401F8608 0x0 0x401F8298>;
	};

	IOMUXC_GPIO_EMC_37_ENET2_RX_EN: IOMUXC_GPIO_EMC_37_ENET2_RX_EN {
		pinmux = <0x401F80A8 0x8 0x401F871C 0x0 0x401F8298>;
	};

	IOMUXC_GPIO_EMC_37_FLEXCAN3_RX: IOMUXC_GPIO_EMC_37_FLEXCAN3_RX {
		pinmux = <0x401F80A8 0x9 0x401F878C 0x0 0x401F8298>;
	};

	IOMUXC_GPIO_EMC_38_SEMC_DM01: IOMUXC_GPIO_EMC_38_SEMC_DM01 {
		pinmux = <0x401F80AC 0x0 0 0 0x401F829C>;
	};

	IOMUXC_GPIO_EMC_38_FLEXPWM1_PWMA03: IOMUXC_GPIO_EMC_38_FLEXPWM1_PWMA03 {
		pinmux = <0x401F80AC 0x1 0x401F8454 0x2 0x401F829C>;
	};

	IOMUXC_GPIO_EMC_38_LPUART8_TX: IOMUXC_GPIO_EMC_38_LPUART8_TX {
		pinmux = <0x401F80AC 0x2 0x401F8564 0x2 0x401F829C>;
	};

	IOMUXC_GPIO_EMC_38_SAI3_TX_BCLK: IOMUXC_GPIO_EMC_38_SAI3_TX_BCLK {
		pinmux = <0x401F80AC 0x3 0x401F8780 0x0 0x401F829C>;
	};

	IOMUXC_GPIO_EMC_38_CSI_FIELD: IOMUXC_GPIO_EMC_38_CSI_FIELD {
		pinmux = <0x401F80AC 0x4 0 0 0x401F829C>;
	};

	IOMUXC_GPIO_EMC_38_GPIO3_IO24: IOMUXC_GPIO_EMC_38_GPIO3_IO24 {
		pinmux = <0x401F80AC 0x5 0 0 0x401F829C>;
	};

	IOMUXC_GPIO_EMC_38_USDHC2_VSELECT: IOMUXC_GPIO_EMC_38_USDHC2_VSELECT {
		pinmux = <0x401F80AC 0x6 0 0 0x401F829C>;
	};

	IOMUXC_GPIO_EMC_38_ENET2_MDC: IOMUXC_GPIO_EMC_38_ENET2_MDC {
		pinmux = <0x401F80AC 0x8 0 0 0x401F829C>;
	};

	IOMUXC_GPIO_EMC_39_SEMC_DQS: IOMUXC_GPIO_EMC_39_SEMC_DQS {
		pinmux = <0x401F80B0 0x0 0 0 0x401F82A0>;
	};

	IOMUXC_GPIO_EMC_39_FLEXPWM1_PWMB03: IOMUXC_GPIO_EMC_39_FLEXPWM1_PWMB03 {
		pinmux = <0x401F80B0 0x1 0x401F8464 0x2 0x401F82A0>;
	};

	IOMUXC_GPIO_EMC_39_LPUART8_RX: IOMUXC_GPIO_EMC_39_LPUART8_RX {
		pinmux = <0x401F80B0 0x2 0x401F8560 0x2 0x401F82A0>;
	};

	IOMUXC_GPIO_EMC_39_SAI3_TX_SYNC: IOMUXC_GPIO_EMC_39_SAI3_TX_SYNC {
		pinmux = <0x401F80B0 0x3 0x401F8784 0x0 0x401F82A0>;
	};

	IOMUXC_GPIO_EMC_39_WDOG1_WDOG_B: IOMUXC_GPIO_EMC_39_WDOG1_WDOG_B {
		pinmux = <0x401F80B0 0x4 0 0 0x401F82A0>;
	};

	IOMUXC_GPIO_EMC_39_GPIO3_IO25: IOMUXC_GPIO_EMC_39_GPIO3_IO25 {
		pinmux = <0x401F80B0 0x5 0 0 0x401F82A0>;
	};

	IOMUXC_GPIO_EMC_39_USDHC2_CD_B: IOMUXC_GPIO_EMC_39_USDHC2_CD_B {
		pinmux = <0x401F80B0 0x6 0x401F85E0 0x1 0x401F82A0>;
	};

	IOMUXC_GPIO_EMC_39_ENET2_MDIO: IOMUXC_GPIO_EMC_39_ENET2_MDIO {
		pinmux = <0x401F80B0 0x8 0x401F8710 0x0 0x401F82A0>;
	};

	IOMUXC_GPIO_EMC_39_SEMC_DQS4: IOMUXC_GPIO_EMC_39_SEMC_DQS4 {
		pinmux = <0x401F80B0 0x9 0x401F8788 0x1 0x401F82A0>;
	};

	IOMUXC_GPIO_EMC_40_SEMC_RDY: IOMUXC_GPIO_EMC_40_SEMC_RDY {
		pinmux = <0x401F80B4 0x0 0 0 0x401F82A4>;
	};

	IOMUXC_GPIO_EMC_40_GPT2_CAPTURE2: IOMUXC_GPIO_EMC_40_GPT2_CAPTURE2 {
		pinmux = <0x401F80B4 0x1 0x401F8768 0x0 0x401F82A4>;
	};

	IOMUXC_GPIO_EMC_40_LPSPI1_PCS2: IOMUXC_GPIO_EMC_40_LPSPI1_PCS2 {
		pinmux = <0x401F80B4 0x2 0 0 0x401F82A4>;
	};

	IOMUXC_GPIO_EMC_40_USB_OTG2_OC: IOMUXC_GPIO_EMC_40_USB_OTG2_OC {
		pinmux = <0x401F80B4 0x3 0x401F85CC 0x1 0x401F82A4>;
	};

	IOMUXC_GPIO_EMC_40_ENET_MDC: IOMUXC_GPIO_EMC_40_ENET_MDC {
		pinmux = <0x401F80B4 0x4 0 0 0x401F82A4>;
	};

	IOMUXC_GPIO_EMC_40_GPIO3_IO26: IOMUXC_GPIO_EMC_40_GPIO3_IO26 {
		pinmux = <0x401F80B4 0x5 0 0 0x401F82A4>;
	};

	IOMUXC_GPIO_EMC_40_USDHC2_RESET_B: IOMUXC_GPIO_EMC_40_USDHC2_RESET_B {
		pinmux = <0x401F80B4 0x6 0 0 0x401F82A4>;
	};

	IOMUXC_GPIO_EMC_40_SEMC_CLK5: IOMUXC_GPIO_EMC_40_SEMC_CLK5 {
		pinmux = <0x401F80B4 0x9 0 0 0x401F82A4>;
	};

	IOMUXC_GPIO_EMC_41_SEMC_CSX00: IOMUXC_GPIO_EMC_41_SEMC_CSX00 {
		pinmux = <0x401F80B8 0x0 0 0 0x401F82A8>;
	};

	IOMUXC_GPIO_EMC_41_GPT2_CAPTURE1: IOMUXC_GPIO_EMC_41_GPT2_CAPTURE1 {
		pinmux = <0x401F80B8 0x1 0x401F8764 0x0 0x401F82A8>;
	};

	IOMUXC_GPIO_EMC_41_LPSPI1_PCS3: IOMUXC_GPIO_EMC_41_LPSPI1_PCS3 {
		pinmux = <0x401F80B8 0x2 0 0 0x401F82A8>;
	};

	IOMUXC_GPIO_EMC_41_USB_OTG2_PWR: IOMUXC_GPIO_EMC_41_USB_OTG2_PWR {
		pinmux = <0x401F80B8 0x3 0 0 0x401F82A8>;
	};

	IOMUXC_GPIO_EMC_41_ENET_MDIO: IOMUXC_GPIO_EMC_41_ENET_MDIO {
		pinmux = <0x401F80B8 0x4 0x401F8430 0x1 0x401F82A8>;
	};

	IOMUXC_GPIO_EMC_41_GPIO3_IO27: IOMUXC_GPIO_EMC_41_GPIO3_IO27 {
		pinmux = <0x401F80B8 0x5 0 0 0x401F82A8>;
	};

	IOMUXC_GPIO_EMC_41_USDHC1_VSELECT: IOMUXC_GPIO_EMC_41_USDHC1_VSELECT {
		pinmux = <0x401F80B8 0x6 0 0 0x401F82A8>;
	};

	IOMUXC_GPIO_AD_B0_00_FLEXPWM2_PWMA03: IOMUXC_GPIO_AD_B0_00_FLEXPWM2_PWMA03 {
		pinmux = <0x401F80BC 0x0 0x401F8474 0x2 0x401F82AC>;
	};

	IOMUXC_GPIO_AD_B0_00_XBAR1_INOUT14: IOMUXC_GPIO_AD_B0_00_XBAR1_INOUT14 {
		pinmux = <0x401F80BC 0x1 0x401F8644 0x0 0x401F82AC>;
	};

	IOMUXC_GPIO_AD_B0_00_REF_CLK_32K: IOMUXC_GPIO_AD_B0_00_REF_CLK_32K {
		pinmux = <0x401F80BC 0x2 0 0 0x401F82AC>;
	};

	IOMUXC_GPIO_AD_B0_00_USB_OTG2_ID: IOMUXC_GPIO_AD_B0_00_USB_OTG2_ID {
		pinmux = <0x401F80BC 0x3 0x401F83F8 0x0 0x401F82AC>;
	};

	IOMUXC_GPIO_AD_B0_00_LPI2C1_SCLS: IOMUXC_GPIO_AD_B0_00_LPI2C1_SCLS {
		pinmux = <0x401F80BC 0x4 0 0 0x401F82AC>;
	};

	IOMUXC_GPIO_AD_B0_00_GPIO1_IO00: IOMUXC_GPIO_AD_B0_00_GPIO1_IO00 {
		pinmux = <0x401F80BC 0x5 0 0 0x401F82AC>;
	};

	IOMUXC_GPIO_AD_B0_00_USDHC1_RESET_B: IOMUXC_GPIO_AD_B0_00_USDHC1_RESET_B {
		pinmux = <0x401F80BC 0x6 0 0 0x401F82AC>;
	};

	IOMUXC_GPIO_AD_B0_00_LPSPI3_SCK: IOMUXC_GPIO_AD_B0_00_LPSPI3_SCK {
		pinmux = <0x401F80BC 0x7 0x401F8510 0x0 0x401F82AC>;
	};

	IOMUXC_GPIO_AD_B0_01_FLEXPWM2_PWMB03: IOMUXC_GPIO_AD_B0_01_FLEXPWM2_PWMB03 {
		pinmux = <0x401F80C0 0x0 0x401F8484 0x2 0x401F82B0>;
	};

	IOMUXC_GPIO_AD_B0_01_XBAR1_INOUT15: IOMUXC_GPIO_AD_B0_01_XBAR1_INOUT15 {
		pinmux = <0x401F80C0 0x1 0x401F8648 0x0 0x401F82B0>;
	};

	IOMUXC_GPIO_AD_B0_01_REF_CLK_24M: IOMUXC_GPIO_AD_B0_01_REF_CLK_24M {
		pinmux = <0x401F80C0 0x2 0 0 0x401F82B0>;
	};

	IOMUXC_GPIO_AD_B0_01_USB_OTG1_ID: IOMUXC_GPIO_AD_B0_01_USB_OTG1_ID {
		pinmux = <0x401F80C0 0x3 0x401F83F4 0x0 0x401F82B0>;
	};

	IOMUXC_GPIO_AD_B0_01_LPI2C1_SDAS: IOMUXC_GPIO_AD_B0_01_LPI2C1_SDAS {
		pinmux = <0x401F80C0 0x4 0 0 0x401F82B0>;
	};

	IOMUXC_GPIO_AD_B0_01_GPIO1_IO01: IOMUXC_GPIO_AD_B0_01_GPIO1_IO01 {
		pinmux = <0x401F80C0 0x5 0 0 0x401F82B0>;
	};

	IOMUXC_GPIO_AD_B0_01_EWM_OUT_B: IOMUXC_GPIO_AD_B0_01_EWM_OUT_B {
		pinmux = <0x401F80C0 0x6 0 0 0x401F82B0>;
	};

	IOMUXC_GPIO_AD_B0_01_LPSPI3_SDO: IOMUXC_GPIO_AD_B0_01_LPSPI3_SDO {
		pinmux = <0x401F80C0 0x7 0x401F8518 0x0 0x401F82B0>;
	};

	IOMUXC_GPIO_AD_B0_02_FLEXCAN2_TX: IOMUXC_GPIO_AD_B0_02_FLEXCAN2_TX {
		pinmux = <0x401F80C4 0x0 0 0 0x401F82B4>;
	};

	IOMUXC_GPIO_AD_B0_02_XBAR1_INOUT16: IOMUXC_GPIO_AD_B0_02_XBAR1_INOUT16 {
		pinmux = <0x401F80C4 0x1 0x401F864C 0x0 0x401F82B4>;
	};

	IOMUXC_GPIO_AD_B0_02_LPUART6_TX: IOMUXC_GPIO_AD_B0_02_LPUART6_TX {
		pinmux = <0x401F80C4 0x2 0x401F8554 0x1 0x401F82B4>;
	};

	IOMUXC_GPIO_AD_B0_02_USB_OTG1_PWR: IOMUXC_GPIO_AD_B0_02_USB_OTG1_PWR {
		pinmux = <0x401F80C4 0x3 0 0 0x401F82B4>;
	};

	IOMUXC_GPIO_AD_B0_02_FLEXPWM1_PWMX00: IOMUXC_GPIO_AD_B0_02_FLEXPWM1_PWMX00 {
		pinmux = <0x401F80C4 0x4 0 0 0x401F82B4>;
	};

	IOMUXC_GPIO_AD_B0_02_GPIO1_IO02: IOMUXC_GPIO_AD_B0_02_GPIO1_IO02 {
		pinmux = <0x401F80C4 0x5 0 0 0x401F82B4>;
	};

	IOMUXC_GPIO_AD_B0_02_LPI2C1_HREQ: IOMUXC_GPIO_AD_B0_02_LPI2C1_HREQ {
		pinmux = <0x401F80C4 0x6 0 0 0x401F82B4>;
	};

	IOMUXC_GPIO_AD_B0_02_LPSPI3_SDI: IOMUXC_GPIO_AD_B0_02_LPSPI3_SDI {
		pinmux = <0x401F80C4 0x7 0x401F8514 0x0 0x401F82B4>;
	};

	IOMUXC_GPIO_AD_B0_03_FLEXCAN2_RX: IOMUXC_GPIO_AD_B0_03_FLEXCAN2_RX {
		pinmux = <0x401F80C8 0x0 0x401F8450 0x1 0x401F82B8>;
	};

	IOMUXC_GPIO_AD_B0_03_XBAR1_INOUT17: IOMUXC_GPIO_AD_B0_03_XBAR1_INOUT17 {
		pinmux = <0x401F80C8 0x1 0x401F862C 0x1 0x401F82B8>;
	};

	IOMUXC_GPIO_AD_B0_03_LPUART6_RX: IOMUXC_GPIO_AD_B0_03_LPUART6_RX {
		pinmux = <0x401F80C8 0x2 0x401F8550 0x1 0x401F82B8>;
	};

	IOMUXC_GPIO_AD_B0_03_USB_OTG1_OC: IOMUXC_GPIO_AD_B0_03_USB_OTG1_OC {
		pinmux = <0x401F80C8 0x3 0x401F85D0 0x0 0x401F82B8>;
	};

	IOMUXC_GPIO_AD_B0_03_FLEXPWM1_PWMX01: IOMUXC_GPIO_AD_B0_03_FLEXPWM1_PWMX01 {
		pinmux = <0x401F80C8 0x4 0 0 0x401F82B8>;
	};

	IOMUXC_GPIO_AD_B0_03_GPIO1_IO03: IOMUXC_GPIO_AD_B0_03_GPIO1_IO03 {
		pinmux = <0x401F80C8 0x5 0 0 0x401F82B8>;
	};

	IOMUXC_GPIO_AD_B0_03_REF_CLK_24M: IOMUXC_GPIO_AD_B0_03_REF_CLK_24M {
		pinmux = <0x401F80C8 0x6 0 0 0x401F82B8>;
	};

	IOMUXC_GPIO_AD_B0_03_LPSPI3_PCS0: IOMUXC_GPIO_AD_B0_03_LPSPI3_PCS0 {
		pinmux = <0x401F80C8 0x7 0x401F850C 0x0 0x401F82B8>;
	};

	IOMUXC_GPIO_AD_B0_04_SRC_BOOT_MODE00: IOMUXC_GPIO_AD_B0_04_SRC_BOOT_MODE00 {
		pinmux = <0x401F80CC 0x0 0 0 0x401F82BC>;
	};

	IOMUXC_GPIO_AD_B0_04_MQS_RIGHT: IOMUXC_GPIO_AD_B0_04_MQS_RIGHT {
		pinmux = <0x401F80CC 0x1 0 0 0x401F82BC>;
	};

	IOMUXC_GPIO_AD_B0_04_ENET_TX_DATA03: IOMUXC_GPIO_AD_B0_04_ENET_TX_DATA03 {
		pinmux = <0x401F80CC 0x2 0 0 0x401F82BC>;
	};

	IOMUXC_GPIO_AD_B0_04_SAI2_TX_SYNC: IOMUXC_GPIO_AD_B0_04_SAI2_TX_SYNC {
		pinmux = <0x401F80CC 0x3 0x401F85C4 0x1 0x401F82BC>;
	};

	IOMUXC_GPIO_AD_B0_04_CSI_DATA09: IOMUXC_GPIO_AD_B0_04_CSI_DATA09 {
		pinmux = <0x401F80CC 0x4 0x401F841C 0x1 0x401F82BC>;
	};

	IOMUXC_GPIO_AD_B0_04_GPIO1_IO04: IOMUXC_GPIO_AD_B0_04_GPIO1_IO04 {
		pinmux = <0x401F80CC 0x5 0 0 0x401F82BC>;
	};

	IOMUXC_GPIO_AD_B0_04_PIT_TRIGGER00: IOMUXC_GPIO_AD_B0_04_PIT_TRIGGER00 {
		pinmux = <0x401F80CC 0x6 0 0 0x401F82BC>;
	};

	IOMUXC_GPIO_AD_B0_04_LPSPI3_PCS1: IOMUXC_GPIO_AD_B0_04_LPSPI3_PCS1 {
		pinmux = <0x401F80CC 0x7 0 0 0x401F82BC>;
	};

	IOMUXC_GPIO_AD_B0_05_SRC_BOOT_MODE01: IOMUXC_GPIO_AD_B0_05_SRC_BOOT_MODE01 {
		pinmux = <0x401F80D0 0x0 0 0 0x401F82C0>;
	};

	IOMUXC_GPIO_AD_B0_05_MQS_LEFT: IOMUXC_GPIO_AD_B0_05_MQS_LEFT {
		pinmux = <0x401F80D0 0x1 0 0 0x401F82C0>;
	};

	IOMUXC_GPIO_AD_B0_05_ENET_TX_DATA02: IOMUXC_GPIO_AD_B0_05_ENET_TX_DATA02 {
		pinmux = <0x401F80D0 0x2 0 0 0x401F82C0>;
	};

	IOMUXC_GPIO_AD_B0_05_SAI2_TX_BCLK: IOMUXC_GPIO_AD_B0_05_SAI2_TX_BCLK {
		pinmux = <0x401F80D0 0x3 0x401F85C0 0x1 0x401F82C0>;
	};

	IOMUXC_GPIO_AD_B0_05_CSI_DATA08: IOMUXC_GPIO_AD_B0_05_CSI_DATA08 {
		pinmux = <0x401F80D0 0x4 0x401F8418 0x1 0x401F82C0>;
	};

	IOMUXC_GPIO_AD_B0_05_GPIO1_IO05: IOMUXC_GPIO_AD_B0_05_GPIO1_IO05 {
		pinmux = <0x401F80D0 0x5 0 0 0x401F82C0>;
	};

	IOMUXC_GPIO_AD_B0_05_XBAR1_INOUT17: IOMUXC_GPIO_AD_B0_05_XBAR1_INOUT17 {
		pinmux = <0x401F80D0 0x6 0x401F862C 0x2 0x401F82C0>;
	};

	IOMUXC_GPIO_AD_B0_05_LPSPI3_PCS2: IOMUXC_GPIO_AD_B0_05_LPSPI3_PCS2 {
		pinmux = <0x401F80D0 0x7 0 0 0x401F82C0>;
	};

	IOMUXC_GPIO_AD_B0_06_JTAG_TMS: IOMUXC_GPIO_AD_B0_06_JTAG_TMS {
		pinmux = <0x401F80D4 0x0 0 0 0x401F82C4>;
	};

	IOMUXC_GPIO_AD_B0_06_GPT2_COMPARE1: IOMUXC_GPIO_AD_B0_06_GPT2_COMPARE1 {
		pinmux = <0x401F80D4 0x1 0 0 0x401F82C4>;
	};

	IOMUXC_GPIO_AD_B0_06_ENET_RX_CLK: IOMUXC_GPIO_AD_B0_06_ENET_RX_CLK {
		pinmux = <0x401F80D4 0x2 0 0 0x401F82C4>;
	};

	IOMUXC_GPIO_AD_B0_06_SAI2_RX_BCLK: IOMUXC_GPIO_AD_B0_06_SAI2_RX_BCLK {
		pinmux = <0x401F80D4 0x3 0x401F85B4 0x1 0x401F82C4>;
	};

	IOMUXC_GPIO_AD_B0_06_CSI_DATA07: IOMUXC_GPIO_AD_B0_06_CSI_DATA07 {
		pinmux = <0x401F80D4 0x4 0x401F8414 0x1 0x401F82C4>;
	};

	IOMUXC_GPIO_AD_B0_06_GPIO1_IO06: IOMUXC_GPIO_AD_B0_06_GPIO1_IO06 {
		pinmux = <0x401F80D4 0x5 0 0 0x401F82C4>;
	};

	IOMUXC_GPIO_AD_B0_06_XBAR1_INOUT18: IOMUXC_GPIO_AD_B0_06_XBAR1_INOUT18 {
		pinmux = <0x401F80D4 0x6 0x401F8630 0x1 0x401F82C4>;
	};

	IOMUXC_GPIO_AD_B0_06_LPSPI3_PCS3: IOMUXC_GPIO_AD_B0_06_LPSPI3_PCS3 {
		pinmux = <0x401F80D4 0x7 0 0 0x401F82C4>;
	};

	IOMUXC_GPIO_AD_B0_07_JTAG_TCK: IOMUXC_GPIO_AD_B0_07_JTAG_TCK {
		pinmux = <0x401F80D8 0x0 0 0 0x401F82C8>;
	};

	IOMUXC_GPIO_AD_B0_07_GPT2_COMPARE2: IOMUXC_GPIO_AD_B0_07_GPT2_COMPARE2 {
		pinmux = <0x401F80D8 0x1 0 0 0x401F82C8>;
	};

	IOMUXC_GPIO_AD_B0_07_ENET_TX_ER: IOMUXC_GPIO_AD_B0_07_ENET_TX_ER {
		pinmux = <0x401F80D8 0x2 0 0 0x401F82C8>;
	};

	IOMUXC_GPIO_AD_B0_07_SAI2_RX_SYNC: IOMUXC_GPIO_AD_B0_07_SAI2_RX_SYNC {
		pinmux = <0x401F80D8 0x3 0x401F85BC 0x1 0x401F82C8>;
	};

	IOMUXC_GPIO_AD_B0_07_CSI_DATA06: IOMUXC_GPIO_AD_B0_07_CSI_DATA06 {
		pinmux = <0x401F80D8 0x4 0x401F8410 0x1 0x401F82C8>;
	};

	IOMUXC_GPIO_AD_B0_07_GPIO1_IO07: IOMUXC_GPIO_AD_B0_07_GPIO1_IO07 {
		pinmux = <0x401F80D8 0x5 0 0 0x401F82C8>;
	};

	IOMUXC_GPIO_AD_B0_07_XBAR1_INOUT19: IOMUXC_GPIO_AD_B0_07_XBAR1_INOUT19 {
		pinmux = <0x401F80D8 0x6 0x401F8654 0x1 0x401F82C8>;
	};

	IOMUXC_GPIO_AD_B0_07_ENET_1588_EVENT3_OUT: IOMUXC_GPIO_AD_B0_07_ENET_1588_EVENT3_OUT {
		pinmux = <0x401F80D8 0x7 0 0 0x401F82C8>;
	};

	IOMUXC_GPIO_AD_B0_08_JTAG_MOD: IOMUXC_GPIO_AD_B0_08_JTAG_MOD {
		pinmux = <0x401F80DC 0x0 0 0 0x401F82CC>;
	};

	IOMUXC_GPIO_AD_B0_08_GPT2_COMPARE3: IOMUXC_GPIO_AD_B0_08_GPT2_COMPARE3 {
		pinmux = <0x401F80DC 0x1 0 0 0x401F82CC>;
	};

	IOMUXC_GPIO_AD_B0_08_ENET_RX_DATA03: IOMUXC_GPIO_AD_B0_08_ENET_RX_DATA03 {
		pinmux = <0x401F80DC 0x2 0 0 0x401F82CC>;
	};

	IOMUXC_GPIO_AD_B0_08_SAI2_RX_DATA: IOMUXC_GPIO_AD_B0_08_SAI2_RX_DATA {
		pinmux = <0x401F80DC 0x3 0x401F85B8 0x1 0x401F82CC>;
	};

	IOMUXC_GPIO_AD_B0_08_CSI_DATA05: IOMUXC_GPIO_AD_B0_08_CSI_DATA05 {
		pinmux = <0x401F80DC 0x4 0x401F840C 0x1 0x401F82CC>;
	};

	IOMUXC_GPIO_AD_B0_08_GPIO1_IO08: IOMUXC_GPIO_AD_B0_08_GPIO1_IO08 {
		pinmux = <0x401F80DC 0x5 0 0 0x401F82CC>;
	};

	IOMUXC_GPIO_AD_B0_08_XBAR1_IN20: IOMUXC_GPIO_AD_B0_08_XBAR1_IN20 {
		pinmux = <0x401F80DC 0x6 0x401F8634 0x1 0x401F82CC>;
	};

	IOMUXC_GPIO_AD_B0_08_ENET_1588_EVENT3_IN: IOMUXC_GPIO_AD_B0_08_ENET_1588_EVENT3_IN {
		pinmux = <0x401F80DC 0x7 0 0 0x401F82CC>;
	};

	IOMUXC_GPIO_AD_B0_09_JTAG_TDI: IOMUXC_GPIO_AD_B0_09_JTAG_TDI {
		pinmux = <0x401F80E0 0x0 0 0 0x401F82D0>;
	};

	IOMUXC_GPIO_AD_B0_09_FLEXPWM2_PWMA03: IOMUXC_GPIO_AD_B0_09_FLEXPWM2_PWMA03 {
		pinmux = <0x401F80E0 0x1 0x401F8474 0x3 0x401F82D0>;
	};

	IOMUXC_GPIO_AD_B0_09_ENET_RX_DATA02: IOMUXC_GPIO_AD_B0_09_ENET_RX_DATA02 {
		pinmux = <0x401F80E0 0x2 0 0 0x401F82D0>;
	};

	IOMUXC_GPIO_AD_B0_09_SAI2_TX_DATA: IOMUXC_GPIO_AD_B0_09_SAI2_TX_DATA {
		pinmux = <0x401F80E0 0x3 0 0 0x401F82D0>;
	};

	IOMUXC_GPIO_AD_B0_09_CSI_DATA04: IOMUXC_GPIO_AD_B0_09_CSI_DATA04 {
		pinmux = <0x401F80E0 0x4 0x401F8408 0x1 0x401F82D0>;
	};

	IOMUXC_GPIO_AD_B0_09_GPIO1_IO09: IOMUXC_GPIO_AD_B0_09_GPIO1_IO09 {
		pinmux = <0x401F80E0 0x5 0 0 0x401F82D0>;
	};

	IOMUXC_GPIO_AD_B0_09_XBAR1_IN21: IOMUXC_GPIO_AD_B0_09_XBAR1_IN21 {
		pinmux = <0x401F80E0 0x6 0x401F8658 0x1 0x401F82D0>;
	};

	IOMUXC_GPIO_AD_B0_09_GPT2_CLK: IOMUXC_GPIO_AD_B0_09_GPT2_CLK {
		pinmux = <0x401F80E0 0x7 0x401F876C 0x0 0x401F82D0>;
	};

	IOMUXC_GPIO_AD_B0_09_SEMC_DQS4: IOMUXC_GPIO_AD_B0_09_SEMC_DQS4 {
		pinmux = <0x401F80E0 0x9 0x401F8788 0x2 0x401F82D0>;
	};

	IOMUXC_GPIO_AD_B0_10_JTAG_TDO: IOMUXC_GPIO_AD_B0_10_JTAG_TDO {
		pinmux = <0x401F80E4 0x0 0 0 0x401F82D4>;
	};

	IOMUXC_GPIO_AD_B0_10_FLEXPWM1_PWMA03: IOMUXC_GPIO_AD_B0_10_FLEXPWM1_PWMA03 {
		pinmux = <0x401F80E4 0x1 0x401F8454 0x3 0x401F82D4>;
	};

	IOMUXC_GPIO_AD_B0_10_ENET_CRS: IOMUXC_GPIO_AD_B0_10_ENET_CRS {
		pinmux = <0x401F80E4 0x2 0 0 0x401F82D4>;
	};

	IOMUXC_GPIO_AD_B0_10_SAI2_MCLK: IOMUXC_GPIO_AD_B0_10_SAI2_MCLK {
		pinmux = <0x401F80E4 0x3 0x401F85B0 0x1 0x401F82D4>;
	};

	IOMUXC_GPIO_AD_B0_10_CSI_DATA03: IOMUXC_GPIO_AD_B0_10_CSI_DATA03 {
		pinmux = <0x401F80E4 0x4 0x401F8404 0x1 0x401F82D4>;
	};

	IOMUXC_GPIO_AD_B0_10_GPIO1_IO10: IOMUXC_GPIO_AD_B0_10_GPIO1_IO10 {
		pinmux = <0x401F80E4 0x5 0 0 0x401F82D4>;
	};

	IOMUXC_GPIO_AD_B0_10_XBAR1_IN22: IOMUXC_GPIO_AD_B0_10_XBAR1_IN22 {
		pinmux = <0x401F80E4 0x6 0x401F8638 0x1 0x401F82D4>;
	};

	IOMUXC_GPIO_AD_B0_10_ENET_1588_EVENT0_OUT: IOMUXC_GPIO_AD_B0_10_ENET_1588_EVENT0_OUT {
		pinmux = <0x401F80E4 0x7 0 0 0x401F82D4>;
	};

	IOMUXC_GPIO_AD_B0_10_FLEXCAN3_TX: IOMUXC_GPIO_AD_B0_10_FLEXCAN3_TX {
		pinmux = <0x401F80E4 0x8 0 0 0x401F82D4>;
	};

	IOMUXC_GPIO_AD_B0_10_ARM_TRACE_SWO: IOMUXC_GPIO_AD_B0_10_ARM_TRACE_SWO {
		pinmux = <0x401F80E4 0x9 0 0 0x401F82D4>;
	};

	IOMUXC_GPIO_AD_B0_11_JTAG_TRSTB: IOMUXC_GPIO_AD_B0_11_JTAG_TRSTB {
		pinmux = <0x401F80E8 0x0 0 0 0x401F82D8>;
	};

	IOMUXC_GPIO_AD_B0_11_FLEXPWM1_PWMB03: IOMUXC_GPIO_AD_B0_11_FLEXPWM1_PWMB03 {
		pinmux = <0x401F80E8 0x1 0x401F8464 0x3 0x401F82D8>;
	};

	IOMUXC_GPIO_AD_B0_11_ENET_COL: IOMUXC_GPIO_AD_B0_11_ENET_COL {
		pinmux = <0x401F80E8 0x2 0 0 0x401F82D8>;
	};

	IOMUXC_GPIO_AD_B0_11_WDOG1_WDOG_B: IOMUXC_GPIO_AD_B0_11_WDOG1_WDOG_B {
		pinmux = <0x401F80E8 0x3 0 0 0x401F82D8>;
	};

	IOMUXC_GPIO_AD_B0_11_CSI_DATA02: IOMUXC_GPIO_AD_B0_11_CSI_DATA02 {
		pinmux = <0x401F80E8 0x4 0x401F8400 0x1 0x401F82D8>;
	};

	IOMUXC_GPIO_AD_B0_11_GPIO1_IO11: IOMUXC_GPIO_AD_B0_11_GPIO1_IO11 {
		pinmux = <0x401F80E8 0x5 0 0 0x401F82D8>;
	};

	IOMUXC_GPIO_AD_B0_11_XBAR1_IN23: IOMUXC_GPIO_AD_B0_11_XBAR1_IN23 {
		pinmux = <0x401F80E8 0x6 0x401F863C 0x1 0x401F82D8>;
	};

	IOMUXC_GPIO_AD_B0_11_ENET_1588_EVENT0_IN: IOMUXC_GPIO_AD_B0_11_ENET_1588_EVENT0_IN {
		pinmux = <0x401F80E8 0x7 0x401F8444 0x1 0x401F82D8>;
	};

	IOMUXC_GPIO_AD_B0_11_FLEXCAN3_RX: IOMUXC_GPIO_AD_B0_11_FLEXCAN3_RX {
		pinmux = <0x401F80E8 0x8 0x401F878C 0x2 0x401F82D8>;
	};

	IOMUXC_GPIO_AD_B0_11_SEMC_CLK6: IOMUXC_GPIO_AD_B0_11_SEMC_CLK6 {
		pinmux = <0x401F80E8 0x9 0 0 0x401F82D8>;
	};

	IOMUXC_GPIO_AD_B0_12_LPI2C4_SCL: IOMUXC_GPIO_AD_B0_12_LPI2C4_SCL {
		pinmux = <0x401F80EC 0x0 0x401F84E4 0x1 0x401F82DC>;
	};

	IOMUXC_GPIO_AD_B0_12_CCM_PMIC_READY: IOMUXC_GPIO_AD_B0_12_CCM_PMIC_READY {
		pinmux = <0x401F80EC 0x1 0x401F83FC 0x1 0x401F82DC>;
	};

	IOMUXC_GPIO_AD_B0_12_LPUART1_TX: IOMUXC_GPIO_AD_B0_12_LPUART1_TX {
		pinmux = <0x401F80EC 0x2 0 0 0x401F82DC>;
	};

	IOMUXC_GPIO_AD_B0_12_WDOG2_WDOG_B: IOMUXC_GPIO_AD_B0_12_WDOG2_WDOG_B {
		pinmux = <0x401F80EC 0x3 0 0 0x401F82DC>;
	};

	IOMUXC_GPIO_AD_B0_12_FLEXPWM1_PWMX02: IOMUXC_GPIO_AD_B0_12_FLEXPWM1_PWMX02 {
		pinmux = <0x401F80EC 0x4 0 0 0x401F82DC>;
	};

	IOMUXC_GPIO_AD_B0_12_GPIO1_IO12: IOMUXC_GPIO_AD_B0_12_GPIO1_IO12 {
		pinmux = <0x401F80EC 0x5 0 0 0x401F82DC>;
	};

	IOMUXC_GPIO_AD_B0_12_ENET_1588_EVENT1_OUT: IOMUXC_GPIO_AD_B0_12_ENET_1588_EVENT1_OUT {
		pinmux = <0x401F80EC 0x6 0 0 0x401F82DC>;
	};

	IOMUXC_GPIO_AD_B0_12_NMI_GLUE_NMI: IOMUXC_GPIO_AD_B0_12_NMI_GLUE_NMI {
		pinmux = <0x401F80EC 0x7 0x401F8568 0x0 0x401F82DC>;
	};

	IOMUXC_GPIO_AD_B0_13_LPI2C4_SDA: IOMUXC_GPIO_AD_B0_13_LPI2C4_SDA {
		pinmux = <0x401F80F0 0x0 0x401F84E8 0x1 0x401F82E0>;
	};

	IOMUXC_GPIO_AD_B0_13_GPT1_CLK: IOMUXC_GPIO_AD_B0_13_GPT1_CLK {
		pinmux = <0x401F80F0 0x1 0x401F8760 0x0 0x401F82E0>;
	};

	IOMUXC_GPIO_AD_B0_13_LPUART1_RX: IOMUXC_GPIO_AD_B0_13_LPUART1_RX {
		pinmux = <0x401F80F0 0x2 0 0 0x401F82E0>;
	};

	IOMUXC_GPIO_AD_B0_13_EWM_OUT_B: IOMUXC_GPIO_AD_B0_13_EWM_OUT_B {
		pinmux = <0x401F80F0 0x3 0 0 0x401F82E0>;
	};

	IOMUXC_GPIO_AD_B0_13_FLEXPWM1_PWMX03: IOMUXC_GPIO_AD_B0_13_FLEXPWM1_PWMX03 {
		pinmux = <0x401F80F0 0x4 0 0 0x401F82E0>;
	};

	IOMUXC_GPIO_AD_B0_13_GPIO1_IO13: IOMUXC_GPIO_AD_B0_13_GPIO1_IO13 {
		pinmux = <0x401F80F0 0x5 0 0 0x401F82E0>;
	};

	IOMUXC_GPIO_AD_B0_13_ENET_1588_EVENT1_IN: IOMUXC_GPIO_AD_B0_13_ENET_1588_EVENT1_IN {
		pinmux = <0x401F80F0 0x6 0 0 0x401F82E0>;
	};

	IOMUXC_GPIO_AD_B0_13_REF_CLK_24M: IOMUXC_GPIO_AD_B0_13_REF_CLK_24M {
		pinmux = <0x401F80F0 0x7 0 0 0x401F82E0>;
	};

	IOMUXC_GPIO_AD_B0_14_USB_OTG2_OC: IOMUXC_GPIO_AD_B0_14_USB_OTG2_OC {
		pinmux = <0x401F80F4 0x0 0x401F85CC 0x0 0x401F82E4>;
	};

	IOMUXC_GPIO_AD_B0_14_XBAR1_IN24: IOMUXC_GPIO_AD_B0_14_XBAR1_IN24 {
		pinmux = <0x401F80F4 0x1 0x401F8640 0x1 0x401F82E4>;
	};

	IOMUXC_GPIO_AD_B0_14_LPUART1_CTS_B: IOMUXC_GPIO_AD_B0_14_LPUART1_CTS_B {
		pinmux = <0x401F80F4 0x2 0 0 0x401F82E4>;
	};

	IOMUXC_GPIO_AD_B0_14_ENET_1588_EVENT0_OUT: IOMUXC_GPIO_AD_B0_14_ENET_1588_EVENT0_OUT {
		pinmux = <0x401F80F4 0x3 0 0 0x401F82E4>;
	};

	IOMUXC_GPIO_AD_B0_14_CSI_VSYNC: IOMUXC_GPIO_AD_B0_14_CSI_VSYNC {
		pinmux = <0x401F80F4 0x4 0x401F8428 0x0 0x401F82E4>;
	};

	IOMUXC_GPIO_AD_B0_14_GPIO1_IO14: IOMUXC_GPIO_AD_B0_14_GPIO1_IO14 {
		pinmux = <0x401F80F4 0x5 0 0 0x401F82E4>;
	};

	IOMUXC_GPIO_AD_B0_14_FLEXCAN2_TX: IOMUXC_GPIO_AD_B0_14_FLEXCAN2_TX {
		pinmux = <0x401F80F4 0x6 0 0 0x401F82E4>;
	};

	IOMUXC_GPIO_AD_B0_14_FLEXCAN3_TX: IOMUXC_GPIO_AD_B0_14_FLEXCAN3_TX {
		pinmux = <0x401F80F4 0x8 0 0 0x401F82E4>;
	};

	IOMUXC_GPIO_AD_B0_15_USB_OTG2_PWR: IOMUXC_GPIO_AD_B0_15_USB_OTG2_PWR {
		pinmux = <0x401F80F8 0x0 0 0 0x401F82E8>;
	};

	IOMUXC_GPIO_AD_B0_15_XBAR1_IN25: IOMUXC_GPIO_AD_B0_15_XBAR1_IN25 {
		pinmux = <0x401F80F8 0x1 0x401F8650 0x0 0x401F82E8>;
	};

	IOMUXC_GPIO_AD_B0_15_LPUART1_RTS_B: IOMUXC_GPIO_AD_B0_15_LPUART1_RTS_B {
		pinmux = <0x401F80F8 0x2 0 0 0x401F82E8>;
	};

	IOMUXC_GPIO_AD_B0_15_ENET_1588_EVENT0_IN: IOMUXC_GPIO_AD_B0_15_ENET_1588_EVENT0_IN {
		pinmux = <0x401F80F8 0x3 0x401F8444 0x0 0x401F82E8>;
	};

	IOMUXC_GPIO_AD_B0_15_CSI_HSYNC: IOMUXC_GPIO_AD_B0_15_CSI_HSYNC {
		pinmux = <0x401F80F8 0x4 0x401F8420 0x0 0x401F82E8>;
	};

	IOMUXC_GPIO_AD_B0_15_GPIO1_IO15: IOMUXC_GPIO_AD_B0_15_GPIO1_IO15 {
		pinmux = <0x401F80F8 0x5 0 0 0x401F82E8>;
	};

	IOMUXC_GPIO_AD_B0_15_FLEXCAN2_RX: IOMUXC_GPIO_AD_B0_15_FLEXCAN2_RX {
		pinmux = <0x401F80F8 0x6 0x401F8450 0x2 0x401F82E8>;
	};

	IOMUXC_GPIO_AD_B0_15_WDOG1_WDOG_RST_B_DEB: IOMUXC_GPIO_AD_B0_15_WDOG1_WDOG_RST_B_DEB {
		pinmux = <0x401F80F8 0x7 0 0 0x401F82E8>;
	};

	IOMUXC_GPIO_AD_B0_15_FLEXCAN3_RX: IOMUXC_GPIO_AD_B0_15_FLEXCAN3_RX {
		pinmux = <0x401F80F8 0x8 0x401F878C 0x1 0x401F82E8>;
	};

	IOMUXC_GPIO_AD_B1_00_USB_OTG2_ID: IOMUXC_GPIO_AD_B1_00_USB_OTG2_ID {
		pinmux = <0x401F80FC 0x0 0x401F83F8 0x1 0x401F82EC>;
	};

	IOMUXC_GPIO_AD_B1_00_QTIMER3_TIMER0: IOMUXC_GPIO_AD_B1_00_QTIMER3_TIMER0 {
		pinmux = <0x401F80FC 0x1 0x401F857C 0x1 0x401F82EC>;
	};

	IOMUXC_GPIO_AD_B1_00_LPUART2_CTS_B: IOMUXC_GPIO_AD_B1_00_LPUART2_CTS_B {
		pinmux = <0x401F80FC 0x2 0 0 0x401F82EC>;
	};

	IOMUXC_GPIO_AD_B1_00_LPI2C1_SCL: IOMUXC_GPIO_AD_B1_00_LPI2C1_SCL {
		pinmux = <0x401F80FC 0x3 0x401F84CC 0x1 0x401F82EC>;
	};

	IOMUXC_GPIO_AD_B1_00_WDOG1_B: IOMUXC_GPIO_AD_B1_00_WDOG1_B {
		pinmux = <0x401F80FC 0x4 0 0 0x401F82EC>;
	};

	IOMUXC_GPIO_AD_B1_00_GPIO1_IO16: IOMUXC_GPIO_AD_B1_00_GPIO1_IO16 {
		pinmux = <0x401F80FC 0x5 0 0 0x401F82EC>;
	};

	IOMUXC_GPIO_AD_B1_00_USDHC1_WP: IOMUXC_GPIO_AD_B1_00_USDHC1_WP {
		pinmux = <0x401F80FC 0x6 0x401F85D8 0x2 0x401F82EC>;
	};

	IOMUXC_GPIO_AD_B1_00_KPP_ROW07: IOMUXC_GPIO_AD_B1_00_KPP_ROW07 {
		pinmux = <0x401F80FC 0x7 0 0 0x401F82EC>;
	};

	IOMUXC_GPIO_AD_B1_00_ENET2_1588_EVENT0_OUT: IOMUXC_GPIO_AD_B1_00_ENET2_1588_EVENT0_OUT {
		pinmux = <0x401F80FC 0x8 0 0 0x401F82EC>;
	};

	IOMUXC_GPIO_AD_B1_00_FLEXIO3_FLEXIO00: IOMUXC_GPIO_AD_B1_00_FLEXIO3_FLEXIO00 {
		pinmux = <0x401F80FC 0x9 0 0 0x401F82EC>;
	};

	IOMUXC_GPIO_AD_B1_01_USB_OTG1_PWR: IOMUXC_GPIO_AD_B1_01_USB_OTG1_PWR {
		pinmux = <0x401F8100 0x0 0 0 0x401F82F0>;
	};

	IOMUXC_GPIO_AD_B1_01_QTIMER3_TIMER1: IOMUXC_GPIO_AD_B1_01_QTIMER3_TIMER1 {
		pinmux = <0x401F8100 0x1 0x401F8580 0x0 0x401F82F0>;
	};

	IOMUXC_GPIO_AD_B1_01_LPUART2_RTS_B: IOMUXC_GPIO_AD_B1_01_LPUART2_RTS_B {
		pinmux = <0x401F8100 0x2 0 0 0x401F82F0>;
	};

	IOMUXC_GPIO_AD_B1_01_LPI2C1_SDA: IOMUXC_GPIO_AD_B1_01_LPI2C1_SDA {
		pinmux = <0x401F8100 0x3 0x401F84D0 0x1 0x401F82F0>;
	};

	IOMUXC_GPIO_AD_B1_01_CCM_PMIC_READY: IOMUXC_GPIO_AD_B1_01_CCM_PMIC_READY {
		pinmux = <0x401F8100 0x4 0x401F83FC 0x2 0x401F82F0>;
	};

	IOMUXC_GPIO_AD_B1_01_GPIO1_IO17: IOMUXC_GPIO_AD_B1_01_GPIO1_IO17 {
		pinmux = <0x401F8100 0x5 0 0 0x401F82F0>;
	};

	IOMUXC_GPIO_AD_B1_01_USDHC1_VSELECT: IOMUXC_GPIO_AD_B1_01_USDHC1_VSELECT {
		pinmux = <0x401F8100 0x6 0 0 0x401F82F0>;
	};

	IOMUXC_GPIO_AD_B1_01_KPP_COL07: IOMUXC_GPIO_AD_B1_01_KPP_COL07 {
		pinmux = <0x401F8100 0x7 0 0 0x401F82F0>;
	};

	IOMUXC_GPIO_AD_B1_01_ENET2_1588_EVENT0_IN: IOMUXC_GPIO_AD_B1_01_ENET2_1588_EVENT0_IN {
		pinmux = <0x401F8100 0x8 0x401F8724 0x0 0x401F82F0>;
	};

	IOMUXC_GPIO_AD_B1_01_FLEXIO3_FLEXIO01: IOMUXC_GPIO_AD_B1_01_FLEXIO3_FLEXIO01 {
		pinmux = <0x401F8100 0x9 0 0 0x401F82F0>;
	};

	IOMUXC_GPIO_AD_B1_02_USB_OTG1_ID: IOMUXC_GPIO_AD_B1_02_USB_OTG1_ID {
		pinmux = <0x401F8104 0x0 0x401F83F4 0x1 0x401F82F4>;
	};

	IOMUXC_GPIO_AD_B1_02_QTIMER3_TIMER2: IOMUXC_GPIO_AD_B1_02_QTIMER3_TIMER2 {
		pinmux = <0x401F8104 0x1 0x401F8584 0x1 0x401F82F4>;
	};

	IOMUXC_GPIO_AD_B1_02_LPUART2_TX: IOMUXC_GPIO_AD_B1_02_LPUART2_TX {
		pinmux = <0x401F8104 0x2 0x401F8530 0x1 0x401F82F4>;
	};

	IOMUXC_GPIO_AD_B1_02_SPDIF_OUT: IOMUXC_GPIO_AD_B1_02_SPDIF_OUT {
		pinmux = <0x401F8104 0x3 0 0 0x401F82F4>;
	};

	IOMUXC_GPIO_AD_B1_02_ENET_1588_EVENT2_OUT: IOMUXC_GPIO_AD_B1_02_ENET_1588_EVENT2_OUT {
		pinmux = <0x401F8104 0x4 0 0 0x401F82F4>;
	};

	IOMUXC_GPIO_AD_B1_02_GPIO1_IO18: IOMUXC_GPIO_AD_B1_02_GPIO1_IO18 {
		pinmux = <0x401F8104 0x5 0 0 0x401F82F4>;
	};

	IOMUXC_GPIO_AD_B1_02_USDHC1_CD_B: IOMUXC_GPIO_AD_B1_02_USDHC1_CD_B {
		pinmux = <0x401F8104 0x6 0x401F85D4 0x1 0x401F82F4>;
	};

	IOMUXC_GPIO_AD_B1_02_KPP_ROW06: IOMUXC_GPIO_AD_B1_02_KPP_ROW06 {
		pinmux = <0x401F8104 0x7 0 0 0x401F82F4>;
	};

	IOMUXC_GPIO_AD_B1_02_GPT2_CLK: IOMUXC_GPIO_AD_B1_02_GPT2_CLK {
		pinmux = <0x401F8104 0x8 0x401F876C 0x1 0x401F82F4>;
	};

	IOMUXC_GPIO_AD_B1_02_FLEXIO3_FLEXIO02: IOMUXC_GPIO_AD_B1_02_FLEXIO3_FLEXIO02 {
		pinmux = <0x401F8104 0x9 0 0 0x401F82F4>;
	};

	IOMUXC_GPIO_AD_B1_03_USB_OTG1_OC: IOMUXC_GPIO_AD_B1_03_USB_OTG1_OC {
		pinmux = <0x401F8108 0x0 0x401F85D0 0x1 0x401F82F8>;
	};

	IOMUXC_GPIO_AD_B1_03_QTIMER3_TIMER3: IOMUXC_GPIO_AD_B1_03_QTIMER3_TIMER3 {
		pinmux = <0x401F8108 0x1 0x401F8588 0x1 0x401F82F8>;
	};

	IOMUXC_GPIO_AD_B1_03_LPUART2_RX: IOMUXC_GPIO_AD_B1_03_LPUART2_RX {
		pinmux = <0x401F8108 0x2 0x401F852C 0x1 0x401F82F8>;
	};

	IOMUXC_GPIO_AD_B1_03_SPDIF_IN: IOMUXC_GPIO_AD_B1_03_SPDIF_IN {
		pinmux = <0x401F8108 0x3 0x401F85C8 0x0 0x401F82F8>;
	};

	IOMUXC_GPIO_AD_B1_03_ENET_1588_EVENT2_IN: IOMUXC_GPIO_AD_B1_03_ENET_1588_EVENT2_IN {
		pinmux = <0x401F8108 0x4 0 0 0x401F82F8>;
	};

	IOMUXC_GPIO_AD_B1_03_GPIO1_IO19: IOMUXC_GPIO_AD_B1_03_GPIO1_IO19 {
		pinmux = <0x401F8108 0x5 0 0 0x401F82F8>;
	};

	IOMUXC_GPIO_AD_B1_03_USDHC2_CD_B: IOMUXC_GPIO_AD_B1_03_USDHC2_CD_B {
		pinmux = <0x401F8108 0x6 0x401F85E0 0x0 0x401F82F8>;
	};

	IOMUXC_GPIO_AD_B1_03_KPP_COL06: IOMUXC_GPIO_AD_B1_03_KPP_COL06 {
		pinmux = <0x401F8108 0x7 0 0 0x401F82F8>;
	};

	IOMUXC_GPIO_AD_B1_03_GPT2_CAPTURE1: IOMUXC_GPIO_AD_B1_03_GPT2_CAPTURE1 {
		pinmux = <0x401F8108 0x8 0x401F8764 0x1 0x401F82F8>;
	};

	IOMUXC_GPIO_AD_B1_03_FLEXIO3_FLEXIO03: IOMUXC_GPIO_AD_B1_03_FLEXIO3_FLEXIO03 {
		pinmux = <0x401F8108 0x9 0 0 0x401F82F8>;
	};

	IOMUXC_GPIO_AD_B1_04_FLEXSPIB_DATA03: IOMUXC_GPIO_AD_B1_04_FLEXSPIB_DATA03 {
		pinmux = <0x401F810C 0x0 0x401F84C4 0x1 0x401F82FC>;
	};

	IOMUXC_GPIO_AD_B1_04_ENET_MDC: IOMUXC_GPIO_AD_B1_04_ENET_MDC {
		pinmux = <0x401F810C 0x1 0 0 0x401F82FC>;
	};

	IOMUXC_GPIO_AD_B1_04_LPUART3_CTS_B: IOMUXC_GPIO_AD_B1_04_LPUART3_CTS_B {
		pinmux = <0x401F810C 0x2 0x401F8534 0x1 0x401F82FC>;
	};

	IOMUXC_GPIO_AD_B1_04_SPDIF_SR_CLK: IOMUXC_GPIO_AD_B1_04_SPDIF_SR_CLK {
		pinmux = <0x401F810C 0x3 0 0 0x401F82FC>;
	};

	IOMUXC_GPIO_AD_B1_04_CSI_PIXCLK: IOMUXC_GPIO_AD_B1_04_CSI_PIXCLK {
		pinmux = <0x401F810C 0x4 0x401F8424 0x0 0x401F82FC>;
	};

	IOMUXC_GPIO_AD_B1_04_GPIO1_IO20: IOMUXC_GPIO_AD_B1_04_GPIO1_IO20 {
		pinmux = <0x401F810C 0x5 0 0 0x401F82FC>;
	};

	IOMUXC_GPIO_AD_B1_04_USDHC2_DATA0: IOMUXC_GPIO_AD_B1_04_USDHC2_DATA0 {
		pinmux = <0x401F810C 0x6 0x401F85E8 0x1 0x401F82FC>;
	};

	IOMUXC_GPIO_AD_B1_04_KPP_ROW05: IOMUXC_GPIO_AD_B1_04_KPP_ROW05 {
		pinmux = <0x401F810C 0x7 0 0 0x401F82FC>;
	};

	IOMUXC_GPIO_AD_B1_04_GPT2_CAPTURE2: IOMUXC_GPIO_AD_B1_04_GPT2_CAPTURE2 {
		pinmux = <0x401F810C 0x8 0x401F8768 0x1 0x401F82FC>;
	};

	IOMUXC_GPIO_AD_B1_04_FLEXIO3_FLEXIO04: IOMUXC_GPIO_AD_B1_04_FLEXIO3_FLEXIO04 {
		pinmux = <0x401F810C 0x9 0 0 0x401F82FC>;
	};

	IOMUXC_GPIO_AD_B1_05_FLEXSPIB_DATA02: IOMUXC_GPIO_AD_B1_05_FLEXSPIB_DATA02 {
		pinmux = <0x401F8110 0x0 0x401F84C0 0x1 0x401F8300>;
	};

	IOMUXC_GPIO_AD_B1_05_ENET_MDIO: IOMUXC_GPIO_AD_B1_05_ENET_MDIO {
		pinmux = <0x401F8110 0x1 0x401F8430 0x0 0x401F8300>;
	};

	IOMUXC_GPIO_AD_B1_05_LPUART3_RTS_B: IOMUXC_GPIO_AD_B1_05_LPUART3_RTS_B {
		pinmux = <0x401F8110 0x2 0 0 0x401F8300>;
	};

	IOMUXC_GPIO_AD_B1_05_SPDIF_OUT: IOMUXC_GPIO_AD_B1_05_SPDIF_OUT {
		pinmux = <0x401F8110 0x3 0 0 0x401F8300>;
	};

	IOMUXC_GPIO_AD_B1_05_CSI_MCLK: IOMUXC_GPIO_AD_B1_05_CSI_MCLK {
		pinmux = <0x401F8110 0x4 0 0 0x401F8300>;
	};

	IOMUXC_GPIO_AD_B1_05_GPIO1_IO21: IOMUXC_GPIO_AD_B1_05_GPIO1_IO21 {
		pinmux = <0x401F8110 0x5 0 0 0x401F8300>;
	};

	IOMUXC_GPIO_AD_B1_05_USDHC2_DATA1: IOMUXC_GPIO_AD_B1_05_USDHC2_DATA1 {
		pinmux = <0x401F8110 0x6 0x401F85EC 0x1 0x401F8300>;
	};

	IOMUXC_GPIO_AD_B1_05_KPP_COL05: IOMUXC_GPIO_AD_B1_05_KPP_COL05 {
		pinmux = <0x401F8110 0x7 0 0 0x401F8300>;
	};

	IOMUXC_GPIO_AD_B1_05_GPT2_COMPARE1: IOMUXC_GPIO_AD_B1_05_GPT2_COMPARE1 {
		pinmux = <0x401F8110 0x8 0 0 0x401F8300>;
	};

	IOMUXC_GPIO_AD_B1_05_FLEXIO3_FLEXIO05: IOMUXC_GPIO_AD_B1_05_FLEXIO3_FLEXIO05 {
		pinmux = <0x401F8110 0x9 0 0 0x401F8300>;
	};

	IOMUXC_GPIO_AD_B1_06_FLEXSPIB_DATA01: IOMUXC_GPIO_AD_B1_06_FLEXSPIB_DATA01 {
		pinmux = <0x401F8114 0x0 0x401F84BC 0x1 0x401F8304>;
	};

	IOMUXC_GPIO_AD_B1_06_LPI2C3_SDA: IOMUXC_GPIO_AD_B1_06_LPI2C3_SDA {
		pinmux = <0x401F8114 0x1 0x401F84E0 0x2 0x401F8304>;
	};

	IOMUXC_GPIO_AD_B1_06_LPUART3_TX: IOMUXC_GPIO_AD_B1_06_LPUART3_TX {
		pinmux = <0x401F8114 0x2 0x401F853C 0x0 0x401F8304>;
	};

	IOMUXC_GPIO_AD_B1_06_SPDIF_LOCK: IOMUXC_GPIO_AD_B1_06_SPDIF_LOCK {
		pinmux = <0x401F8114 0x3 0 0 0x401F8304>;
	};

	IOMUXC_GPIO_AD_B1_06_CSI_VSYNC: IOMUXC_GPIO_AD_B1_06_CSI_VSYNC {
		pinmux = <0x401F8114 0x4 0x401F8428 0x1 0x401F8304>;
	};

	IOMUXC_GPIO_AD_B1_06_GPIO1_IO22: IOMUXC_GPIO_AD_B1_06_GPIO1_IO22 {
		pinmux = <0x401F8114 0x5 0 0 0x401F8304>;
	};

	IOMUXC_GPIO_AD_B1_06_USDHC2_DATA2: IOMUXC_GPIO_AD_B1_06_USDHC2_DATA2 {
		pinmux = <0x401F8114 0x6 0x401F85F0 0x1 0x401F8304>;
	};

	IOMUXC_GPIO_AD_B1_06_KPP_ROW04: IOMUXC_GPIO_AD_B1_06_KPP_ROW04 {
		pinmux = <0x401F8114 0x7 0 0 0x401F8304>;
	};

	IOMUXC_GPIO_AD_B1_06_GPT2_COMPARE2: IOMUXC_GPIO_AD_B1_06_GPT2_COMPARE2 {
		pinmux = <0x401F8114 0x8 0 0 0x401F8304>;
	};

	IOMUXC_GPIO_AD_B1_06_FLEXIO3_FLEXIO06: IOMUXC_GPIO_AD_B1_06_FLEXIO3_FLEXIO06 {
		pinmux = <0x401F8114 0x9 0 0 0x401F8304>;
	};

	IOMUXC_GPIO_AD_B1_07_FLEXSPIB_DATA00: IOMUXC_GPIO_AD_B1_07_FLEXSPIB_DATA00 {
		pinmux = <0x401F8118 0x0 0x401F84B8 0x1 0x401F8308>;
	};

	IOMUXC_GPIO_AD_B1_07_LPI2C3_SCL: IOMUXC_GPIO_AD_B1_07_LPI2C3_SCL {
		pinmux = <0x401F8118 0x1 0x401F84DC 0x2 0x401F8308>;
	};

	IOMUXC_GPIO_AD_B1_07_LPUART3_RX: IOMUXC_GPIO_AD_B1_07_LPUART3_RX {
		pinmux = <0x401F8118 0x2 0x401F8538 0x0 0x401F8308>;
	};

	IOMUXC_GPIO_AD_B1_07_SPDIF_EXT_CLK: IOMUXC_GPIO_AD_B1_07_SPDIF_EXT_CLK {
		pinmux = <0x401F8118 0x3 0 0 0x401F8308>;
	};

	IOMUXC_GPIO_AD_B1_07_CSI_HSYNC: IOMUXC_GPIO_AD_B1_07_CSI_HSYNC {
		pinmux = <0x401F8118 0x4 0x401F8420 0x1 0x401F8308>;
	};

	IOMUXC_GPIO_AD_B1_07_GPIO1_IO23: IOMUXC_GPIO_AD_B1_07_GPIO1_IO23 {
		pinmux = <0x401F8118 0x5 0 0 0x401F8308>;
	};

	IOMUXC_GPIO_AD_B1_07_USDHC2_DATA3: IOMUXC_GPIO_AD_B1_07_USDHC2_DATA3 {
		pinmux = <0x401F8118 0x6 0x401F85F4 0x1 0x401F8308>;
	};

	IOMUXC_GPIO_AD_B1_07_KPP_COL04: IOMUXC_GPIO_AD_B1_07_KPP_COL04 {
		pinmux = <0x401F8118 0x7 0 0 0x401F8308>;
	};

	IOMUXC_GPIO_AD_B1_07_GPT2_COMPARE3: IOMUXC_GPIO_AD_B1_07_GPT2_COMPARE3 {
		pinmux = <0x401F8118 0x8 0 0 0x401F8308>;
	};

	IOMUXC_GPIO_AD_B1_07_FLEXIO3_FLEXIO07: IOMUXC_GPIO_AD_B1_07_FLEXIO3_FLEXIO07 {
		pinmux = <0x401F8118 0x9 0 0 0x401F8308>;
	};

	IOMUXC_GPIO_AD_B1_08_FLEXSPIA_SS1_B: IOMUXC_GPIO_AD_B1_08_FLEXSPIA_SS1_B {
		pinmux = <0x401F811C 0x0 0 0 0x401F830C>;
	};

	IOMUXC_GPIO_AD_B1_08_FLEXPWM4_PWMA00: IOMUXC_GPIO_AD_B1_08_FLEXPWM4_PWMA00 {
		pinmux = <0x401F811C 0x1 0x401F8494 0x1 0x401F830C>;
	};

	IOMUXC_GPIO_AD_B1_08_FLEXCAN1_TX: IOMUXC_GPIO_AD_B1_08_FLEXCAN1_TX {
		pinmux = <0x401F811C 0x2 0 0 0x401F830C>;
	};

	IOMUXC_GPIO_AD_B1_08_CCM_PMIC_READY: IOMUXC_GPIO_AD_B1_08_CCM_PMIC_READY {
		pinmux = <0x401F811C 0x3 0x401F83FC 0x3 0x401F830C>;
	};

	IOMUXC_GPIO_AD_B1_08_CSI_DATA09: IOMUXC_GPIO_AD_B1_08_CSI_DATA09 {
		pinmux = <0x401F811C 0x4 0x401F841C 0x0 0x401F830C>;
	};

	IOMUXC_GPIO_AD_B1_08_GPIO1_IO24: IOMUXC_GPIO_AD_B1_08_GPIO1_IO24 {
		pinmux = <0x401F811C 0x5 0 0 0x401F830C>;
	};

	IOMUXC_GPIO_AD_B1_08_USDHC2_CMD: IOMUXC_GPIO_AD_B1_08_USDHC2_CMD {
		pinmux = <0x401F811C 0x6 0x401F85E4 0x1 0x401F830C>;
	};

	IOMUXC_GPIO_AD_B1_08_KPP_ROW03: IOMUXC_GPIO_AD_B1_08_KPP_ROW03 {
		pinmux = <0x401F811C 0x7 0 0 0x401F830C>;
	};

	IOMUXC_GPIO_AD_B1_08_FLEXIO3_FLEXIO08: IOMUXC_GPIO_AD_B1_08_FLEXIO3_FLEXIO08 {
		pinmux = <0x401F811C 0x9 0 0 0x401F830C>;
	};

	IOMUXC_GPIO_AD_B1_09_FLEXSPIA_DQS: IOMUXC_GPIO_AD_B1_09_FLEXSPIA_DQS {
		pinmux = <0x401F8120 0x0 0x401F84A4 0x1 0x401F8310>;
	};

	IOMUXC_GPIO_AD_B1_09_FLEXPWM4_PWMA01: IOMUXC_GPIO_AD_B1_09_FLEXPWM4_PWMA01 {
		pinmux = <0x401F8120 0x1 0x401F8498 0x1 0x401F8310>;
	};

	IOMUXC_GPIO_AD_B1_09_FLEXCAN1_RX: IOMUXC_GPIO_AD_B1_09_FLEXCAN1_RX {
		pinmux = <0x401F8120 0x2 0x401F844C 0x2 0x401F8310>;
	};

	IOMUXC_GPIO_AD_B1_09_SAI1_MCLK: IOMUXC_GPIO_AD_B1_09_SAI1_MCLK {
		pinmux = <0x401F8120 0x3 0x401F858C 0x1 0x401F8310>;
	};

	IOMUXC_GPIO_AD_B1_09_CSI_DATA08: IOMUXC_GPIO_AD_B1_09_CSI_DATA08 {
		pinmux = <0x401F8120 0x4 0x401F8418 0x0 0x401F8310>;
	};

	IOMUXC_GPIO_AD_B1_09_GPIO1_IO25: IOMUXC_GPIO_AD_B1_09_GPIO1_IO25 {
		pinmux = <0x401F8120 0x5 0 0 0x401F8310>;
	};

	IOMUXC_GPIO_AD_B1_09_USDHC2_CLK: IOMUXC_GPIO_AD_B1_09_USDHC2_CLK {
		pinmux = <0x401F8120 0x6 0x401F85DC 0x1 0x401F8310>;
	};

	IOMUXC_GPIO_AD_B1_09_KPP_COL03: IOMUXC_GPIO_AD_B1_09_KPP_COL03 {
		pinmux = <0x401F8120 0x7 0 0 0x401F8310>;
	};

	IOMUXC_GPIO_AD_B1_09_FLEXIO3_FLEXIO09: IOMUXC_GPIO_AD_B1_09_FLEXIO3_FLEXIO09 {
		pinmux = <0x401F8120 0x9 0 0 0x401F8310>;
	};

	IOMUXC_GPIO_AD_B1_10_FLEXSPIA_DATA03: IOMUXC_GPIO_AD_B1_10_FLEXSPIA_DATA03 {
		pinmux = <0x401F8124 0x0 0x401F84B4 0x1 0x401F8314>;
	};

	IOMUXC_GPIO_AD_B1_10_WDOG1_B: IOMUXC_GPIO_AD_B1_10_WDOG1_B {
		pinmux = <0x401F8124 0x1 0 0 0x401F8314>;
	};

	IOMUXC_GPIO_AD_B1_10_LPUART8_TX: IOMUXC_GPIO_AD_B1_10_LPUART8_TX {
		pinmux = <0x401F8124 0x2 0x401F8564 0x1 0x401F8314>;
	};

	IOMUXC_GPIO_AD_B1_10_SAI1_RX_SYNC: IOMUXC_GPIO_AD_B1_10_SAI1_RX_SYNC {
		pinmux = <0x401F8124 0x3 0x401F85A4 0x1 0x401F8314>;
	};

	IOMUXC_GPIO_AD_B1_10_CSI_DATA07: IOMUXC_GPIO_AD_B1_10_CSI_DATA07 {
		pinmux = <0x401F8124 0x4 0x401F8414 0x0 0x401F8314>;
	};

	IOMUXC_GPIO_AD_B1_10_GPIO1_IO26: IOMUXC_GPIO_AD_B1_10_GPIO1_IO26 {
		pinmux = <0x401F8124 0x5 0 0 0x401F8314>;
	};

	IOMUXC_GPIO_AD_B1_10_USDHC2_WP: IOMUXC_GPIO_AD_B1_10_USDHC2_WP {
		pinmux = <0x401F8124 0x6 0x401F8608 0x1 0x401F8314>;
	};

	IOMUXC_GPIO_AD_B1_10_KPP_ROW02: IOMUXC_GPIO_AD_B1_10_KPP_ROW02 {
		pinmux = <0x401F8124 0x7 0 0 0x401F8314>;
	};

	IOMUXC_GPIO_AD_B1_10_ENET2_1588_EVENT1_OUT: IOMUXC_GPIO_AD_B1_10_ENET2_1588_EVENT1_OUT {
		pinmux = <0x401F8124 0x8 0 0 0x401F8314>;
	};

	IOMUXC_GPIO_AD_B1_10_FLEXIO3_FLEXIO10: IOMUXC_GPIO_AD_B1_10_FLEXIO3_FLEXIO10 {
		pinmux = <0x401F8124 0x9 0 0 0x401F8314>;
	};

	IOMUXC_GPIO_AD_B1_11_FLEXSPIA_DATA02: IOMUXC_GPIO_AD_B1_11_FLEXSPIA_DATA02 {
		pinmux = <0x401F8128 0x0 0x401F84B0 0x1 0x401F8318>;
	};

	IOMUXC_GPIO_AD_B1_11_EWM_OUT_B: IOMUXC_GPIO_AD_B1_11_EWM_OUT_B {
		pinmux = <0x401F8128 0x1 0 0 0x401F8318>;
	};

	IOMUXC_GPIO_AD_B1_11_LPUART8_RX: IOMUXC_GPIO_AD_B1_11_LPUART8_RX {
		pinmux = <0x401F8128 0x2 0x401F8560 0x1 0x401F8318>;
	};

	IOMUXC_GPIO_AD_B1_11_SAI1_RX_BCLK: IOMUXC_GPIO_AD_B1_11_SAI1_RX_BCLK {
		pinmux = <0x401F8128 0x3 0x401F8590 0x1 0x401F8318>;
	};

	IOMUXC_GPIO_AD_B1_11_CSI_DATA06: IOMUXC_GPIO_AD_B1_11_CSI_DATA06 {
		pinmux = <0x401F8128 0x4 0x401F8410 0x0 0x401F8318>;
	};

	IOMUXC_GPIO_AD_B1_11_GPIO1_IO27: IOMUXC_GPIO_AD_B1_11_GPIO1_IO27 {
		pinmux = <0x401F8128 0x5 0 0 0x401F8318>;
	};

	IOMUXC_GPIO_AD_B1_11_USDHC2_RESET_B: IOMUXC_GPIO_AD_B1_11_USDHC2_RESET_B {
		pinmux = <0x401F8128 0x6 0 0 0x401F8318>;
	};

	IOMUXC_GPIO_AD_B1_11_KPP_COL02: IOMUXC_GPIO_AD_B1_11_KPP_COL02 {
		pinmux = <0x401F8128 0x7 0 0 0x401F8318>;
	};

	IOMUXC_GPIO_AD_B1_11_ENET2_1588_EVENT1_IN: IOMUXC_GPIO_AD_B1_11_ENET2_1588_EVENT1_IN {
		pinmux = <0x401F8128 0x8 0 0 0x401F8318>;
	};

	IOMUXC_GPIO_AD_B1_11_FLEXIO3_FLEXIO11: IOMUXC_GPIO_AD_B1_11_FLEXIO3_FLEXIO11 {
		pinmux = <0x401F8128 0x9 0 0 0x401F8318>;
	};

	IOMUXC_GPIO_AD_B1_12_FLEXSPIA_DATA01: IOMUXC_GPIO_AD_B1_12_FLEXSPIA_DATA01 {
		pinmux = <0x401F812C 0x0 0x401F84AC 0x1 0x401F831C>;
	};

	IOMUXC_GPIO_AD_B1_12_ACMP_OUT00: IOMUXC_GPIO_AD_B1_12_ACMP_OUT00 {
		pinmux = <0x401F812C 0x1 0 0 0x401F831C>;
	};

	IOMUXC_GPIO_AD_B1_12_LPSPI3_PCS0: IOMUXC_GPIO_AD_B1_12_LPSPI3_PCS0 {
		pinmux = <0x401F812C 0x2 0x401F850C 0x1 0x401F831C>;
	};

	IOMUXC_GPIO_AD_B1_12_SAI1_RX_DATA00: IOMUXC_GPIO_AD_B1_12_SAI1_RX_DATA00 {
		pinmux = <0x401F812C 0x3 0x401F8594 0x1 0x401F831C>;
	};

	IOMUXC_GPIO_AD_B1_12_CSI_DATA05: IOMUXC_GPIO_AD_B1_12_CSI_DATA05 {
		pinmux = <0x401F812C 0x4 0x401F840C 0x0 0x401F831C>;
	};

	IOMUXC_GPIO_AD_B1_12_GPIO1_IO28: IOMUXC_GPIO_AD_B1_12_GPIO1_IO28 {
		pinmux = <0x401F812C 0x5 0 0 0x401F831C>;
	};

	IOMUXC_GPIO_AD_B1_12_USDHC2_DATA4: IOMUXC_GPIO_AD_B1_12_USDHC2_DATA4 {
		pinmux = <0x401F812C 0x6 0x401F85F8 0x1 0x401F831C>;
	};

	IOMUXC_GPIO_AD_B1_12_KPP_ROW01: IOMUXC_GPIO_AD_B1_12_KPP_ROW01 {
		pinmux = <0x401F812C 0x7 0 0 0x401F831C>;
	};

	IOMUXC_GPIO_AD_B1_12_ENET2_1588_EVENT2_OUT: IOMUXC_GPIO_AD_B1_12_ENET2_1588_EVENT2_OUT {
		pinmux = <0x401F812C 0x8 0 0 0x401F831C>;
	};

	IOMUXC_GPIO_AD_B1_12_FLEXIO3_FLEXIO12: IOMUXC_GPIO_AD_B1_12_FLEXIO3_FLEXIO12 {
		pinmux = <0x401F812C 0x9 0 0 0x401F831C>;
	};

	IOMUXC_GPIO_AD_B1_13_FLEXSPIA_DATA00: IOMUXC_GPIO_AD_B1_13_FLEXSPIA_DATA00 {
		pinmux = <0x401F8130 0x0 0x401F84A8 0x1 0x401F8320>;
	};

	IOMUXC_GPIO_AD_B1_13_ACMP_OUT01: IOMUXC_GPIO_AD_B1_13_ACMP_OUT01 {
		pinmux = <0x401F8130 0x1 0 0 0x401F8320>;
	};

	IOMUXC_GPIO_AD_B1_13_LPSPI3_SDI: IOMUXC_GPIO_AD_B1_13_LPSPI3_SDI {
		pinmux = <0x401F8130 0x2 0x401F8514 0x1 0x401F8320>;
	};

	IOMUXC_GPIO_AD_B1_13_SAI1_TX_DATA00: IOMUXC_GPIO_AD_B1_13_SAI1_TX_DATA00 {
		pinmux = <0x401F8130 0x3 0 0 0x401F8320>;
	};

	IOMUXC_GPIO_AD_B1_13_CSI_DATA04: IOMUXC_GPIO_AD_B1_13_CSI_DATA04 {
		pinmux = <0x401F8130 0x4 0x401F8408 0x0 0x401F8320>;
	};

	IOMUXC_GPIO_AD_B1_13_GPIO1_IO29: IOMUXC_GPIO_AD_B1_13_GPIO1_IO29 {
		pinmux = <0x401F8130 0x5 0 0 0x401F8320>;
	};

	IOMUXC_GPIO_AD_B1_13_USDHC2_DATA5: IOMUXC_GPIO_AD_B1_13_USDHC2_DATA5 {
		pinmux = <0x401F8130 0x6 0x401F85FC 0x1 0x401F8320>;
	};

	IOMUXC_GPIO_AD_B1_13_KPP_COL01: IOMUXC_GPIO_AD_B1_13_KPP_COL01 {
		pinmux = <0x401F8130 0x7 0 0 0x401F8320>;
	};

	IOMUXC_GPIO_AD_B1_13_ENET2_1588_EVENT2_IN: IOMUXC_GPIO_AD_B1_13_ENET2_1588_EVENT2_IN {
		pinmux = <0x401F8130 0x8 0 0 0x401F8320>;
	};

	IOMUXC_GPIO_AD_B1_13_FLEXIO3_FLEXIO13: IOMUXC_GPIO_AD_B1_13_FLEXIO3_FLEXIO13 {
		pinmux = <0x401F8130 0x9 0 0 0x401F8320>;
	};

	IOMUXC_GPIO_AD_B1_14_FLEXSPIA_SCLK: IOMUXC_GPIO_AD_B1_14_FLEXSPIA_SCLK {
		pinmux = <0x401F8134 0x0 0x401F84C8 0x1 0x401F8324>;
	};

	IOMUXC_GPIO_AD_B1_14_ACMP_OUT02: IOMUXC_GPIO_AD_B1_14_ACMP_OUT02 {
		pinmux = <0x401F8134 0x1 0 0 0x401F8324>;
	};

	IOMUXC_GPIO_AD_B1_14_LPSPI3_SDO: IOMUXC_GPIO_AD_B1_14_LPSPI3_SDO {
		pinmux = <0x401F8134 0x2 0x401F8518 0x1 0x401F8324>;
	};

	IOMUXC_GPIO_AD_B1_14_SAI1_TX_BCLK: IOMUXC_GPIO_AD_B1_14_SAI1_TX_BCLK {
		pinmux = <0x401F8134 0x3 0x401F85A8 0x1 0x401F8324>;
	};

	IOMUXC_GPIO_AD_B1_14_CSI_DATA03: IOMUXC_GPIO_AD_B1_14_CSI_DATA03 {
		pinmux = <0x401F8134 0x4 0x401F8404 0x0 0x401F8324>;
	};

	IOMUXC_GPIO_AD_B1_14_GPIO1_IO30: IOMUXC_GPIO_AD_B1_14_GPIO1_IO30 {
		pinmux = <0x401F8134 0x5 0 0 0x401F8324>;
	};

	IOMUXC_GPIO_AD_B1_14_USDHC2_DATA6: IOMUXC_GPIO_AD_B1_14_USDHC2_DATA6 {
		pinmux = <0x401F8134 0x6 0x401F8600 0x1 0x401F8324>;
	};

	IOMUXC_GPIO_AD_B1_14_KPP_ROW00: IOMUXC_GPIO_AD_B1_14_KPP_ROW00 {
		pinmux = <0x401F8134 0x7 0 0 0x401F8324>;
	};

	IOMUXC_GPIO_AD_B1_14_ENET2_1588_EVENT3_OUT: IOMUXC_GPIO_AD_B1_14_ENET2_1588_EVENT3_OUT {
		pinmux = <0x401F8134 0x8 0 0 0x401F8324>;
	};

	IOMUXC_GPIO_AD_B1_14_FLEXIO3_FLEXIO14: IOMUXC_GPIO_AD_B1_14_FLEXIO3_FLEXIO14 {
		pinmux = <0x401F8134 0x9 0 0 0x401F8324>;
	};

	IOMUXC_GPIO_AD_B1_15_FLEXSPIA_SS0_B: IOMUXC_GPIO_AD_B1_15_FLEXSPIA_SS0_B {
		pinmux = <0x401F8138 0x0 0 0 0x401F8328>;
	};

	IOMUXC_GPIO_AD_B1_15_ACMP_OUT03: IOMUXC_GPIO_AD_B1_15_ACMP_OUT03 {
		pinmux = <0x401F8138 0x1 0 0 0x401F8328>;
	};

	IOMUXC_GPIO_AD_B1_15_LPSPI3_SCK: IOMUXC_GPIO_AD_B1_15_LPSPI3_SCK {
		pinmux = <0x401F8138 0x2 0 0 0x401F8328>;
	};

	IOMUXC_GPIO_AD_B1_15_SAI1_TX_SYNC: IOMUXC_GPIO_AD_B1_15_SAI1_TX_SYNC {
		pinmux = <0x401F8138 0x3 0x401F85AC 0x1 0x401F8328>;
	};

	IOMUXC_GPIO_AD_B1_15_CSI_DATA02: IOMUXC_GPIO_AD_B1_15_CSI_DATA02 {
		pinmux = <0x401F8138 0x4 0x401F8400 0x0 0x401F8328>;
	};

	IOMUXC_GPIO_AD_B1_15_GPIO1_IO31: IOMUXC_GPIO_AD_B1_15_GPIO1_IO31 {
		pinmux = <0x401F8138 0x5 0 0 0x401F8328>;
	};

	IOMUXC_GPIO_AD_B1_15_USDHC2_DATA7: IOMUXC_GPIO_AD_B1_15_USDHC2_DATA7 {
		pinmux = <0x401F8138 0x6 0x401F8604 0x1 0x401F8328>;
	};

	IOMUXC_GPIO_AD_B1_15_KPP_COL00: IOMUXC_GPIO_AD_B1_15_KPP_COL00 {
		pinmux = <0x401F8138 0x7 0 0 0x401F8328>;
	};

	IOMUXC_GPIO_AD_B1_15_ENET2_1588_EVENT3_IN: IOMUXC_GPIO_AD_B1_15_ENET2_1588_EVENT3_IN {
		pinmux = <0x401F8138 0x8 0 0 0x401F8328>;
	};

	IOMUXC_GPIO_AD_B1_15_FLEXIO3_FLEXIO15: IOMUXC_GPIO_AD_B1_15_FLEXIO3_FLEXIO15 {
		pinmux = <0x401F8138 0x9 0 0 0x401F8328>;
	};

	IOMUXC_GPIO_B0_00_LCD_CLK: IOMUXC_GPIO_B0_00_LCD_CLK {
		pinmux = <0x401F813C 0x0 0 0 0x401F832C>;
	};

	IOMUXC_GPIO_B0_00_QTIMER1_TIMER0: IOMUXC_GPIO_B0_00_QTIMER1_TIMER0 {
		pinmux = <0x401F813C 0x1 0 0 0x401F832C>;
	};

	IOMUXC_GPIO_B0_00_MQS_RIGHT: IOMUXC_GPIO_B0_00_MQS_RIGHT {
		pinmux = <0x401F813C 0x2 0 0 0x401F832C>;
	};

	IOMUXC_GPIO_B0_00_LPSPI4_PCS0: IOMUXC_GPIO_B0_00_LPSPI4_PCS0 {
		pinmux = <0x401F813C 0x3 0x401F851C 0x0 0x401F832C>;
	};

	IOMUXC_GPIO_B0_00_FLEXIO2_FLEXIO00: IOMUXC_GPIO_B0_00_FLEXIO2_FLEXIO00 {
		pinmux = <0x401F813C 0x4 0 0 0x401F832C>;
	};

	IOMUXC_GPIO_B0_00_GPIO2_IO00: IOMUXC_GPIO_B0_00_GPIO2_IO00 {
		pinmux = <0x401F813C 0x5 0 0 0x401F832C>;
	};

	IOMUXC_GPIO_B0_00_SEMC_CSX01: IOMUXC_GPIO_B0_00_SEMC_CSX01 {
		pinmux = <0x401F813C 0x6 0 0 0x401F832C>;
	};

	IOMUXC_GPIO_B0_00_ENET2_MDC: IOMUXC_GPIO_B0_00_ENET2_MDC {
		pinmux = <0x401F813C 0x8 0 0 0x401F832C>;
	};

	IOMUXC_GPIO_B0_01_LCD_ENABLE: IOMUXC_GPIO_B0_01_LCD_ENABLE {
		pinmux = <0x401F8140 0x0 0 0 0x401F8330>;
	};

	IOMUXC_GPIO_B0_01_QTIMER1_TIMER1: IOMUXC_GPIO_B0_01_QTIMER1_TIMER1 {
		pinmux = <0x401F8140 0x1 0 0 0x401F8330>;
	};

	IOMUXC_GPIO_B0_01_MQS_LEFT: IOMUXC_GPIO_B0_01_MQS_LEFT {
		pinmux = <0x401F8140 0x2 0 0 0x401F8330>;
	};

	IOMUXC_GPIO_B0_01_LPSPI4_SDI: IOMUXC_GPIO_B0_01_LPSPI4_SDI {
		pinmux = <0x401F8140 0x3 0x401F8524 0x0 0x401F8330>;
	};

	IOMUXC_GPIO_B0_01_FLEXIO2_FLEXIO01: IOMUXC_GPIO_B0_01_FLEXIO2_FLEXIO01 {
		pinmux = <0x401F8140 0x4 0 0 0x401F8330>;
	};

	IOMUXC_GPIO_B0_01_GPIO2_IO01: IOMUXC_GPIO_B0_01_GPIO2_IO01 {
		pinmux = <0x401F8140 0x5 0 0 0x401F8330>;
	};

	IOMUXC_GPIO_B0_01_SEMC_CSX02: IOMUXC_GPIO_B0_01_SEMC_CSX02 {
		pinmux = <0x401F8140 0x6 0 0 0x401F8330>;
	};

	IOMUXC_GPIO_B0_01_ENET2_MDIO: IOMUXC_GPIO_B0_01_ENET2_MDIO {
		pinmux = <0x401F8140 0x8 0x401F8710 0x1 0x401F8330>;
	};

	IOMUXC_GPIO_B0_02_LCD_HSYNC: IOMUXC_GPIO_B0_02_LCD_HSYNC {
		pinmux = <0x401F8144 0x0 0 0 0x401F8334>;
	};

	IOMUXC_GPIO_B0_02_QTIMER1_TIMER2: IOMUXC_GPIO_B0_02_QTIMER1_TIMER2 {
		pinmux = <0x401F8144 0x1 0 0 0x401F8334>;
	};

	IOMUXC_GPIO_B0_02_FLEXCAN1_TX: IOMUXC_GPIO_B0_02_FLEXCAN1_TX {
		pinmux = <0x401F8144 0x2 0 0 0x401F8334>;
	};

	IOMUXC_GPIO_B0_02_LPSPI4_SDO: IOMUXC_GPIO_B0_02_LPSPI4_SDO {
		pinmux = <0x401F8144 0x3 0x401F8528 0x0 0x401F8334>;
	};

	IOMUXC_GPIO_B0_02_FLEXIO2_FLEXIO02: IOMUXC_GPIO_B0_02_FLEXIO2_FLEXIO02 {
		pinmux = <0x401F8144 0x4 0 0 0x401F8334>;
	};

	IOMUXC_GPIO_B0_02_GPIO2_IO02: IOMUXC_GPIO_B0_02_GPIO2_IO02 {
		pinmux = <0x401F8144 0x5 0 0 0x401F8334>;
	};

	IOMUXC_GPIO_B0_02_SEMC_CSX03: IOMUXC_GPIO_B0_02_SEMC_CSX03 {
		pinmux = <0x401F8144 0x6 0 0 0x401F8334>;
	};

	IOMUXC_GPIO_B0_02_ENET2_1588_EVENT0_OUT: IOMUXC_GPIO_B0_02_ENET2_1588_EVENT0_OUT {
		pinmux = <0x401F8144 0x8 0 0 0x401F8334>;
	};

	IOMUXC_GPIO_B0_03_LCD_VSYNC: IOMUXC_GPIO_B0_03_LCD_VSYNC {
		pinmux = <0x401F8148 0x0 0 0 0x401F8338>;
	};

	IOMUXC_GPIO_B0_03_QTIMER2_TIMER0: IOMUXC_GPIO_B0_03_QTIMER2_TIMER0 {
		pinmux = <0x401F8148 0x1 0x401F856C 0x1 0x401F8338>;
	};

	IOMUXC_GPIO_B0_03_FLEXCAN1_RX: IOMUXC_GPIO_B0_03_FLEXCAN1_RX {
		pinmux = <0x401F8148 0x2 0x401F844C 0x3 0x401F8338>;
	};

	IOMUXC_GPIO_B0_03_LPSPI4_SCK: IOMUXC_GPIO_B0_03_LPSPI4_SCK {
		pinmux = <0x401F8148 0x3 0x401F8520 0x0 0x401F8338>;
	};

	IOMUXC_GPIO_B0_03_FLEXIO2_FLEXIO03: IOMUXC_GPIO_B0_03_FLEXIO2_FLEXIO03 {
		pinmux = <0x401F8148 0x4 0 0 0x401F8338>;
	};

	IOMUXC_GPIO_B0_03_GPIO2_IO03: IOMUXC_GPIO_B0_03_GPIO2_IO03 {
		pinmux = <0x401F8148 0x5 0 0 0x401F8338>;
	};

	IOMUXC_GPIO_B0_03_WDOG2_RESET_B_DEB: IOMUXC_GPIO_B0_03_WDOG2_RESET_B_DEB {
		pinmux = <0x401F8148 0x6 0 0 0x401F8338>;
	};

	IOMUXC_GPIO_B0_03_ENET2_1588_EVENT0_IN: IOMUXC_GPIO_B0_03_ENET2_1588_EVENT0_IN {
		pinmux = <0x401F8148 0x8 0x401F8724 0x1 0x401F8338>;
	};

	IOMUXC_GPIO_B0_04_LCD_DATA00: IOMUXC_GPIO_B0_04_LCD_DATA00 {
		pinmux = <0x401F814C 0x0 0 0 0x401F833C>;
	};

	IOMUXC_GPIO_B0_04_QTIMER2_TIMER1: IOMUXC_GPIO_B0_04_QTIMER2_TIMER1 {
		pinmux = <0x401F814C 0x1 0x401F8570 0x1 0x401F833C>;
	};

	IOMUXC_GPIO_B0_04_LPI2C2_SCL: IOMUXC_GPIO_B0_04_LPI2C2_SCL {
		pinmux = <0x401F814C 0x2 0x401F84D4 0x1 0x401F833C>;
	};

	IOMUXC_GPIO_B0_04_ARM_TRACE0: IOMUXC_GPIO_B0_04_ARM_TRACE0 {
		pinmux = <0x401F814C 0x3 0 0 0x401F833C>;
	};

	IOMUXC_GPIO_B0_04_FLEXIO2_FLEXIO04: IOMUXC_GPIO_B0_04_FLEXIO2_FLEXIO04 {
		pinmux = <0x401F814C 0x4 0 0 0x401F833C>;
	};

	IOMUXC_GPIO_B0_04_GPIO2_IO04: IOMUXC_GPIO_B0_04_GPIO2_IO04 {
		pinmux = <0x401F814C 0x5 0 0 0x401F833C>;
	};

	IOMUXC_GPIO_B0_04_SRC_BOOT_CFG00: IOMUXC_GPIO_B0_04_SRC_BOOT_CFG00 {
		pinmux = <0x401F814C 0x6 0 0 0x401F833C>;
	};

	IOMUXC_GPIO_B0_04_ENET2_TDATA03: IOMUXC_GPIO_B0_04_ENET2_TDATA03 {
		pinmux = <0x401F814C 0x8 0 0 0x401F833C>;
	};

	IOMUXC_GPIO_B0_05_LCD_DATA01: IOMUXC_GPIO_B0_05_LCD_DATA01 {
		pinmux = <0x401F8150 0x0 0 0 0x401F8340>;
	};

	IOMUXC_GPIO_B0_05_QTIMER2_TIMER2: IOMUXC_GPIO_B0_05_QTIMER2_TIMER2 {
		pinmux = <0x401F8150 0x1 0x401F8574 0x1 0x401F8340>;
	};

	IOMUXC_GPIO_B0_05_LPI2C2_SDA: IOMUXC_GPIO_B0_05_LPI2C2_SDA {
		pinmux = <0x401F8150 0x2 0x401F84D8 0x1 0x401F8340>;
	};

	IOMUXC_GPIO_B0_05_ARM_TRACE1: IOMUXC_GPIO_B0_05_ARM_TRACE1 {
		pinmux = <0x401F8150 0x3 0 0 0x401F8340>;
	};

	IOMUXC_GPIO_B0_05_FLEXIO2_FLEXIO05: IOMUXC_GPIO_B0_05_FLEXIO2_FLEXIO05 {
		pinmux = <0x401F8150 0x4 0 0 0x401F8340>;
	};

	IOMUXC_GPIO_B0_05_GPIO2_IO05: IOMUXC_GPIO_B0_05_GPIO2_IO05 {
		pinmux = <0x401F8150 0x5 0 0 0x401F8340>;
	};

	IOMUXC_GPIO_B0_05_SRC_BOOT_CFG01: IOMUXC_GPIO_B0_05_SRC_BOOT_CFG01 {
		pinmux = <0x401F8150 0x6 0 0 0x401F8340>;
	};

	IOMUXC_GPIO_B0_05_ENET2_TDATA02: IOMUXC_GPIO_B0_05_ENET2_TDATA02 {
		pinmux = <0x401F8150 0x8 0 0 0x401F8340>;
	};

	IOMUXC_GPIO_B0_06_LCD_DATA02: IOMUXC_GPIO_B0_06_LCD_DATA02 {
		pinmux = <0x401F8154 0x0 0 0 0x401F8344>;
	};

	IOMUXC_GPIO_B0_06_QTIMER3_TIMER0: IOMUXC_GPIO_B0_06_QTIMER3_TIMER0 {
		pinmux = <0x401F8154 0x1 0x401F857C 0x2 0x401F8344>;
	};

	IOMUXC_GPIO_B0_06_FLEXPWM2_PWMA00: IOMUXC_GPIO_B0_06_FLEXPWM2_PWMA00 {
		pinmux = <0x401F8154 0x2 0x401F8478 0x1 0x401F8344>;
	};

	IOMUXC_GPIO_B0_06_ARM_TRACE2: IOMUXC_GPIO_B0_06_ARM_TRACE2 {
		pinmux = <0x401F8154 0x3 0 0 0x401F8344>;
	};

	IOMUXC_GPIO_B0_06_FLEXIO2_FLEXIO06: IOMUXC_GPIO_B0_06_FLEXIO2_FLEXIO06 {
		pinmux = <0x401F8154 0x4 0 0 0x401F8344>;
	};

	IOMUXC_GPIO_B0_06_GPIO2_IO06: IOMUXC_GPIO_B0_06_GPIO2_IO06 {
		pinmux = <0x401F8154 0x5 0 0 0x401F8344>;
	};

	IOMUXC_GPIO_B0_06_SRC_BOOT_CFG02: IOMUXC_GPIO_B0_06_SRC_BOOT_CFG02 {
		pinmux = <0x401F8154 0x6 0 0 0x401F8344>;
	};

	IOMUXC_GPIO_B0_06_ENET2_RX_CLK: IOMUXC_GPIO_B0_06_ENET2_RX_CLK {
		pinmux = <0x401F8154 0x8 0 0 0x401F8344>;
	};

	IOMUXC_GPIO_B0_07_LCD_DATA03: IOMUXC_GPIO_B0_07_LCD_DATA03 {
		pinmux = <0x401F8158 0x0 0 0 0x401F8348>;
	};

	IOMUXC_GPIO_B0_07_QTIMER3_TIMER1: IOMUXC_GPIO_B0_07_QTIMER3_TIMER1 {
		pinmux = <0x401F8158 0x1 0x401F8580 0x2 0x401F8348>;
	};

	IOMUXC_GPIO_B0_07_FLEXPWM2_PWMB00: IOMUXC_GPIO_B0_07_FLEXPWM2_PWMB00 {
		pinmux = <0x401F8158 0x2 0x401F8488 0x1 0x401F8348>;
	};

	IOMUXC_GPIO_B0_07_ARM_TRACE3: IOMUXC_GPIO_B0_07_ARM_TRACE3 {
		pinmux = <0x401F8158 0x3 0 0 0x401F8348>;
	};

	IOMUXC_GPIO_B0_07_FLEXIO2_FLEXIO07: IOMUXC_GPIO_B0_07_FLEXIO2_FLEXIO07 {
		pinmux = <0x401F8158 0x4 0 0 0x401F8348>;
	};

	IOMUXC_GPIO_B0_07_GPIO2_IO07: IOMUXC_GPIO_B0_07_GPIO2_IO07 {
		pinmux = <0x401F8158 0x5 0 0 0x401F8348>;
	};

	IOMUXC_GPIO_B0_07_SRC_BOOT_CFG03: IOMUXC_GPIO_B0_07_SRC_BOOT_CFG03 {
		pinmux = <0x401F8158 0x6 0 0 0x401F8348>;
	};

	IOMUXC_GPIO_B0_07_ENET2_TX_ER: IOMUXC_GPIO_B0_07_ENET2_TX_ER {
		pinmux = <0x401F8158 0x8 0 0 0x401F8348>;
	};

	IOMUXC_GPIO_B0_08_LCD_DATA04: IOMUXC_GPIO_B0_08_LCD_DATA04 {
		pinmux = <0x401F815C 0x0 0 0 0x401F834C>;
	};

	IOMUXC_GPIO_B0_08_QTIMER3_TIMER2: IOMUXC_GPIO_B0_08_QTIMER3_TIMER2 {
		pinmux = <0x401F815C 0x1 0x401F8584 0x2 0x401F834C>;
	};

	IOMUXC_GPIO_B0_08_FLEXPWM2_PWMA01: IOMUXC_GPIO_B0_08_FLEXPWM2_PWMA01 {
		pinmux = <0x401F815C 0x2 0x401F847C 0x1 0x401F834C>;
	};

	IOMUXC_GPIO_B0_08_LPUART3_TX: IOMUXC_GPIO_B0_08_LPUART3_TX {
		pinmux = <0x401F815C 0x3 0x401F853C 0x2 0x401F834C>;
	};

	IOMUXC_GPIO_B0_08_FLEXIO2_FLEXIO08: IOMUXC_GPIO_B0_08_FLEXIO2_FLEXIO08 {
		pinmux = <0x401F815C 0x4 0 0 0x401F834C>;
	};

	IOMUXC_GPIO_B0_08_GPIO2_IO08: IOMUXC_GPIO_B0_08_GPIO2_IO08 {
		pinmux = <0x401F815C 0x5 0 0 0x401F834C>;
	};

	IOMUXC_GPIO_B0_08_SRC_BOOT_CFG04: IOMUXC_GPIO_B0_08_SRC_BOOT_CFG04 {
		pinmux = <0x401F815C 0x6 0 0 0x401F834C>;
	};

	IOMUXC_GPIO_B0_08_ENET2_RDATA03: IOMUXC_GPIO_B0_08_ENET2_RDATA03 {
		pinmux = <0x401F815C 0x8 0 0 0x401F834C>;
	};

	IOMUXC_GPIO_B0_09_LCD_DATA05: IOMUXC_GPIO_B0_09_LCD_DATA05 {
		pinmux = <0x401F8160 0x0 0 0 0x401F8350>;
	};

	IOMUXC_GPIO_B0_09_QTIMER4_TIMER0: IOMUXC_GPIO_B0_09_QTIMER4_TIMER0 {
		pinmux = <0x401F8160 0x1 0 0 0x401F8350>;
	};

	IOMUXC_GPIO_B0_09_FLEXPWM2_PWMB01: IOMUXC_GPIO_B0_09_FLEXPWM2_PWMB01 {
		pinmux = <0x401F8160 0x2 0x401F848C 0x1 0x401F8350>;
	};

	IOMUXC_GPIO_B0_09_LPUART3_RX: IOMUXC_GPIO_B0_09_LPUART3_RX {
		pinmux = <0x401F8160 0x3 0x401F8538 0x2 0x401F8350>;
	};

	IOMUXC_GPIO_B0_09_FLEXIO2_FLEXIO09: IOMUXC_GPIO_B0_09_FLEXIO2_FLEXIO09 {
		pinmux = <0x401F8160 0x4 0 0 0x401F8350>;
	};

	IOMUXC_GPIO_B0_09_GPIO2_IO09: IOMUXC_GPIO_B0_09_GPIO2_IO09 {
		pinmux = <0x401F8160 0x5 0 0 0x401F8350>;
	};

	IOMUXC_GPIO_B0_09_SRC_BOOT_CFG05: IOMUXC_GPIO_B0_09_SRC_BOOT_CFG05 {
		pinmux = <0x401F8160 0x6 0 0 0x401F8350>;
	};

	IOMUXC_GPIO_B0_09_ENET2_RDATA02: IOMUXC_GPIO_B0_09_ENET2_RDATA02 {
		pinmux = <0x401F8160 0x8 0 0 0x401F8350>;
	};

	IOMUXC_GPIO_B0_10_LCD_DATA06: IOMUXC_GPIO_B0_10_LCD_DATA06 {
		pinmux = <0x401F8164 0x0 0 0 0x401F8354>;
	};

	IOMUXC_GPIO_B0_10_QTIMER4_TIMER1: IOMUXC_GPIO_B0_10_QTIMER4_TIMER1 {
		pinmux = <0x401F8164 0x1 0 0 0x401F8354>;
	};

	IOMUXC_GPIO_B0_10_FLEXPWM2_PWMA02: IOMUXC_GPIO_B0_10_FLEXPWM2_PWMA02 {
		pinmux = <0x401F8164 0x2 0x401F8480 0x1 0x401F8354>;
	};

	IOMUXC_GPIO_B0_10_SAI1_TX_DATA03: IOMUXC_GPIO_B0_10_SAI1_TX_DATA03 {
		pinmux = <0x401F8164 0x3 0x401F8598 0x1 0x401F8354>;
	};

	IOMUXC_GPIO_B0_10_FLEXIO2_FLEXIO10: IOMUXC_GPIO_B0_10_FLEXIO2_FLEXIO10 {
		pinmux = <0x401F8164 0x4 0 0 0x401F8354>;
	};

	IOMUXC_GPIO_B0_10_GPIO2_IO10: IOMUXC_GPIO_B0_10_GPIO2_IO10 {
		pinmux = <0x401F8164 0x5 0 0 0x401F8354>;
	};

	IOMUXC_GPIO_B0_10_SRC_BOOT_CFG06: IOMUXC_GPIO_B0_10_SRC_BOOT_CFG06 {
		pinmux = <0x401F8164 0x6 0 0 0x401F8354>;
	};

	IOMUXC_GPIO_B0_10_ENET2_CRS: IOMUXC_GPIO_B0_10_ENET2_CRS {
		pinmux = <0x401F8164 0x8 0 0 0x401F8354>;
	};

	IOMUXC_GPIO_B0_11_LCD_DATA07: IOMUXC_GPIO_B0_11_LCD_DATA07 {
		pinmux = <0x401F8168 0x0 0 0 0x401F8358>;
	};

	IOMUXC_GPIO_B0_11_QTIMER4_TIMER2: IOMUXC_GPIO_B0_11_QTIMER4_TIMER2 {
		pinmux = <0x401F8168 0x1 0 0 0x401F8358>;
	};

	IOMUXC_GPIO_B0_11_FLEXPWM2_PWMB02: IOMUXC_GPIO_B0_11_FLEXPWM2_PWMB02 {
		pinmux = <0x401F8168 0x2 0x401F8490 0x1 0x401F8358>;
	};

	IOMUXC_GPIO_B0_11_SAI1_TX_DATA02: IOMUXC_GPIO_B0_11_SAI1_TX_DATA02 {
		pinmux = <0x401F8168 0x3 0x401F859C 0x1 0x401F8358>;
	};

	IOMUXC_GPIO_B0_11_FLEXIO2_FLEXIO11: IOMUXC_GPIO_B0_11_FLEXIO2_FLEXIO11 {
		pinmux = <0x401F8168 0x4 0 0 0x401F8358>;
	};

	IOMUXC_GPIO_B0_11_GPIO2_IO11: IOMUXC_GPIO_B0_11_GPIO2_IO11 {
		pinmux = <0x401F8168 0x5 0 0 0x401F8358>;
	};

	IOMUXC_GPIO_B0_11_SRC_BOOT_CFG07: IOMUXC_GPIO_B0_11_SRC_BOOT_CFG07 {
		pinmux = <0x401F8168 0x6 0 0 0x401F8358>;
	};

	IOMUXC_GPIO_B0_11_ENET2_COL: IOMUXC_GPIO_B0_11_ENET2_COL {
		pinmux = <0x401F8168 0x8 0 0 0x401F8358>;
	};

	IOMUXC_GPIO_B0_12_LCD_DATA08: IOMUXC_GPIO_B0_12_LCD_DATA08 {
		pinmux = <0x401F816C 0x0 0 0 0x401F835C>;
	};

	IOMUXC_GPIO_B0_12_XBAR1_INOUT10: IOMUXC_GPIO_B0_12_XBAR1_INOUT10 {
		pinmux = <0x401F816C 0x1 0 0 0x401F835C>;
	};

	IOMUXC_GPIO_B0_12_ARM_TRACE_CLK: IOMUXC_GPIO_B0_12_ARM_TRACE_CLK {
		pinmux = <0x401F816C 0x2 0 0 0x401F835C>;
	};

	IOMUXC_GPIO_B0_12_SAI1_TX_DATA01: IOMUXC_GPIO_B0_12_SAI1_TX_DATA01 {
		pinmux = <0x401F816C 0x3 0x401F85A0 0x1 0x401F835C>;
	};

	IOMUXC_GPIO_B0_12_FLEXIO2_FLEXIO12: IOMUXC_GPIO_B0_12_FLEXIO2_FLEXIO12 {
		pinmux = <0x401F816C 0x4 0 0 0x401F835C>;
	};

	IOMUXC_GPIO_B0_12_GPIO2_IO12: IOMUXC_GPIO_B0_12_GPIO2_IO12 {
		pinmux = <0x401F816C 0x5 0 0 0x401F835C>;
	};

	IOMUXC_GPIO_B0_12_SRC_BOOT_CFG08: IOMUXC_GPIO_B0_12_SRC_BOOT_CFG08 {
		pinmux = <0x401F816C 0x6 0 0 0x401F835C>;
	};

	IOMUXC_GPIO_B0_12_ENET2_TDATA00: IOMUXC_GPIO_B0_12_ENET2_TDATA00 {
		pinmux = <0x401F816C 0x8 0 0 0x401F835C>;
	};

	IOMUXC_GPIO_B0_13_LCD_DATA09: IOMUXC_GPIO_B0_13_LCD_DATA09 {
		pinmux = <0x401F8170 0x0 0 0 0x401F8360>;
	};

	IOMUXC_GPIO_B0_13_XBAR1_INOUT11: IOMUXC_GPIO_B0_13_XBAR1_INOUT11 {
		pinmux = <0x401F8170 0x1 0 0 0x401F8360>;
	};

	IOMUXC_GPIO_B0_13_ARM_TRACE_SWO: IOMUXC_GPIO_B0_13_ARM_TRACE_SWO {
		pinmux = <0x401F8170 0x2 0 0 0x401F8360>;
	};

	IOMUXC_GPIO_B0_13_SAI1_MCLK: IOMUXC_GPIO_B0_13_SAI1_MCLK {
		pinmux = <0x401F8170 0x3 0x401F858C 0x2 0x401F8360>;
	};

	IOMUXC_GPIO_B0_13_FLEXIO2_FLEXIO13: IOMUXC_GPIO_B0_13_FLEXIO2_FLEXIO13 {
		pinmux = <0x401F8170 0x4 0 0 0x401F8360>;
	};

	IOMUXC_GPIO_B0_13_GPIO2_IO13: IOMUXC_GPIO_B0_13_GPIO2_IO13 {
		pinmux = <0x401F8170 0x5 0 0 0x401F8360>;
	};

	IOMUXC_GPIO_B0_13_SRC_BOOT_CFG09: IOMUXC_GPIO_B0_13_SRC_BOOT_CFG09 {
		pinmux = <0x401F8170 0x6 0 0 0x401F8360>;
	};

	IOMUXC_GPIO_B0_13_ENET2_TDATA01: IOMUXC_GPIO_B0_13_ENET2_TDATA01 {
		pinmux = <0x401F8170 0x8 0 0 0x401F8360>;
	};

	IOMUXC_GPIO_B0_14_LCD_DATA10: IOMUXC_GPIO_B0_14_LCD_DATA10 {
		pinmux = <0x401F8174 0x0 0 0 0x401F8364>;
	};

	IOMUXC_GPIO_B0_14_XBAR1_INOUT12: IOMUXC_GPIO_B0_14_XBAR1_INOUT12 {
		pinmux = <0x401F8174 0x1 0 0 0x401F8364>;
	};

	IOMUXC_GPIO_B0_14_ARM_TXEV: IOMUXC_GPIO_B0_14_ARM_TXEV {
		pinmux = <0x401F8174 0x2 0 0 0x401F8364>;
	};

	IOMUXC_GPIO_B0_14_SAI1_RX_SYNC: IOMUXC_GPIO_B0_14_SAI1_RX_SYNC {
		pinmux = <0x401F8174 0x3 0x401F85A4 0x2 0x401F8364>;
	};

	IOMUXC_GPIO_B0_14_FLEXIO2_FLEXIO14: IOMUXC_GPIO_B0_14_FLEXIO2_FLEXIO14 {
		pinmux = <0x401F8174 0x4 0 0 0x401F8364>;
	};

	IOMUXC_GPIO_B0_14_GPIO2_IO14: IOMUXC_GPIO_B0_14_GPIO2_IO14 {
		pinmux = <0x401F8174 0x5 0 0 0x401F8364>;
	};

	IOMUXC_GPIO_B0_14_SRC_BOOT_CFG10: IOMUXC_GPIO_B0_14_SRC_BOOT_CFG10 {
		pinmux = <0x401F8174 0x6 0 0 0x401F8364>;
	};

	IOMUXC_GPIO_B0_14_ENET2_TX_EN: IOMUXC_GPIO_B0_14_ENET2_TX_EN {
		pinmux = <0x401F8174 0x8 0 0 0x401F8364>;
	};

	IOMUXC_GPIO_B0_15_LCD_DATA11: IOMUXC_GPIO_B0_15_LCD_DATA11 {
		pinmux = <0x401F8178 0x0 0 0 0x401F8368>;
	};

	IOMUXC_GPIO_B0_15_XBAR1_INOUT13: IOMUXC_GPIO_B0_15_XBAR1_INOUT13 {
		pinmux = <0x401F8178 0x1 0 0 0x401F8368>;
	};

	IOMUXC_GPIO_B0_15_ARM_RXEV: IOMUXC_GPIO_B0_15_ARM_RXEV {
		pinmux = <0x401F8178 0x2 0 0 0x401F8368>;
	};

	IOMUXC_GPIO_B0_15_SAI1_RX_BCLK: IOMUXC_GPIO_B0_15_SAI1_RX_BCLK {
		pinmux = <0x401F8178 0x3 0x401F8590 0x2 0x401F8368>;
	};

	IOMUXC_GPIO_B0_15_FLEXIO2_FLEXIO15: IOMUXC_GPIO_B0_15_FLEXIO2_FLEXIO15 {
		pinmux = <0x401F8178 0x4 0 0 0x401F8368>;
	};

	IOMUXC_GPIO_B0_15_GPIO2_IO15: IOMUXC_GPIO_B0_15_GPIO2_IO15 {
		pinmux = <0x401F8178 0x5 0 0 0x401F8368>;
	};

	IOMUXC_GPIO_B0_15_SRC_BOOT_CFG11: IOMUXC_GPIO_B0_15_SRC_BOOT_CFG11 {
		pinmux = <0x401F8178 0x6 0 0 0x401F8368>;
	};

	IOMUXC_GPIO_B0_15_ENET2_TX_CLK: IOMUXC_GPIO_B0_15_ENET2_TX_CLK {
		pinmux = <0x401F8178 0x8 0x401F8728 0x2 0x401F8368>;
	};

	IOMUXC_GPIO_B0_15_ENET2_REF_CLK2: IOMUXC_GPIO_B0_15_ENET2_REF_CLK2 {
		pinmux = <0x401F8178 0x9 0x401F870C 0x2 0x401F8368>;
	};

	IOMUXC_GPIO_B1_00_LCD_DATA12: IOMUXC_GPIO_B1_00_LCD_DATA12 {
		pinmux = <0x401F817C 0x0 0 0 0x401F836C>;
	};

	IOMUXC_GPIO_B1_00_XBAR1_INOUT14: IOMUXC_GPIO_B1_00_XBAR1_INOUT14 {
		pinmux = <0x401F817C 0x1 0x401F8644 0x1 0x401F836C>;
	};

	IOMUXC_GPIO_B1_00_LPUART4_TX: IOMUXC_GPIO_B1_00_LPUART4_TX {
		pinmux = <0x401F817C 0x2 0x401F8544 0x2 0x401F836C>;
	};

	IOMUXC_GPIO_B1_00_SAI1_RX_DATA00: IOMUXC_GPIO_B1_00_SAI1_RX_DATA00 {
		pinmux = <0x401F817C 0x3 0x401F8594 0x2 0x401F836C>;
	};

	IOMUXC_GPIO_B1_00_FLEXIO2_FLEXIO16: IOMUXC_GPIO_B1_00_FLEXIO2_FLEXIO16 {
		pinmux = <0x401F817C 0x4 0 0 0x401F836C>;
	};

	IOMUXC_GPIO_B1_00_GPIO2_IO16: IOMUXC_GPIO_B1_00_GPIO2_IO16 {
		pinmux = <0x401F817C 0x5 0 0 0x401F836C>;
	};

	IOMUXC_GPIO_B1_00_FLEXPWM1_PWMA03: IOMUXC_GPIO_B1_00_FLEXPWM1_PWMA03 {
		pinmux = <0x401F817C 0x6 0x401F8454 0x4 0x401F836C>;
	};

	IOMUXC_GPIO_B1_00_ENET2_RX_ER: IOMUXC_GPIO_B1_00_ENET2_RX_ER {
		pinmux = <0x401F817C 0x8 0x401F8720 0x2 0x401F836C>;
	};

	IOMUXC_GPIO_B1_00_FLEXIO3_FLEXIO16: IOMUXC_GPIO_B1_00_FLEXIO3_FLEXIO16 {
		pinmux = <0x401F817C 0x9 0 0 0x401F836C>;
	};

	IOMUXC_GPIO_B1_01_LCD_DATA13: IOMUXC_GPIO_B1_01_LCD_DATA13 {
		pinmux = <0x401F8180 0x0 0 0 0x401F8370>;
	};

	IOMUXC_GPIO_B1_01_XBAR1_INOUT15: IOMUXC_GPIO_B1_01_XBAR1_INOUT15 {
		pinmux = <0x401F8180 0x1 0x401F8648 0x1 0x401F8370>;
	};

	IOMUXC_GPIO_B1_01_LPUART4_RX: IOMUXC_GPIO_B1_01_LPUART4_RX {
		pinmux = <0x401F8180 0x2 0x401F8540 0x2 0x401F8370>;
	};

	IOMUXC_GPIO_B1_01_SAI1_TX_DATA00: IOMUXC_GPIO_B1_01_SAI1_TX_DATA00 {
		pinmux = <0x401F8180 0x3 0 0 0x401F8370>;
	};

	IOMUXC_GPIO_B1_01_FLEXIO2_FLEXIO17: IOMUXC_GPIO_B1_01_FLEXIO2_FLEXIO17 {
		pinmux = <0x401F8180 0x4 0 0 0x401F8370>;
	};

	IOMUXC_GPIO_B1_01_GPIO2_IO17: IOMUXC_GPIO_B1_01_GPIO2_IO17 {
		pinmux = <0x401F8180 0x5 0 0 0x401F8370>;
	};

	IOMUXC_GPIO_B1_01_FLEXPWM1_PWMB03: IOMUXC_GPIO_B1_01_FLEXPWM1_PWMB03 {
		pinmux = <0x401F8180 0x6 0x401F8464 0x4 0x401F8370>;
	};

	IOMUXC_GPIO_B1_01_ENET2_RDATA00: IOMUXC_GPIO_B1_01_ENET2_RDATA00 {
		pinmux = <0x401F8180 0x8 0x401F8714 0x2 0x401F8370>;
	};

	IOMUXC_GPIO_B1_01_FLEXIO3_FLEXIO17: IOMUXC_GPIO_B1_01_FLEXIO3_FLEXIO17 {
		pinmux = <0x401F8180 0x9 0 0 0x401F8370>;
	};

	IOMUXC_GPIO_B1_02_LCD_DATA14: IOMUXC_GPIO_B1_02_LCD_DATA14 {
		pinmux = <0x401F8184 0x0 0 0 0x401F8374>;
	};

	IOMUXC_GPIO_B1_02_XBAR1_INOUT16: IOMUXC_GPIO_B1_02_XBAR1_INOUT16 {
		pinmux = <0x401F8184 0x1 0x401F864C 0x1 0x401F8374>;
	};

	IOMUXC_GPIO_B1_02_LPSPI4_PCS2: IOMUXC_GPIO_B1_02_LPSPI4_PCS2 {
		pinmux = <0x401F8184 0x2 0 0 0x401F8374>;
	};

	IOMUXC_GPIO_B1_02_SAI1_TX_BCLK: IOMUXC_GPIO_B1_02_SAI1_TX_BCLK {
		pinmux = <0x401F8184 0x3 0x401F85A8 0x2 0x401F8374>;
	};

	IOMUXC_GPIO_B1_02_FLEXIO2_FLEXIO18: IOMUXC_GPIO_B1_02_FLEXIO2_FLEXIO18 {
		pinmux = <0x401F8184 0x4 0 0 0x401F8374>;
	};

	IOMUXC_GPIO_B1_02_GPIO2_IO18: IOMUXC_GPIO_B1_02_GPIO2_IO18 {
		pinmux = <0x401F8184 0x5 0 0 0x401F8374>;
	};

	IOMUXC_GPIO_B1_02_FLEXPWM2_PWMA03: IOMUXC_GPIO_B1_02_FLEXPWM2_PWMA03 {
		pinmux = <0x401F8184 0x6 0x401F8474 0x4 0x401F8374>;
	};

	IOMUXC_GPIO_B1_02_ENET2_RDATA01: IOMUXC_GPIO_B1_02_ENET2_RDATA01 {
		pinmux = <0x401F8184 0x8 0x401F8718 0x2 0x401F8374>;
	};

	IOMUXC_GPIO_B1_02_FLEXIO3_FLEXIO18: IOMUXC_GPIO_B1_02_FLEXIO3_FLEXIO18 {
		pinmux = <0x401F8184 0x9 0 0 0x401F8374>;
	};

	IOMUXC_GPIO_B1_03_LCD_DATA15: IOMUXC_GPIO_B1_03_LCD_DATA15 {
		pinmux = <0x401F8188 0x0 0 0 0x401F8378>;
	};

	IOMUXC_GPIO_B1_03_XBAR1_INOUT17: IOMUXC_GPIO_B1_03_XBAR1_INOUT17 {
		pinmux = <0x401F8188 0x1 0x401F862C 0x3 0x401F8378>;
	};

	IOMUXC_GPIO_B1_03_LPSPI4_PCS1: IOMUXC_GPIO_B1_03_LPSPI4_PCS1 {
		pinmux = <0x401F8188 0x2 0 0 0x401F8378>;
	};

	IOMUXC_GPIO_B1_03_SAI1_TX_SYNC: IOMUXC_GPIO_B1_03_SAI1_TX_SYNC {
		pinmux = <0x401F8188 0x3 0x401F85AC 0x2 0x401F8378>;
	};

	IOMUXC_GPIO_B1_03_FLEXIO2_FLEXIO19: IOMUXC_GPIO_B1_03_FLEXIO2_FLEXIO19 {
		pinmux = <0x401F8188 0x4 0 0 0x401F8378>;
	};

	IOMUXC_GPIO_B1_03_GPIO2_IO19: IOMUXC_GPIO_B1_03_GPIO2_IO19 {
		pinmux = <0x401F8188 0x5 0 0 0x401F8378>;
	};

	IOMUXC_GPIO_B1_03_FLEXPWM2_PWMB03: IOMUXC_GPIO_B1_03_FLEXPWM2_PWMB03 {
		pinmux = <0x401F8188 0x6 0x401F8484 0x3 0x401F8378>;
	};

	IOMUXC_GPIO_B1_03_ENET2_RX_EN: IOMUXC_GPIO_B1_03_ENET2_RX_EN {
		pinmux = <0x401F8188 0x8 0x401F871C 0x2 0x401F8378>;
	};

	IOMUXC_GPIO_B1_03_FLEXIO3_FLEXIO19: IOMUXC_GPIO_B1_03_FLEXIO3_FLEXIO19 {
		pinmux = <0x401F8188 0x9 0 0 0x401F8378>;
	};

	IOMUXC_GPIO_B1_04_LCD_DATA16: IOMUXC_GPIO_B1_04_LCD_DATA16 {
		pinmux = <0x401F818C 0x0 0 0 0x401F837C>;
	};

	IOMUXC_GPIO_B1_04_LPSPI4_PCS0: IOMUXC_GPIO_B1_04_LPSPI4_PCS0 {
		pinmux = <0x401F818C 0x1 0x401F851C 0x1 0x401F837C>;
	};

	IOMUXC_GPIO_B1_04_CSI_DATA15: IOMUXC_GPIO_B1_04_CSI_DATA15 {
		pinmux = <0x401F818C 0x2 0 0 0x401F837C>;
	};

	IOMUXC_GPIO_B1_04_ENET_RX_DATA00: IOMUXC_GPIO_B1_04_ENET_RX_DATA00 {
		pinmux = <0x401F818C 0x3 0x401F8434 0x1 0x401F837C>;
	};

	IOMUXC_GPIO_B1_04_FLEXIO2_FLEXIO20: IOMUXC_GPIO_B1_04_FLEXIO2_FLEXIO20 {
		pinmux = <0x401F818C 0x4 0 0 0x401F837C>;
	};

	IOMUXC_GPIO_B1_04_GPIO2_IO20: IOMUXC_GPIO_B1_04_GPIO2_IO20 {
		pinmux = <0x401F818C 0x5 0 0 0x401F837C>;
	};

	IOMUXC_GPIO_B1_04_GPT1_CLK: IOMUXC_GPIO_B1_04_GPT1_CLK {
		pinmux = <0x401F818C 0x8 0x401F8760 0x1 0x401F837C>;
	};

	IOMUXC_GPIO_B1_04_FLEXIO3_FLEXIO20: IOMUXC_GPIO_B1_04_FLEXIO3_FLEXIO20 {
		pinmux = <0x401F818C 0x9 0 0 0x401F837C>;
	};

	IOMUXC_GPIO_B1_05_LCD_DATA17: IOMUXC_GPIO_B1_05_LCD_DATA17 {
		pinmux = <0x401F8190 0x0 0 0 0x401F8380>;
	};

	IOMUXC_GPIO_B1_05_LPSPI4_SDI: IOMUXC_GPIO_B1_05_LPSPI4_SDI {
		pinmux = <0x401F8190 0x1 0x401F8524 0x1 0x401F8380>;
	};

	IOMUXC_GPIO_B1_05_CSI_DATA14: IOMUXC_GPIO_B1_05_CSI_DATA14 {
		pinmux = <0x401F8190 0x2 0 0 0x401F8380>;
	};

	IOMUXC_GPIO_B1_05_ENET_RX_DATA01: IOMUXC_GPIO_B1_05_ENET_RX_DATA01 {
		pinmux = <0x401F8190 0x3 0x401F8438 0x1 0x401F8380>;
	};

	IOMUXC_GPIO_B1_05_FLEXIO2_FLEXIO21: IOMUXC_GPIO_B1_05_FLEXIO2_FLEXIO21 {
		pinmux = <0x401F8190 0x4 0 0 0x401F8380>;
	};

	IOMUXC_GPIO_B1_05_GPIO2_IO21: IOMUXC_GPIO_B1_05_GPIO2_IO21 {
		pinmux = <0x401F8190 0x5 0 0 0x401F8380>;
	};

	IOMUXC_GPIO_B1_05_GPT1_CAPTURE1: IOMUXC_GPIO_B1_05_GPT1_CAPTURE1 {
		pinmux = <0x401F8190 0x8 0x401F8758 0x1 0x401F8380>;
	};

	IOMUXC_GPIO_B1_05_FLEXIO3_FLEXIO21: IOMUXC_GPIO_B1_05_FLEXIO3_FLEXIO21 {
		pinmux = <0x401F8190 0x9 0 0 0x401F8380>;
	};

	IOMUXC_GPIO_B1_06_LCD_DATA18: IOMUXC_GPIO_B1_06_LCD_DATA18 {
		pinmux = <0x401F8194 0x0 0 0 0x401F8384>;
	};

	IOMUXC_GPIO_B1_06_LPSPI4_SDO: IOMUXC_GPIO_B1_06_LPSPI4_SDO {
		pinmux = <0x401F8194 0x1 0x401F8528 0x1 0x401F8384>;
	};

	IOMUXC_GPIO_B1_06_CSI_DATA13: IOMUXC_GPIO_B1_06_CSI_DATA13 {
		pinmux = <0x401F8194 0x2 0 0 0x401F8384>;
	};

	IOMUXC_GPIO_B1_06_ENET_RX_EN: IOMUXC_GPIO_B1_06_ENET_RX_EN {
		pinmux = <0x401F8194 0x3 0x401F843C 0x1 0x401F8384>;
	};

	IOMUXC_GPIO_B1_06_FLEXIO2_FLEXIO22: IOMUXC_GPIO_B1_06_FLEXIO2_FLEXIO22 {
		pinmux = <0x401F8194 0x4 0 0 0x401F8384>;
	};

	IOMUXC_GPIO_B1_06_GPIO2_IO22: IOMUXC_GPIO_B1_06_GPIO2_IO22 {
		pinmux = <0x401F8194 0x5 0 0 0x401F8384>;
	};

	IOMUXC_GPIO_B1_06_GPT1_CAPTURE2: IOMUXC_GPIO_B1_06_GPT1_CAPTURE2 {
		pinmux = <0x401F8194 0x8 0x401F875C 0x1 0x401F8384>;
	};

	IOMUXC_GPIO_B1_06_FLEXIO3_FLEXIO22: IOMUXC_GPIO_B1_06_FLEXIO3_FLEXIO22 {
		pinmux = <0x401F8194 0x9 0 0 0x401F8384>;
	};

	IOMUXC_GPIO_B1_07_LCD_DATA19: IOMUXC_GPIO_B1_07_LCD_DATA19 {
		pinmux = <0x401F8198 0x0 0 0 0x401F8388>;
	};

	IOMUXC_GPIO_B1_07_LPSPI4_SCK: IOMUXC_GPIO_B1_07_LPSPI4_SCK {
		pinmux = <0x401F8198 0x1 0x401F8520 0x1 0x401F8388>;
	};

	IOMUXC_GPIO_B1_07_CSI_DATA12: IOMUXC_GPIO_B1_07_CSI_DATA12 {
		pinmux = <0x401F8198 0x2 0 0 0x401F8388>;
	};

	IOMUXC_GPIO_B1_07_ENET_TX_DATA00: IOMUXC_GPIO_B1_07_ENET_TX_DATA00 {
		pinmux = <0x401F8198 0x3 0 0 0x401F8388>;
	};

	IOMUXC_GPIO_B1_07_FLEXIO2_FLEXIO23: IOMUXC_GPIO_B1_07_FLEXIO2_FLEXIO23 {
		pinmux = <0x401F8198 0x4 0 0 0x401F8388>;
	};

	IOMUXC_GPIO_B1_07_GPIO2_IO23: IOMUXC_GPIO_B1_07_GPIO2_IO23 {
		pinmux = <0x401F8198 0x5 0 0 0x401F8388>;
	};

	IOMUXC_GPIO_B1_07_GPT1_COMPARE1: IOMUXC_GPIO_B1_07_GPT1_COMPARE1 {
		pinmux = <0x401F8198 0x8 0 0 0x401F8388>;
	};

	IOMUXC_GPIO_B1_07_FLEXIO3_FLEXIO23: IOMUXC_GPIO_B1_07_FLEXIO3_FLEXIO23 {
		pinmux = <0x401F8198 0x9 0 0 0x401F8388>;
	};

	IOMUXC_GPIO_B1_08_LCD_DATA20: IOMUXC_GPIO_B1_08_LCD_DATA20 {
		pinmux = <0x401F819C 0x0 0 0 0x401F838C>;
	};

	IOMUXC_GPIO_B1_08_QTIMER1_TIMER3: IOMUXC_GPIO_B1_08_QTIMER1_TIMER3 {
		pinmux = <0x401F819C 0x1 0 0 0x401F838C>;
	};

	IOMUXC_GPIO_B1_08_CSI_DATA11: IOMUXC_GPIO_B1_08_CSI_DATA11 {
		pinmux = <0x401F819C 0x2 0 0 0x401F838C>;
	};

	IOMUXC_GPIO_B1_08_ENET_TX_DATA01: IOMUXC_GPIO_B1_08_ENET_TX_DATA01 {
		pinmux = <0x401F819C 0x3 0 0 0x401F838C>;
	};

	IOMUXC_GPIO_B1_08_FLEXIO2_FLEXIO24: IOMUXC_GPIO_B1_08_FLEXIO2_FLEXIO24 {
		pinmux = <0x401F819C 0x4 0 0 0x401F838C>;
	};

	IOMUXC_GPIO_B1_08_GPIO2_IO24: IOMUXC_GPIO_B1_08_GPIO2_IO24 {
		pinmux = <0x401F819C 0x5 0 0 0x401F838C>;
	};

	IOMUXC_GPIO_B1_08_FLEXCAN2_TX: IOMUXC_GPIO_B1_08_FLEXCAN2_TX {
		pinmux = <0x401F819C 0x6 0 0 0x401F838C>;
	};

	IOMUXC_GPIO_B1_08_GPT1_COMPARE2: IOMUXC_GPIO_B1_08_GPT1_COMPARE2 {
		pinmux = <0x401F819C 0x8 0 0 0x401F838C>;
	};

	IOMUXC_GPIO_B1_08_FLEXIO3_FLEXIO24: IOMUXC_GPIO_B1_08_FLEXIO3_FLEXIO24 {
		pinmux = <0x401F819C 0x9 0 0 0x401F838C>;
	};

	IOMUXC_GPIO_B1_09_LCD_DATA21: IOMUXC_GPIO_B1_09_LCD_DATA21 {
		pinmux = <0x401F81A0 0x0 0 0 0x401F8390>;
	};

	IOMUXC_GPIO_B1_09_QTIMER2_TIMER3: IOMUXC_GPIO_B1_09_QTIMER2_TIMER3 {
		pinmux = <0x401F81A0 0x1 0x401F8578 0x1 0x401F8390>;
	};

	IOMUXC_GPIO_B1_09_CSI_DATA10: IOMUXC_GPIO_B1_09_CSI_DATA10 {
		pinmux = <0x401F81A0 0x2 0 0 0x401F8390>;
	};

	IOMUXC_GPIO_B1_09_ENET_TX_EN: IOMUXC_GPIO_B1_09_ENET_TX_EN {
		pinmux = <0x401F81A0 0x3 0 0 0x401F8390>;
	};

	IOMUXC_GPIO_B1_09_FLEXIO2_FLEXIO25: IOMUXC_GPIO_B1_09_FLEXIO2_FLEXIO25 {
		pinmux = <0x401F81A0 0x4 0 0 0x401F8390>;
	};

	IOMUXC_GPIO_B1_09_GPIO2_IO25: IOMUXC_GPIO_B1_09_GPIO2_IO25 {
		pinmux = <0x401F81A0 0x5 0 0 0x401F8390>;
	};

	IOMUXC_GPIO_B1_09_FLEXCAN2_RX: IOMUXC_GPIO_B1_09_FLEXCAN2_RX {
		pinmux = <0x401F81A0 0x6 0x401F8450 0x3 0x401F8390>;
	};

	IOMUXC_GPIO_B1_09_GPT1_COMPARE3: IOMUXC_GPIO_B1_09_GPT1_COMPARE3 {
		pinmux = <0x401F81A0 0x8 0 0 0x401F8390>;
	};

	IOMUXC_GPIO_B1_09_FLEXIO3_FLEXIO25: IOMUXC_GPIO_B1_09_FLEXIO3_FLEXIO25 {
		pinmux = <0x401F81A0 0x9 0 0 0x401F8390>;
	};

	IOMUXC_GPIO_B1_10_LCD_DATA22: IOMUXC_GPIO_B1_10_LCD_DATA22 {
		pinmux = <0x401F81A4 0x0 0 0 0x401F8394>;
	};

	IOMUXC_GPIO_B1_10_QTIMER3_TIMER3: IOMUXC_GPIO_B1_10_QTIMER3_TIMER3 {
		pinmux = <0x401F81A4 0x1 0x401F8588 0x2 0x401F8394>;
	};

	IOMUXC_GPIO_B1_10_CSI_DATA00: IOMUXC_GPIO_B1_10_CSI_DATA00 {
		pinmux = <0x401F81A4 0x2 0 0 0x401F8394>;
	};

	IOMUXC_GPIO_B1_10_ENET_TX_CLK: IOMUXC_GPIO_B1_10_ENET_TX_CLK {
		pinmux = <0x401F81A4 0x3 0x401F8448 0x1 0x401F8394>;
	};

	IOMUXC_GPIO_B1_10_FLEXIO2_FLEXIO26: IOMUXC_GPIO_B1_10_FLEXIO2_FLEXIO26 {
		pinmux = <0x401F81A4 0x4 0 0 0x401F8394>;
	};

	IOMUXC_GPIO_B1_10_GPIO2_IO26: IOMUXC_GPIO_B1_10_GPIO2_IO26 {
		pinmux = <0x401F81A4 0x5 0 0 0x401F8394>;
	};

	IOMUXC_GPIO_B1_10_ENET_REF_CLK: IOMUXC_GPIO_B1_10_ENET_REF_CLK {
		pinmux = <0x401F81A4 0x6 0x401F842C 0x1 0x401F8394>;
	};

	IOMUXC_GPIO_B1_10_FLEXIO3_FLEXIO26: IOMUXC_GPIO_B1_10_FLEXIO3_FLEXIO26 {
		pinmux = <0x401F81A4 0x9 0 0 0x401F8394>;
	};

	IOMUXC_GPIO_B1_11_LCD_DATA23: IOMUXC_GPIO_B1_11_LCD_DATA23 {
		pinmux = <0x401F81A8 0x0 0 0 0x401F8398>;
	};

	IOMUXC_GPIO_B1_11_QTIMER4_TIMER3: IOMUXC_GPIO_B1_11_QTIMER4_TIMER3 {
		pinmux = <0x401F81A8 0x1 0 0 0x401F8398>;
	};

	IOMUXC_GPIO_B1_11_CSI_DATA01: IOMUXC_GPIO_B1_11_CSI_DATA01 {
		pinmux = <0x401F81A8 0x2 0 0 0x401F8398>;
	};

	IOMUXC_GPIO_B1_11_ENET_RX_ER: IOMUXC_GPIO_B1_11_ENET_RX_ER {
		pinmux = <0x401F81A8 0x3 0x401F8440 0x1 0x401F8398>;
	};

	IOMUXC_GPIO_B1_11_FLEXIO2_FLEXIO27: IOMUXC_GPIO_B1_11_FLEXIO2_FLEXIO27 {
		pinmux = <0x401F81A8 0x4 0 0 0x401F8398>;
	};

	IOMUXC_GPIO_B1_11_GPIO2_IO27: IOMUXC_GPIO_B1_11_GPIO2_IO27 {
		pinmux = <0x401F81A8 0x5 0 0 0x401F8398>;
	};

	IOMUXC_GPIO_B1_11_LPSPI4_PCS3: IOMUXC_GPIO_B1_11_LPSPI4_PCS3 {
		pinmux = <0x401F81A8 0x6 0 0 0x401F8398>;
	};

	IOMUXC_GPIO_B1_11_FLEXIO3_FLEXIO27: IOMUXC_GPIO_B1_11_FLEXIO3_FLEXIO27 {
		pinmux = <0x401F81A8 0x9 0 0 0x401F8398>;
	};

	IOMUXC_GPIO_B1_12_LPUART5_TX: IOMUXC_GPIO_B1_12_LPUART5_TX {
		pinmux = <0x401F81AC 0x1 0x401F854C 0x1 0x401F839C>;
	};

	IOMUXC_GPIO_B1_12_CSI_PIXCLK: IOMUXC_GPIO_B1_12_CSI_PIXCLK {
		pinmux = <0x401F81AC 0x2 0x401F8424 0x1 0x401F839C>;
	};

	IOMUXC_GPIO_B1_12_ENET_1588_EVENT0_IN: IOMUXC_GPIO_B1_12_ENET_1588_EVENT0_IN {
		pinmux = <0x401F81AC 0x3 0x401F8444 0x2 0x401F839C>;
	};

	IOMUXC_GPIO_B1_12_FLEXIO2_FLEXIO28: IOMUXC_GPIO_B1_12_FLEXIO2_FLEXIO28 {
		pinmux = <0x401F81AC 0x4 0 0 0x401F839C>;
	};

	IOMUXC_GPIO_B1_12_GPIO2_IO28: IOMUXC_GPIO_B1_12_GPIO2_IO28 {
		pinmux = <0x401F81AC 0x5 0 0 0x401F839C>;
	};

	IOMUXC_GPIO_B1_12_USDHC1_CD_B: IOMUXC_GPIO_B1_12_USDHC1_CD_B {
		pinmux = <0x401F81AC 0x6 0x401F85D4 0x2 0x401F839C>;
	};

	IOMUXC_GPIO_B1_12_FLEXIO3_FLEXIO28: IOMUXC_GPIO_B1_12_FLEXIO3_FLEXIO28 {
		pinmux = <0x401F81AC 0x9 0 0 0x401F839C>;
	};

	IOMUXC_GPIO_B1_13_WDOG1_B: IOMUXC_GPIO_B1_13_WDOG1_B {
		pinmux = <0x401F81B0 0x0 0 0 0x401F83A0>;
	};

	IOMUXC_GPIO_B1_13_LPUART5_RX: IOMUXC_GPIO_B1_13_LPUART5_RX {
		pinmux = <0x401F81B0 0x1 0x401F8548 0x1 0x401F83A0>;
	};

	IOMUXC_GPIO_B1_13_CSI_VSYNC: IOMUXC_GPIO_B1_13_CSI_VSYNC {
		pinmux = <0x401F81B0 0x2 0x401F8428 0x2 0x401F83A0>;
	};

	IOMUXC_GPIO_B1_13_ENET_1588_EVENT0_OUT: IOMUXC_GPIO_B1_13_ENET_1588_EVENT0_OUT {
		pinmux = <0x401F81B0 0x3 0 0 0x401F83A0>;
	};

	IOMUXC_GPIO_B1_13_FLEXIO2_FLEXIO29: IOMUXC_GPIO_B1_13_FLEXIO2_FLEXIO29 {
		pinmux = <0x401F81B0 0x4 0 0 0x401F83A0>;
	};

	IOMUXC_GPIO_B1_13_GPIO2_IO29: IOMUXC_GPIO_B1_13_GPIO2_IO29 {
		pinmux = <0x401F81B0 0x5 0 0 0x401F83A0>;
	};

	IOMUXC_GPIO_B1_13_USDHC1_WP: IOMUXC_GPIO_B1_13_USDHC1_WP {
		pinmux = <0x401F81B0 0x6 0x401F85D8 0x3 0x401F83A0>;
	};

	IOMUXC_GPIO_B1_13_SEMC_DQS4: IOMUXC_GPIO_B1_13_SEMC_DQS4 {
		pinmux = <0x401F81B0 0x8 0x401F8788 0x3 0x401F83A0>;
	};

	IOMUXC_GPIO_B1_13_FLEXIO3_FLEXIO29: IOMUXC_GPIO_B1_13_FLEXIO3_FLEXIO29 {
		pinmux = <0x401F81B0 0x9 0 0 0x401F83A0>;
	};

	IOMUXC_GPIO_B1_14_ENET_MDC: IOMUXC_GPIO_B1_14_ENET_MDC {
		pinmux = <0x401F81B4 0x0 0 0 0x401F83A4>;
	};

	IOMUXC_GPIO_B1_14_FLEXPWM4_PWMA02: IOMUXC_GPIO_B1_14_FLEXPWM4_PWMA02 {
		pinmux = <0x401F81B4 0x1 0x401F849C 0x1 0x401F83A4>;
	};

	IOMUXC_GPIO_B1_14_CSI_HSYNC: IOMUXC_GPIO_B1_14_CSI_HSYNC {
		pinmux = <0x401F81B4 0x2 0x401F8420 0x2 0x401F83A4>;
	};

	IOMUXC_GPIO_B1_14_XBAR1_IN02: IOMUXC_GPIO_B1_14_XBAR1_IN02 {
		pinmux = <0x401F81B4 0x3 0x401F860C 0x1 0x401F83A4>;
	};

	IOMUXC_GPIO_B1_14_FLEXIO2_FLEXIO30: IOMUXC_GPIO_B1_14_FLEXIO2_FLEXIO30 {
		pinmux = <0x401F81B4 0x4 0 0 0x401F83A4>;
	};

	IOMUXC_GPIO_B1_14_GPIO2_IO30: IOMUXC_GPIO_B1_14_GPIO2_IO30 {
		pinmux = <0x401F81B4 0x5 0 0 0x401F83A4>;
	};

	IOMUXC_GPIO_B1_14_USDHC1_VSELECT: IOMUXC_GPIO_B1_14_USDHC1_VSELECT {
		pinmux = <0x401F81B4 0x6 0 0 0x401F83A4>;
	};

	IOMUXC_GPIO_B1_14_ENET2_TDATA00: IOMUXC_GPIO_B1_14_ENET2_TDATA00 {
		pinmux = <0x401F81B4 0x8 0 0 0x401F83A4>;
	};

	IOMUXC_GPIO_B1_14_FLEXIO3_FLEXIO30: IOMUXC_GPIO_B1_14_FLEXIO3_FLEXIO30 {
		pinmux = <0x401F81B4 0x9 0 0 0x401F83A4>;
	};

	IOMUXC_GPIO_B1_15_ENET_MDIO: IOMUXC_GPIO_B1_15_ENET_MDIO {
		pinmux = <0x401F81B8 0x0 0x401F8430 0x2 0x401F83A8>;
	};

	IOMUXC_GPIO_B1_15_FLEXPWM4_PWMA03: IOMUXC_GPIO_B1_15_FLEXPWM4_PWMA03 {
		pinmux = <0x401F81B8 0x1 0x401F84A0 0x1 0x401F83A8>;
	};

	IOMUXC_GPIO_B1_15_CSI_MCLK: IOMUXC_GPIO_B1_15_CSI_MCLK {
		pinmux = <0x401F81B8 0x2 0 0 0x401F83A8>;
	};

	IOMUXC_GPIO_B1_15_XBAR1_IN03: IOMUXC_GPIO_B1_15_XBAR1_IN03 {
		pinmux = <0x401F81B8 0x3 0x401F8610 0x1 0x401F83A8>;
	};

	IOMUXC_GPIO_B1_15_FLEXIO2_FLEXIO31: IOMUXC_GPIO_B1_15_FLEXIO2_FLEXIO31 {
		pinmux = <0x401F81B8 0x4 0 0 0x401F83A8>;
	};

	IOMUXC_GPIO_B1_15_GPIO2_IO31: IOMUXC_GPIO_B1_15_GPIO2_IO31 {
		pinmux = <0x401F81B8 0x5 0 0 0x401F83A8>;
	};

	IOMUXC_GPIO_B1_15_USDHC1_RESET_B: IOMUXC_GPIO_B1_15_USDHC1_RESET_B {
		pinmux = <0x401F81B8 0x6 0 0 0x401F83A8>;
	};

	IOMUXC_GPIO_B1_15_ENET2_TDATA01: IOMUXC_GPIO_B1_15_ENET2_TDATA01 {
		pinmux = <0x401F81B8 0x8 0 0 0x401F83A8>;
	};

	IOMUXC_GPIO_B1_15_FLEXIO3_FLEXIO31: IOMUXC_GPIO_B1_15_FLEXIO3_FLEXIO31 {
		pinmux = <0x401F81B8 0x9 0 0 0x401F83A8>;
	};

	IOMUXC_GPIO_SD_B0_00_USDHC1_CMD: IOMUXC_GPIO_SD_B0_00_USDHC1_CMD {
		pinmux = <0x401F81BC 0x0 0 0 0x401F83AC>;
	};

	IOMUXC_GPIO_SD_B0_00_FLEXPWM1_PWMA00: IOMUXC_GPIO_SD_B0_00_FLEXPWM1_PWMA00 {
		pinmux = <0x401F81BC 0x1 0x401F8458 0x1 0x401F83AC>;
	};

	IOMUXC_GPIO_SD_B0_00_LPI2C3_SCL: IOMUXC_GPIO_SD_B0_00_LPI2C3_SCL {
		pinmux = <0x401F81BC 0x2 0x401F84DC 0x1 0x401F83AC>;
	};

	IOMUXC_GPIO_SD_B0_00_XBAR1_INOUT04: IOMUXC_GPIO_SD_B0_00_XBAR1_INOUT04 {
		pinmux = <0x401F81BC 0x3 0x401F8614 0x1 0x401F83AC>;
	};

	IOMUXC_GPIO_SD_B0_00_LPSPI1_SCK: IOMUXC_GPIO_SD_B0_00_LPSPI1_SCK {
		pinmux = <0x401F81BC 0x4 0x401F84F0 0x1 0x401F83AC>;
	};

	IOMUXC_GPIO_SD_B0_00_GPIO3_IO12: IOMUXC_GPIO_SD_B0_00_GPIO3_IO12 {
		pinmux = <0x401F81BC 0x5 0 0 0x401F83AC>;
	};

	IOMUXC_GPIO_SD_B0_00_FLEXSPIA_SS1_B: IOMUXC_GPIO_SD_B0_00_FLEXSPIA_SS1_B {
		pinmux = <0x401F81BC 0x6 0 0 0x401F83AC>;
	};

	IOMUXC_GPIO_SD_B0_00_ENET2_TX_EN: IOMUXC_GPIO_SD_B0_00_ENET2_TX_EN {
		pinmux = <0x401F81BC 0x8 0 0 0x401F83AC>;
	};

	IOMUXC_GPIO_SD_B0_00_SEMC_DQS4: IOMUXC_GPIO_SD_B0_00_SEMC_DQS4 {
		pinmux = <0x401F81BC 0x9 0x401F8788 0x0 0x401F83AC>;
	};

	IOMUXC_GPIO_SD_B0_01_USDHC1_CLK: IOMUXC_GPIO_SD_B0_01_USDHC1_CLK {
		pinmux = <0x401F81C0 0x0 0 0 0x401F83B0>;
	};

	IOMUXC_GPIO_SD_B0_01_FLEXPWM1_PWMB00: IOMUXC_GPIO_SD_B0_01_FLEXPWM1_PWMB00 {
		pinmux = <0x401F81C0 0x1 0x401F8468 0x1 0x401F83B0>;
	};

	IOMUXC_GPIO_SD_B0_01_LPI2C3_SDA: IOMUXC_GPIO_SD_B0_01_LPI2C3_SDA {
		pinmux = <0x401F81C0 0x2 0x401F84E0 0x1 0x401F83B0>;
	};

	IOMUXC_GPIO_SD_B0_01_XBAR1_INOUT05: IOMUXC_GPIO_SD_B0_01_XBAR1_INOUT05 {
		pinmux = <0x401F81C0 0x3 0x401F8618 0x1 0x401F83B0>;
	};

	IOMUXC_GPIO_SD_B0_01_LPSPI1_PCS0: IOMUXC_GPIO_SD_B0_01_LPSPI1_PCS0 {
		pinmux = <0x401F81C0 0x4 0x401F84EC 0x0 0x401F83B0>;
	};

	IOMUXC_GPIO_SD_B0_01_GPIO3_IO13: IOMUXC_GPIO_SD_B0_01_GPIO3_IO13 {
		pinmux = <0x401F81C0 0x5 0 0 0x401F83B0>;
	};

	IOMUXC_GPIO_SD_B0_01_FLEXSPIB_SS1_B: IOMUXC_GPIO_SD_B0_01_FLEXSPIB_SS1_B {
		pinmux = <0x401F81C0 0x6 0 0 0x401F83B0>;
	};

	IOMUXC_GPIO_SD_B0_01_ENET2_TX_CLK: IOMUXC_GPIO_SD_B0_01_ENET2_TX_CLK {
		pinmux = <0x401F81C0 0x8 0x401F8728 0x1 0x401F83B0>;
	};

	IOMUXC_GPIO_SD_B0_01_ENET2_REF_CLK2: IOMUXC_GPIO_SD_B0_01_ENET2_REF_CLK2 {
		pinmux = <0x401F81C0 0x9 0x401F870C 0x1 0x401F83B0>;
	};

	IOMUXC_GPIO_SD_B0_02_USDHC1_DATA0: IOMUXC_GPIO_SD_B0_02_USDHC1_DATA0 {
		pinmux = <0x401F81C4 0x0 0 0 0x401F83B4>;
	};

	IOMUXC_GPIO_SD_B0_02_FLEXPWM1_PWMA01: IOMUXC_GPIO_SD_B0_02_FLEXPWM1_PWMA01 {
		pinmux = <0x401F81C4 0x1 0x401F845C 0x1 0x401F83B4>;
	};

	IOMUXC_GPIO_SD_B0_02_LPUART8_CTS_B: IOMUXC_GPIO_SD_B0_02_LPUART8_CTS_B {
		pinmux = <0x401F81C4 0x2 0 0 0x401F83B4>;
	};

	IOMUXC_GPIO_SD_B0_02_XBAR1_INOUT06: IOMUXC_GPIO_SD_B0_02_XBAR1_INOUT06 {
		pinmux = <0x401F81C4 0x3 0x401F861C 0x1 0x401F83B4>;
	};

	IOMUXC_GPIO_SD_B0_02_LPSPI1_SDO: IOMUXC_GPIO_SD_B0_02_LPSPI1_SDO {
		pinmux = <0x401F81C4 0x4 0x401F84F8 0x1 0x401F83B4>;
	};

	IOMUXC_GPIO_SD_B0_02_GPIO3_IO14: IOMUXC_GPIO_SD_B0_02_GPIO3_IO14 {
		pinmux = <0x401F81C4 0x5 0 0 0x401F83B4>;
	};

	IOMUXC_GPIO_SD_B0_02_ENET2_RX_ER: IOMUXC_GPIO_SD_B0_02_ENET2_RX_ER {
		pinmux = <0x401F81C4 0x8 0x401F8720 0x1 0x401F83B4>;
	};

	IOMUXC_GPIO_SD_B0_02_SEMC_CLK5: IOMUXC_GPIO_SD_B0_02_SEMC_CLK5 {
		pinmux = <0x401F81C4 0x9 0 0 0x401F83B4>;
	};

	IOMUXC_GPIO_SD_B0_03_USDHC1_DATA1: IOMUXC_GPIO_SD_B0_03_USDHC1_DATA1 {
		pinmux = <0x401F81C8 0x0 0 0 0x401F83B8>;
	};

	IOMUXC_GPIO_SD_B0_03_FLEXPWM1_PWMB01: IOMUXC_GPIO_SD_B0_03_FLEXPWM1_PWMB01 {
		pinmux = <0x401F81C8 0x1 0x401F846C 0x1 0x401F83B8>;
	};

	IOMUXC_GPIO_SD_B0_03_LPUART8_RTS_B: IOMUXC_GPIO_SD_B0_03_LPUART8_RTS_B {
		pinmux = <0x401F81C8 0x2 0 0 0x401F83B8>;
	};

	IOMUXC_GPIO_SD_B0_03_XBAR1_INOUT07: IOMUXC_GPIO_SD_B0_03_XBAR1_INOUT07 {
		pinmux = <0x401F81C8 0x3 0x401F8620 0x1 0x401F83B8>;
	};

	IOMUXC_GPIO_SD_B0_03_LPSPI1_SDI: IOMUXC_GPIO_SD_B0_03_LPSPI1_SDI {
		pinmux = <0x401F81C8 0x4 0x401F84F4 0x1 0x401F83B8>;
	};

	IOMUXC_GPIO_SD_B0_03_GPIO3_IO15: IOMUXC_GPIO_SD_B0_03_GPIO3_IO15 {
		pinmux = <0x401F81C8 0x5 0 0 0x401F83B8>;
	};

	IOMUXC_GPIO_SD_B0_03_ENET2_RDATA00: IOMUXC_GPIO_SD_B0_03_ENET2_RDATA00 {
		pinmux = <0x401F81C8 0x8 0x401F8714 0x1 0x401F83B8>;
	};

	IOMUXC_GPIO_SD_B0_03_SEMC_CLK6: IOMUXC_GPIO_SD_B0_03_SEMC_CLK6 {
		pinmux = <0x401F81C8 0x9 0 0 0x401F83B8>;
	};

	IOMUXC_GPIO_SD_B0_04_USDHC1_DATA2: IOMUXC_GPIO_SD_B0_04_USDHC1_DATA2 {
		pinmux = <0x401F81CC 0x0 0 0 0x401F83BC>;
	};

	IOMUXC_GPIO_SD_B0_04_FLEXPWM1_PWMA02: IOMUXC_GPIO_SD_B0_04_FLEXPWM1_PWMA02 {
		pinmux = <0x401F81CC 0x1 0x401F8460 0x1 0x401F83BC>;
	};

	IOMUXC_GPIO_SD_B0_04_LPUART8_TX: IOMUXC_GPIO_SD_B0_04_LPUART8_TX {
		pinmux = <0x401F81CC 0x2 0x401F8564 0x0 0x401F83BC>;
	};

	IOMUXC_GPIO_SD_B0_04_XBAR1_INOUT08: IOMUXC_GPIO_SD_B0_04_XBAR1_INOUT08 {
		pinmux = <0x401F81CC 0x3 0x401F8624 0x1 0x401F83BC>;
	};

	IOMUXC_GPIO_SD_B0_04_FLEXSPIB_SS0_B: IOMUXC_GPIO_SD_B0_04_FLEXSPIB_SS0_B {
		pinmux = <0x401F81CC 0x4 0 0 0x401F83BC>;
	};

	IOMUXC_GPIO_SD_B0_04_GPIO3_IO16: IOMUXC_GPIO_SD_B0_04_GPIO3_IO16 {
		pinmux = <0x401F81CC 0x5 0 0 0x401F83BC>;
	};

	IOMUXC_GPIO_SD_B0_04_CCM_CLKO1: IOMUXC_GPIO_SD_B0_04_CCM_CLKO1 {
		pinmux = <0x401F81CC 0x6 0 0 0x401F83BC>;
	};

	IOMUXC_GPIO_SD_B0_04_ENET2_RDATA01: IOMUXC_GPIO_SD_B0_04_ENET2_RDATA01 {
		pinmux = <0x401F81CC 0x8 0x401F8718 0x1 0x401F83BC>;
	};

	IOMUXC_GPIO_SD_B0_05_USDHC1_DATA3: IOMUXC_GPIO_SD_B0_05_USDHC1_DATA3 {
		pinmux = <0x401F81D0 0x0 0 0 0x401F83C0>;
	};

	IOMUXC_GPIO_SD_B0_05_FLEXPWM1_PWMB02: IOMUXC_GPIO_SD_B0_05_FLEXPWM1_PWMB02 {
		pinmux = <0x401F81D0 0x1 0x401F8470 0x1 0x401F83C0>;
	};

	IOMUXC_GPIO_SD_B0_05_LPUART8_RX: IOMUXC_GPIO_SD_B0_05_LPUART8_RX {
		pinmux = <0x401F81D0 0x2 0x401F8560 0x0 0x401F83C0>;
	};

	IOMUXC_GPIO_SD_B0_05_XBAR1_INOUT09: IOMUXC_GPIO_SD_B0_05_XBAR1_INOUT09 {
		pinmux = <0x401F81D0 0x3 0x401F8628 0x1 0x401F83C0>;
	};

	IOMUXC_GPIO_SD_B0_05_FLEXSPIB_DQS: IOMUXC_GPIO_SD_B0_05_FLEXSPIB_DQS {
		pinmux = <0x401F81D0 0x4 0 0 0x401F83C0>;
	};

	IOMUXC_GPIO_SD_B0_05_GPIO3_IO17: IOMUXC_GPIO_SD_B0_05_GPIO3_IO17 {
		pinmux = <0x401F81D0 0x5 0 0 0x401F83C0>;
	};

	IOMUXC_GPIO_SD_B0_05_CCM_CLKO2: IOMUXC_GPIO_SD_B0_05_CCM_CLKO2 {
		pinmux = <0x401F81D0 0x6 0 0 0x401F83C0>;
	};

	IOMUXC_GPIO_SD_B0_05_ENET2_RX_EN: IOMUXC_GPIO_SD_B0_05_ENET2_RX_EN {
		pinmux = <0x401F81D0 0x8 0x401F871C 0x1 0x401F83C0>;
	};

	IOMUXC_GPIO_SD_B1_00_USDHC2_DATA3: IOMUXC_GPIO_SD_B1_00_USDHC2_DATA3 {
		pinmux = <0x401F81D4 0x0 0x401F85F4 0x0 0x401F83C4>;
	};

	IOMUXC_GPIO_SD_B1_00_FLEXSPIB_DATA03: IOMUXC_GPIO_SD_B1_00_FLEXSPIB_DATA03 {
		pinmux = <0x401F81D4 0x1 0x401F84C4 0x0 0x401F83C4>;
	};

	IOMUXC_GPIO_SD_B1_00_FLEXPWM1_PWMA03: IOMUXC_GPIO_SD_B1_00_FLEXPWM1_PWMA03 {
		pinmux = <0x401F81D4 0x2 0x401F8454 0x0 0x401F83C4>;
	};

	IOMUXC_GPIO_SD_B1_00_SAI1_TX_DATA03: IOMUXC_GPIO_SD_B1_00_SAI1_TX_DATA03 {
		pinmux = <0x401F81D4 0x3 0x401F8598 0x0 0x401F83C4>;
	};

	IOMUXC_GPIO_SD_B1_00_LPUART4_TX: IOMUXC_GPIO_SD_B1_00_LPUART4_TX {
		pinmux = <0x401F81D4 0x4 0x401F8544 0x0 0x401F83C4>;
	};

	IOMUXC_GPIO_SD_B1_00_GPIO3_IO00: IOMUXC_GPIO_SD_B1_00_GPIO3_IO00 {
		pinmux = <0x401F81D4 0x5 0 0 0x401F83C4>;
	};

	IOMUXC_GPIO_SD_B1_00_SAI3_RX_DATA: IOMUXC_GPIO_SD_B1_00_SAI3_RX_DATA {
		pinmux = <0x401F81D4 0x8 0x401F8778 0x1 0x401F83C4>;
	};

	IOMUXC_GPIO_SD_B1_01_USDHC2_DATA2: IOMUXC_GPIO_SD_B1_01_USDHC2_DATA2 {
		pinmux = <0x401F81D8 0x0 0x401F85F0 0x0 0x401F83C8>;
	};

	IOMUXC_GPIO_SD_B1_01_FLEXSPIB_DATA02: IOMUXC_GPIO_SD_B1_01_FLEXSPIB_DATA02 {
		pinmux = <0x401F81D8 0x1 0x401F84C0 0x0 0x401F83C8>;
	};

	IOMUXC_GPIO_SD_B1_01_FLEXPWM1_PWMB03: IOMUXC_GPIO_SD_B1_01_FLEXPWM1_PWMB03 {
		pinmux = <0x401F81D8 0x2 0x401F8464 0x0 0x401F83C8>;
	};

	IOMUXC_GPIO_SD_B1_01_SAI1_TX_DATA02: IOMUXC_GPIO_SD_B1_01_SAI1_TX_DATA02 {
		pinmux = <0x401F81D8 0x3 0x401F859C 0x0 0x401F83C8>;
	};

	IOMUXC_GPIO_SD_B1_01_LPUART4_RX: IOMUXC_GPIO_SD_B1_01_LPUART4_RX {
		pinmux = <0x401F81D8 0x4 0x401F8540 0x0 0x401F83C8>;
	};

	IOMUXC_GPIO_SD_B1_01_GPIO3_IO01: IOMUXC_GPIO_SD_B1_01_GPIO3_IO01 {
		pinmux = <0x401F81D8 0x5 0 0 0x401F83C8>;
	};

	IOMUXC_GPIO_SD_B1_01_SAI3_TX_DATA: IOMUXC_GPIO_SD_B1_01_SAI3_TX_DATA {
		pinmux = <0x401F81D8 0x8 0 0 0x401F83C8>;
	};

	IOMUXC_GPIO_SD_B1_02_USDHC2_DATA1: IOMUXC_GPIO_SD_B1_02_USDHC2_DATA1 {
		pinmux = <0x401F81DC 0x0 0x401F85EC 0x0 0x401F83CC>;
	};

	IOMUXC_GPIO_SD_B1_02_FLEXSPIB_DATA01: IOMUXC_GPIO_SD_B1_02_FLEXSPIB_DATA01 {
		pinmux = <0x401F81DC 0x1 0x401F84BC 0x0 0x401F83CC>;
	};

	IOMUXC_GPIO_SD_B1_02_FLEXPWM2_PWMA03: IOMUXC_GPIO_SD_B1_02_FLEXPWM2_PWMA03 {
		pinmux = <0x401F81DC 0x2 0x401F8474 0x0 0x401F83CC>;
	};

	IOMUXC_GPIO_SD_B1_02_SAI1_TX_DATA01: IOMUXC_GPIO_SD_B1_02_SAI1_TX_DATA01 {
		pinmux = <0x401F81DC 0x3 0x401F85A0 0x0 0x401F83CC>;
	};

	IOMUXC_GPIO_SD_B1_02_FLEXCAN1_TX: IOMUXC_GPIO_SD_B1_02_FLEXCAN1_TX {
		pinmux = <0x401F81DC 0x4 0 0 0x401F83CC>;
	};

	IOMUXC_GPIO_SD_B1_02_GPIO3_IO02: IOMUXC_GPIO_SD_B1_02_GPIO3_IO02 {
		pinmux = <0x401F81DC 0x5 0 0 0x401F83CC>;
	};

	IOMUXC_GPIO_SD_B1_02_CCM_WAIT: IOMUXC_GPIO_SD_B1_02_CCM_WAIT {
		pinmux = <0x401F81DC 0x6 0 0 0x401F83CC>;
	};

	IOMUXC_GPIO_SD_B1_02_SAI3_TX_SYNC: IOMUXC_GPIO_SD_B1_02_SAI3_TX_SYNC {
		pinmux = <0x401F81DC 0x8 0x401F8784 0x1 0x401F83CC>;
	};

	IOMUXC_GPIO_SD_B1_03_USDHC2_DATA0: IOMUXC_GPIO_SD_B1_03_USDHC2_DATA0 {
		pinmux = <0x401F81E0 0x0 0x401F85E8 0x0 0x401F83D0>;
	};

	IOMUXC_GPIO_SD_B1_03_FLEXSPIB_DATA00: IOMUXC_GPIO_SD_B1_03_FLEXSPIB_DATA00 {
		pinmux = <0x401F81E0 0x1 0x401F84B8 0x0 0x401F83D0>;
	};

	IOMUXC_GPIO_SD_B1_03_FLEXPWM2_PWMB03: IOMUXC_GPIO_SD_B1_03_FLEXPWM2_PWMB03 {
		pinmux = <0x401F81E0 0x2 0x401F8484 0x0 0x401F83D0>;
	};

	IOMUXC_GPIO_SD_B1_03_SAI1_MCLK: IOMUXC_GPIO_SD_B1_03_SAI1_MCLK {
		pinmux = <0x401F81E0 0x3 0x401F858C 0x0 0x401F83D0>;
	};

	IOMUXC_GPIO_SD_B1_03_FLEXCAN1_RX: IOMUXC_GPIO_SD_B1_03_FLEXCAN1_RX {
		pinmux = <0x401F81E0 0x4 0x401F844C 0x0 0x401F83D0>;
	};

	IOMUXC_GPIO_SD_B1_03_GPIO3_IO03: IOMUXC_GPIO_SD_B1_03_GPIO3_IO03 {
		pinmux = <0x401F81E0 0x5 0 0 0x401F83D0>;
	};

	IOMUXC_GPIO_SD_B1_03_CCM_PMIC_READY: IOMUXC_GPIO_SD_B1_03_CCM_PMIC_READY {
		pinmux = <0x401F81E0 0x6 0x401F83FC 0x0 0x401F83D0>;
	};

	IOMUXC_GPIO_SD_B1_03_SAI3_TX_BCLK: IOMUXC_GPIO_SD_B1_03_SAI3_TX_BCLK {
		pinmux = <0x401F81E0 0x8 0x401F8780 0x1 0x401F83D0>;
	};

	IOMUXC_GPIO_SD_B1_04_USDHC2_CLK: IOMUXC_GPIO_SD_B1_04_USDHC2_CLK {
		pinmux = <0x401F81E4 0x0 0x401F85DC 0x0 0x401F83D4>;
	};

	IOMUXC_GPIO_SD_B1_04_FLEXSPIB_SCLK: IOMUXC_GPIO_SD_B1_04_FLEXSPIB_SCLK {
		pinmux = <0x401F81E4 0x1 0 0 0x401F83D4>;
	};

	IOMUXC_GPIO_SD_B1_04_LPI2C1_SCL: IOMUXC_GPIO_SD_B1_04_LPI2C1_SCL {
		pinmux = <0x401F81E4 0x2 0x401F84CC 0x0 0x401F83D4>;
	};

	IOMUXC_GPIO_SD_B1_04_SAI1_RX_SYNC: IOMUXC_GPIO_SD_B1_04_SAI1_RX_SYNC {
		pinmux = <0x401F81E4 0x3 0x401F85A4 0x0 0x401F83D4>;
	};

	IOMUXC_GPIO_SD_B1_04_FLEXSPIA_SS1_B: IOMUXC_GPIO_SD_B1_04_FLEXSPIA_SS1_B {
		pinmux = <0x401F81E4 0x4 0 0 0x401F83D4>;
	};

	IOMUXC_GPIO_SD_B1_04_GPIO3_IO04: IOMUXC_GPIO_SD_B1_04_GPIO3_IO04 {
		pinmux = <0x401F81E4 0x5 0 0 0x401F83D4>;
	};

	IOMUXC_GPIO_SD_B1_04_CCM_STOP: IOMUXC_GPIO_SD_B1_04_CCM_STOP {
		pinmux = <0x401F81E4 0x6 0 0 0x401F83D4>;
	};

	IOMUXC_GPIO_SD_B1_04_SAI3_MCLK: IOMUXC_GPIO_SD_B1_04_SAI3_MCLK {
		pinmux = <0x401F81E4 0x8 0x401F8770 0x1 0x401F83D4>;
	};

	IOMUXC_GPIO_SD_B1_05_USDHC2_CMD: IOMUXC_GPIO_SD_B1_05_USDHC2_CMD {
		pinmux = <0x401F81E8 0x0 0x401F85E4 0x0 0x401F83D8>;
	};

	IOMUXC_GPIO_SD_B1_05_FLEXSPIA_DQS: IOMUXC_GPIO_SD_B1_05_FLEXSPIA_DQS {
		pinmux = <0x401F81E8 0x1 0x401F84A4 0x0 0x401F83D8>;
	};

	IOMUXC_GPIO_SD_B1_05_LPI2C1_SDA: IOMUXC_GPIO_SD_B1_05_LPI2C1_SDA {
		pinmux = <0x401F81E8 0x2 0x401F84D0 0x0 0x401F83D8>;
	};

	IOMUXC_GPIO_SD_B1_05_SAI1_RX_BCLK: IOMUXC_GPIO_SD_B1_05_SAI1_RX_BCLK {
		pinmux = <0x401F81E8 0x3 0x401F8590 0x0 0x401F83D8>;
	};

	IOMUXC_GPIO_SD_B1_05_FLEXSPIB_SS0_B: IOMUXC_GPIO_SD_B1_05_FLEXSPIB_SS0_B {
		pinmux = <0x401F81E8 0x4 0 0 0x401F83D8>;
	};

	IOMUXC_GPIO_SD_B1_05_GPIO3_IO05: IOMUXC_GPIO_SD_B1_05_GPIO3_IO05 {
		pinmux = <0x401F81E8 0x5 0 0 0x401F83D8>;
	};

	IOMUXC_GPIO_SD_B1_05_SAI3_RX_SYNC: IOMUXC_GPIO_SD_B1_05_SAI3_RX_SYNC {
		pinmux = <0x401F81E8 0x8 0x401F877C 0x1 0x401F83D8>;
	};

	IOMUXC_GPIO_SD_B1_06_USDHC2_RESET_B: IOMUXC_GPIO_SD_B1_06_USDHC2_RESET_B {
		pinmux = <0x401F81EC 0x0 0 0 0x401F83DC>;
	};

	IOMUXC_GPIO_SD_B1_06_FLEXSPIA_SS0_B: IOMUXC_GPIO_SD_B1_06_FLEXSPIA_SS0_B {
		pinmux = <0x401F81EC 0x1 0 0 0x401F83DC>;
	};

	IOMUXC_GPIO_SD_B1_06_LPUART7_CTS_B: IOMUXC_GPIO_SD_B1_06_LPUART7_CTS_B {
		pinmux = <0x401F81EC 0x2 0 0 0x401F83DC>;
	};

	IOMUXC_GPIO_SD_B1_06_SAI1_RX_DATA00: IOMUXC_GPIO_SD_B1_06_SAI1_RX_DATA00 {
		pinmux = <0x401F81EC 0x3 0x401F8594 0x0 0x401F83DC>;
	};

	IOMUXC_GPIO_SD_B1_06_LPSPI2_PCS0: IOMUXC_GPIO_SD_B1_06_LPSPI2_PCS0 {
		pinmux = <0x401F81EC 0x4 0x401F84FC 0x0 0x401F83DC>;
	};

	IOMUXC_GPIO_SD_B1_06_GPIO3_IO06: IOMUXC_GPIO_SD_B1_06_GPIO3_IO06 {
		pinmux = <0x401F81EC 0x5 0 0 0x401F83DC>;
	};

	IOMUXC_GPIO_SD_B1_06_SAI3_RX_BCLK: IOMUXC_GPIO_SD_B1_06_SAI3_RX_BCLK {
		pinmux = <0x401F81EC 0x8 0x401F8774 0x1 0x401F83DC>;
	};

	IOMUXC_GPIO_SD_B1_07_SEMC_CSX01: IOMUXC_GPIO_SD_B1_07_SEMC_CSX01 {
		pinmux = <0x401F81F0 0x0 0 0 0x401F83E0>;
	};

	IOMUXC_GPIO_SD_B1_07_FLEXSPIA_SCLK: IOMUXC_GPIO_SD_B1_07_FLEXSPIA_SCLK {
		pinmux = <0x401F81F0 0x1 0x401F84C8 0x0 0x401F83E0>;
	};

	IOMUXC_GPIO_SD_B1_07_LPUART7_RTS_B: IOMUXC_GPIO_SD_B1_07_LPUART7_RTS_B {
		pinmux = <0x401F81F0 0x2 0 0 0x401F83E0>;
	};

	IOMUXC_GPIO_SD_B1_07_SAI1_TX_DATA00: IOMUXC_GPIO_SD_B1_07_SAI1_TX_DATA00 {
		pinmux = <0x401F81F0 0x3 0 0 0x401F83E0>;
	};

	IOMUXC_GPIO_SD_B1_07_LPSPI2_SCK: IOMUXC_GPIO_SD_B1_07_LPSPI2_SCK {
		pinmux = <0x401F81F0 0x4 0x401F8500 0x0 0x401F83E0>;
	};

	IOMUXC_GPIO_SD_B1_07_GPIO3_IO07: IOMUXC_GPIO_SD_B1_07_GPIO3_IO07 {
		pinmux = <0x401F81F0 0x5 0 0 0x401F83E0>;
	};

	IOMUXC_GPIO_SD_B1_08_USDHC2_DATA4: IOMUXC_GPIO_SD_B1_08_USDHC2_DATA4 {
		pinmux = <0x401F81F4 0x0 0x401F85F8 0x0 0x401F83E4>;
	};

	IOMUXC_GPIO_SD_B1_08_FLEXSPIA_DATA00: IOMUXC_GPIO_SD_B1_08_FLEXSPIA_DATA00 {
		pinmux = <0x401F81F4 0x1 0x401F84A8 0x0 0x401F83E4>;
	};

	IOMUXC_GPIO_SD_B1_08_LPUART7_TX: IOMUXC_GPIO_SD_B1_08_LPUART7_TX {
		pinmux = <0x401F81F4 0x2 0x401F855C 0x0 0x401F83E4>;
	};

	IOMUXC_GPIO_SD_B1_08_SAI1_TX_BCLK: IOMUXC_GPIO_SD_B1_08_SAI1_TX_BCLK {
		pinmux = <0x401F81F4 0x3 0x401F85A8 0x0 0x401F83E4>;
	};

	IOMUXC_GPIO_SD_B1_08_LPSPI2_SD0: IOMUXC_GPIO_SD_B1_08_LPSPI2_SD0 {
		pinmux = <0x401F81F4 0x4 0x401F8508 0x0 0x401F83E4>;
	};

	IOMUXC_GPIO_SD_B1_08_GPIO3_IO08: IOMUXC_GPIO_SD_B1_08_GPIO3_IO08 {
		pinmux = <0x401F81F4 0x5 0 0 0x401F83E4>;
	};

	IOMUXC_GPIO_SD_B1_08_SEMC_CSX02: IOMUXC_GPIO_SD_B1_08_SEMC_CSX02 {
		pinmux = <0x401F81F4 0x6 0 0 0x401F83E4>;
	};

	IOMUXC_GPIO_SD_B1_09_USDHC2_DATA5: IOMUXC_GPIO_SD_B1_09_USDHC2_DATA5 {
		pinmux = <0x401F81F8 0x0 0x401F85FC 0x0 0x401F83E8>;
	};

	IOMUXC_GPIO_SD_B1_09_FLEXSPIA_DATA01: IOMUXC_GPIO_SD_B1_09_FLEXSPIA_DATA01 {
		pinmux = <0x401F81F8 0x1 0x401F84AC 0x0 0x401F83E8>;
	};

	IOMUXC_GPIO_SD_B1_09_LPUART7_RX: IOMUXC_GPIO_SD_B1_09_LPUART7_RX {
		pinmux = <0x401F81F8 0x2 0x401F8558 0x0 0x401F83E8>;
	};

	IOMUXC_GPIO_SD_B1_09_SAI1_TX_SYNC: IOMUXC_GPIO_SD_B1_09_SAI1_TX_SYNC {
		pinmux = <0x401F81F8 0x3 0x401F85AC 0x0 0x401F83E8>;
	};

	IOMUXC_GPIO_SD_B1_09_LPSPI2_SDI: IOMUXC_GPIO_SD_B1_09_LPSPI2_SDI {
		pinmux = <0x401F81F8 0x4 0x401F8504 0x0 0x401F83E8>;
	};

	IOMUXC_GPIO_SD_B1_09_GPIO3_IO09: IOMUXC_GPIO_SD_B1_09_GPIO3_IO09 {
		pinmux = <0x401F81F8 0x5 0 0 0x401F83E8>;
	};

	IOMUXC_GPIO_SD_B1_10_USDHC2_DATA6: IOMUXC_GPIO_SD_B1_10_USDHC2_DATA6 {
		pinmux = <0x401F81FC 0x0 0x401F8600 0x0 0x401F83EC>;
	};

	IOMUXC_GPIO_SD_B1_10_FLEXSPIA_DATA02: IOMUXC_GPIO_SD_B1_10_FLEXSPIA_DATA02 {
		pinmux = <0x401F81FC 0x1 0x401F84B0 0x0 0x401F83EC>;
	};

	IOMUXC_GPIO_SD_B1_10_LPUART2_RX: IOMUXC_GPIO_SD_B1_10_LPUART2_RX {
		pinmux = <0x401F81FC 0x2 0x401F852C 0x0 0x401F83EC>;
	};

	IOMUXC_GPIO_SD_B1_10_LPI2C2_SDA: IOMUXC_GPIO_SD_B1_10_LPI2C2_SDA {
		pinmux = <0x401F81FC 0x3 0x401F84D8 0x0 0x401F83EC>;
	};

	IOMUXC_GPIO_SD_B1_10_LPSPI2_PCS2: IOMUXC_GPIO_SD_B1_10_LPSPI2_PCS2 {
		pinmux = <0x401F81FC 0x4 0 0 0x401F83EC>;
	};

	IOMUXC_GPIO_SD_B1_10_GPIO3_IO10: IOMUXC_GPIO_SD_B1_10_GPIO3_IO10 {
		pinmux = <0x401F81FC 0x5 0 0 0x401F83EC>;
	};

	IOMUXC_GPIO_SD_B1_11_USDHC2_DATA7: IOMUXC_GPIO_SD_B1_11_USDHC2_DATA7 {
		pinmux = <0x401F8200 0x0 0x401F8604 0x0 0x401F83F0>;
	};

	IOMUXC_GPIO_SD_B1_11_FLEXSPIA_DATA03: IOMUXC_GPIO_SD_B1_11_FLEXSPIA_DATA03 {
		pinmux = <0x401F8200 0x1 0x401F84B4 0x0 0x401F83F0>;
	};

	IOMUXC_GPIO_SD_B1_11_LPUART2_TX: IOMUXC_GPIO_SD_B1_11_LPUART2_TX {
		pinmux = <0x401F8200 0x2 0x401F8530 0x0 0x401F83F0>;
	};

	IOMUXC_GPIO_SD_B1_11_LPI2C2_SCL: IOMUXC_GPIO_SD_B1_11_LPI2C2_SCL {
		pinmux = <0x401F8200 0x3 0x401F84D4 0x0 0x401F83F0>;
	};

	IOMUXC_GPIO_SD_B1_11_LPSPI2_PCS3: IOMUXC_GPIO_SD_B1_11_LPSPI2_PCS3 {
		pinmux = <0x401F8200 0x4 0 0 0x401F83F0>;
	};

	IOMUXC_GPIO_SD_B1_11_GPIO3_IO11: IOMUXC_GPIO_SD_B1_11_GPIO3_IO11 {
		pinmux = <0x401F8200 0x5 0 0 0x401F83F0>;
	};

	IOMUXC_GPIO_SPI_B0_00: IOMUXC_GPIO_SPI_B0_00 {
		pinmux = <0x401F865C 0 0 0 0x401F86B4>;
	};

	IOMUXC_GPIO_SPI_B0_01_FLEXSPI2_B_SCLK: IOMUXC_GPIO_SPI_B0_01_FLEXSPI2_B_SCLK {
		pinmux = <0x401F8660 0x0 0x401F8754 0x1 0x401F86B8>;
	};

	IOMUXC_GPIO_SPI_B0_02_FLEXSPI2_A_DATA00: IOMUXC_GPIO_SPI_B0_02_FLEXSPI2_A_DATA00 {
		pinmux = <0x401F8664 0x0 0x401F8730 0x2 0x401F86BC>;
	};

	IOMUXC_GPIO_SPI_B0_03_FLEXSPI2_B_DATA02: IOMUXC_GPIO_SPI_B0_03_FLEXSPI2_B_DATA02 {
		pinmux = <0x401F8668 0x0 0x401F8748 0x1 0x401F86C0>;
	};

	IOMUXC_GPIO_SPI_B0_04_FLEXSPI2_B_DATA03: IOMUXC_GPIO_SPI_B0_04_FLEXSPI2_B_DATA03 {
		pinmux = <0x401F866C 0x0 0x401F874C 0x1 0x401F86C4>;
	};

	IOMUXC_GPIO_SPI_B0_05_FLEXSPI2_A_SS0_B: IOMUXC_GPIO_SPI_B0_05_FLEXSPI2_A_SS0_B {
		pinmux = <0x401F8670 0x0 0 0 0x401F86C8>;
	};

	IOMUXC_GPIO_SPI_B0_06_FLEXSPI2_A_DATA02: IOMUXC_GPIO_SPI_B0_06_FLEXSPI2_A_DATA02 {
		pinmux = <0x401F8674 0x0 0x401F8738 0x2 0x401F86CC>;
	};

	IOMUXC_GPIO_SPI_B0_07_FLEXSPI2_B_DATA01: IOMUXC_GPIO_SPI_B0_07_FLEXSPI2_B_DATA01 {
		pinmux = <0x401F8678 0x0 0x401F8744 0x1 0x401F86D0>;
	};

	IOMUXC_GPIO_SPI_B0_08_FLEXSPI2_A_SCLK: IOMUXC_GPIO_SPI_B0_08_FLEXSPI2_A_SCLK {
		pinmux = <0x401F867C 0x0 0x401F8750 0x2 0x401F86D4>;
	};

	IOMUXC_GPIO_SPI_B0_09_FLEXSPI2_A_DQS: IOMUXC_GPIO_SPI_B0_09_FLEXSPI2_A_DQS {
		pinmux = <0x401F8680 0x0 0x401F872C 0x2 0x401F86D8>;
	};

	IOMUXC_GPIO_SPI_B0_10_FLEXSPI2_A_DATA03: IOMUXC_GPIO_SPI_B0_10_FLEXSPI2_A_DATA03 {
		pinmux = <0x401F8684 0x0 0x401F873C 0x2 0x401F86DC>;
	};

	IOMUXC_GPIO_SPI_B0_11_FLEXSPI2_B_DATA00: IOMUXC_GPIO_SPI_B0_11_FLEXSPI2_B_DATA00 {
		pinmux = <0x401F8688 0x0 0x401F8740 0x1 0x401F86E0>;
	};

	IOMUXC_GPIO_SPI_B0_12_FLEXSPI2_A_DATA01: IOMUXC_GPIO_SPI_B0_12_FLEXSPI2_A_DATA01 {
		pinmux = <0x401F868C 0x0 0x401F8734 0x2 0x401F86E4>;
	};

	IOMUXC_GPIO_SPI_B0_13: IOMUXC_GPIO_SPI_B0_13 {
		pinmux = <0x401F8690 0 0 0 0x401F86E8>;
	};

	IOMUXC_GPIO_SPI_B1_00_FLEXSPI2_A_DQS: IOMUXC_GPIO_SPI_B1_00_FLEXSPI2_A_DQS {
		pinmux = <0x401F8694 0x0 0x401F872C 0x0 0x401F86EC>;
	};

	IOMUXC_GPIO_SPI_B1_01_FLEXSPI2_A_DATA03: IOMUXC_GPIO_SPI_B1_01_FLEXSPI2_A_DATA03 {
		pinmux = <0x401F8698 0x0 0x401F873C 0x0 0x401F86F0>;
	};

	IOMUXC_GPIO_SPI_B1_02_FLEXSPI2_A_DATA02: IOMUXC_GPIO_SPI_B1_02_FLEXSPI2_A_DATA02 {
		pinmux = <0x401F869C 0x0 0x401F8738 0x0 0x401F86F4>;
	};

	IOMUXC_GPIO_SPI_B1_03_FLEXSPI2_A_DATA01: IOMUXC_GPIO_SPI_B1_03_FLEXSPI2_A_DATA01 {
		pinmux = <0x401F86A0 0x0 0x401F8734 0x0 0x401F86F8>;
	};

	IOMUXC_GPIO_SPI_B1_04_FLEXSPI2_A_DATA00: IOMUXC_GPIO_SPI_B1_04_FLEXSPI2_A_DATA00 {
		pinmux = <0x401F86A4 0x0 0x401F8730 0x0 0x401F86FC>;
	};

	IOMUXC_GPIO_SPI_B1_05_FLEXSPI2_A_SCLK: IOMUXC_GPIO_SPI_B1_05_FLEXSPI2_A_SCLK {
		pinmux = <0x401F86A8 0x0 0x401F8750 0x0 0x401F8700>;
	};

	IOMUXC_GPIO_SPI_B1_06_FLEXSPI2_A_SS0_B: IOMUXC_GPIO_SPI_B1_06_FLEXSPI2_A_SS0_B {
		pinmux = <0x401F86AC 0x0 0 0 0x401F8704>;
	};

	IOMUXC_GPIO_SPI_B1_07: IOMUXC_GPIO_SPI_B1_07 {
		pinmux = <0x401F86B0 0 0 0 0x401F8708>;
	};
};
